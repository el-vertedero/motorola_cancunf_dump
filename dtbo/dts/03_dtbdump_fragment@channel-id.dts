/dts-v1/;

/ {

	fragment@channel-id {
		target-path = "/";

		__overlay__ {
			channel-id-map = "acg\0amxbr\0amxpr\0amxmx\0amxcl\0amxar\0amxla\0amxpe\0amxco\0tefbr\0tefmx\0tefar\0tefcl\0tefpe\0tefco\0perar\0entcl\0iusmx\0niibr\0niicl\0niimx\0niipe\0oibr\0timbr\0tigco\0retbr\0retar\0retla\0retcl\0tefla\0retla1st\0tefunl\0tigca\0tigca1st\0retmx\0attmx\0womcl\0avaco\0retpe\0openla\0opencl\0openmx\0altmx\0openpe\0openpub\0undefined\0undefined\0undefined\0undefined\0undefined\0undefined\0undefined\0undefined\0undefined\0undefined\0undefined\0undefined\0undefined\0undefined\0undefined\0undefined\0undefined\0undefined\0undefined\0reteu\0retgb\0retfr\0retes\0retie\0retde\0vfgb\0vfde\0vffr\0o2gb\0o2de\0orafr\0bouyfr\0eegb\0tescogb\0yoigo\0oraes\0retapac\0retmea\0vfit\0vfes\0vfeu\03gb\0tescoie\0altfr\03ie\0altpt\0timit\0retma\0windit\0vfhu\0vfro\0telhu\0playpl\0oraeu\0dteu\0teleu\0pluspl\0dtpl\0tefes\0altice\0vipeu\0veoneu\0openeu\0reteu2\0demogb\0retdemo\0rettr\0undefined\0undefined\0undefined\0undefined\0undefined\0undefined\0undefined\0undefined\0undefined\0undefined\0undefined\0undefined\0undefined\0undefined\0undefined\0undefined\0retca\0bwaca\0tkpca\0vzw\0att\0tmo\0sprint\0repw\0attpre\0cricket\0cc\0usc\0tracfone\0retus\0metropcs\0rcica\0wndca\0dmc\0bby\0amz\0acg\0lra\0comcast\0fi\0vzwpre\0boost\0spectrum\0undefined\0undefined\0undefined\0undefined\0undefined\0undefined\0undefined\0undefined\0undefined\0undefined\0undefined\0undefined\0undefined\0undefined\0undefined\0undefined\0undefined\0undefined\0undefined\0undefined\0undefined\0undefined\0undefined\0undefined\0undefined\0undefined\0undefined\0undefined\0undefined\0undefined\0undefined\0undefined\0undefined\0undefined\0undefined\0undefined\0undefined\0retin\0retcn\0telstra\0vfau\0amzin\0jioin\0airin\0retid\0cmcc\0ctcn\0cucn\0retmm\0gt4gtw\0retth\0retru\0trueth\0smarthk\0mobilpk\0retsea\0retjp\0softbank\0optus\0retkr\0retjio\0ymobile\0lguplus\0docomo\0retanz\0cbncn\0kddi\0rakuten\0undefined\0undefined\0undefined\0undefined\0undefined\0undefined\0undefined\0undefined\0undefined\0undefined\0undefined\0undefined\0undefined\0undefined\0undefined\0undefined\0undefined\0undefined\0undefined\0undefined\0undefined\0undefined\0undefined\0undefined\0undefined\0undefined\0undefined\0undefined\0undefined\0undefined\0undefined\0undefined\0undefined";
		};
	};

	fragment@0 {
		target = <0xffffffff>;

		__overlay__ {
			compatible = "mmi,utags";
			mmi,main-utags = "/dev/block/by-name/utags";
			mmi,backup-utags = "/dev/block/by-name/utagsBackup";
		};
	};

	fragment@1 {
		target = <0xffffffff>;

		__overlay__ {
			compatible = "mmi,utags";
			mmi,dir-name = "hw";
			mmi,main-utags = "/dev/block/by-name/hw";
		};
	};

	fragment@2 {
		target = <0xffffffff>;

		__overlay__ {
			force_dyn_mipi_change;
		};
	};

	fragment@3 {
		target = <0xffffffff>;

		__overlay__ {
			id = <0x06>;

			i2c_lcd_bias@3e {
				compatible = "sm,bias_sm5109";
				reg = <0x3e>;
				sm,lcd-bias-enn-gpio = <0xffffffff 0x86 0x00>;
				sm,lcd-bias-enp-gpio = <0xffffffff 0xb6 0x00>;
				biasp_en_pin = <0xb6>;
				biasn_en_pin = <0x86>;
				status = "okay";
				phandle = <0x59>;
			};

			sprd_backlight@36 {
				compatible = "awinic,aw99703-bl\0sm-sm5350";
				reg = <0x36>;
				id = <0x06>;
				lk_hwen-gpio = <0x08>;
				status = "okay";
				pwm-cfg = <0x0f>;
				hwen-gpio = <0xffffffff 0x08 0x01>;
				boost-ctl = <0x02>;
				ctl-bank-en = <0x02>;
				full-scale-current = <0x19>;
				map-mode = <0x00>;
				current-align-type = <0x01>;
				sm5350,default-brightness = <0x3ff>;
				sm5350,init-seq-enable = <0x01>;
				sm5350,init-seq = <0x1a 0x02 0x1c 0x0f 0x10 0x07 0x16 0x00 0x18 0x19 0x23 0xff 0x24 0x02>;
				aw99703,hwen-gpio = <0xffffffff 0x08 0x01>;
				aw99703,bl-map = <0x03>;
				aw99703,using-lsb;
				aw99703,ovp-level = <0x03>;
				aw99703,ocp-level = <0x02>;
				aw99703,switch-freq = <0x01>;
				aw99703,auto-freq-high = <0x10>;
				aw99703,auto-freq-low = <0x05>;
				aw99703,bl-fscal-led = <0x19>;
				aw99703,bl-channel = <0x03>;
				aw99703,turn-on-ramp = <0x00>;
				aw99703,turn-off-ramp = <0x04>;
				aw99703,pwm-trans-dim = <0x00>;
				aw99703,i2c-trans-dim = <0x01>;
				aw99703,skip-first-trans;
				aw99703,reset-trans-delay;
				aw99703,pwm-mode = <0x01>;
				aw99703,map-type = <0x00>;
				aw99703,current-align-type = <0x01>;
				aw99703,work-mode = <0x01>;
				aw99703,default-brightness = <0x3ff>;
				aw99703,init-seq-enable = <0x01>;
				aw99703,init-seq = <0x02 0x00 0x03 0xcf 0x04 0x2e 0x09 0x00 0x05 0x50 0x06 0x02 0x07 0xe2 0x67 0x1c 0x25 0x61 0x24 0x4c 0x23 0x61 0x02 0x01>;
				phandle = <0x5a>;
			};
		};
	};

	fragment@4 {
		target = <0xffffffff>;

		__overlay__ {
			compatible = "mediatek,i2c-leds";

			backlight {
				label = "lcd-backlight";
				led_mode = <0x06>;
				max-brightness = <0x7ff>;
				max-hw-brightness = <0x7ff>;
				default-brightness = <0x712>;
			};
		};
	};

	fragment@5 {
		target = <0xffffffff>;

		__overlay__ {

			lcd_bias_enp0_gpio {
				phandle = <0x01>;

				pins_cmd_dat {
					pinmux = <0xb600>;
					slew-rate = <0x01>;
					output-high;
				};
			};

			lcd_bias_enn0_gpio {
				phandle = <0x02>;

				pins_cmd_dat {
					pinmux = <0x8600>;
					slew-rate = <0x01>;
					output-low;
				};
			};

			lcm_rst_out1_gpio {
				phandle = <0x03>;

				pins_cmd_dat {
					pinmux = <0x5f00>;
					slew-rate = <0x01>;
					output-high;
				};
			};

			lcm_rst_out0_gpio {
				phandle = <0x04>;

				pins_cmd_dat {
					pinmux = <0x5f00>;
					slew-rate = <0x01>;
					output-low;
				};
			};

			lcm_dsi_te {
				phandle = <0x05>;

				pins_cmd_dat {
					pinmux = <0x5e01>;
				};
			};
		};
	};

	fragment@6 {
		target = <0xffffffff>;

		__overlay__ {
			pinctrl-names = "lcd_bias_enp0_gpio\0lcd_bias_enn0_gpio\0lcm_rst_out1_gpio\0lcm_rst_out0_gpio\0mode_te_te";
			pinctrl-0 = <0x01>;
			pinctrl-1 = <0x02>;
			pinctrl-2 = <0x03>;
			pinctrl-3 = <0x04>;
			pinctrl-4 = <0x05>;
			status = "okay";
		};
	};

	fragment@7 {
		target = <0xffffffff>;

		__overlay__ {
			status = "okay";
			#address-cells = <0x01>;
			#size-cells = <0x00>;

			panel1@0 {
				compatible = "mot,dummy,vdo,60hz";
				reg = <0x00>;
				pinctrl-names = "default";

				port {

					endpoint {
						remote-endpoint = <0x06>;
						phandle = <0x07>;
					};
				};
			};

			panel2@0 {
				compatible = "tm,nt36672c,vdo,120hz";
				reg = <0x01>;
				reset-gpios = <0xffffffff 0x5f 0x00>;
				bias_n-gpios = <0xffffffff 0x86 0x00>;
				bias_p-gpios = <0xffffffff 0xb6 0x00>;
				pinctrl-names = "default";

				port {

					endpoint {
						remote-endpoint = <0x06>;
						phandle = <0x5b>;
					};
				};
			};

			panel3@0 {
				compatible = "txd,ili7807s,vdo,120hz";
				reg = <0x02>;
				reset-gpios = <0xffffffff 0x5f 0x00>;
				bias_n-gpios = <0xffffffff 0x86 0x00>;
				bias_p-gpios = <0xffffffff 0xb6 0x00>;
				pinctrl-names = "default";

				port {

					endpoint {
						remote-endpoint = <0x06>;
						phandle = <0x5c>;
					};
				};
			};

			panel4@0 {
				compatible = "csot_ft8725,vid,120hz";
				reg = <0x03>;
				reset-gpios = <0xffffffff 0x5f 0x00>;
				bias_n-gpios = <0xffffffff 0x86 0x00>;
				bias_p-gpios = <0xffffffff 0xb6 0x00>;
				pinctrl-names = "default";

				port {

					endpoint {
						remote-endpoint = <0x06>;
						phandle = <0x5d>;
					};
				};
			};

			panel5@0 {
				compatible = "csot_ft8725,vid,120hz";
				reg = <0x04>;
				reset-gpios = <0xffffffff 0x5f 0x00>;
				bias_n-gpios = <0xffffffff 0x86 0x00>;
				bias_p-gpios = <0xffffffff 0xb6 0x00>;
				pinctrl-names = "default";

				port {

					endpoint {
						remote-endpoint = <0x06>;
						phandle = <0x5e>;
					};
				};
			};

			ports {

				port {

					endpoint {
						remote-endpoint = <0x07>;
						phandle = <0x06>;
					};
				};
			};
		};
	};

	fragment@8 {
		target = <0xffffffff>;

		__overlay__ {

			cam0@0 {
				phandle = <0x09>;

				pins_cmd_dat {
					pinmux = <0x1f00>;
					slew-rate = <0x01>;
					output-low;
				};
			};

			cam0@1 {
				phandle = <0x0a>;

				pins_cmd_dat {
					pinmux = <0x1f00>;
					slew-rate = <0x01>;
					output-high;
				};
			};

			cam1@0 {
				phandle = <0x0b>;

				pins_cmd_dat {
					pinmux = <0x1d00>;
					slew-rate = <0x01>;
					output-low;
				};
			};

			cam1@1 {
				phandle = <0x0c>;

				pins_cmd_dat {
					pinmux = <0x1d00>;
					slew-rate = <0x01>;
					output-high;
				};
			};

			cam2@0 {
				phandle = <0x0d>;

				pins_cmd_dat {
					pinmux = <0x2000>;
					slew-rate = <0x01>;
					output-low;
				};
			};

			cam2@1 {
				phandle = <0x0e>;

				pins_cmd_dat {
					pinmux = <0x2000>;
					slew-rate = <0x01>;
					output-high;
				};
			};

			cam0@vcam0 {
				phandle = <0x0f>;

				pins_cmd_dat {
					pinmux = <0x1900>;
					slew-rate = <0x01>;
					output-low;
				};
			};

			cam0@vcam1 {
				phandle = <0x10>;

				pins_cmd_dat {
					pinmux = <0x1900>;
					slew-rate = <0x01>;
					output-high;
				};
			};

			cam0@vcam2 {
				phandle = <0x11>;

				pins_cmd_dat {
					pinmux = <0x1a00>;
					slew-rate = <0x01>;
					output-low;
				};
			};

			cam0@vcam3 {
				phandle = <0x12>;

				pins_cmd_dat {
					pinmux = <0x1a00>;
					slew-rate = <0x01>;
					output-high;
				};
			};

			cam0@vcam4 {
				phandle = <0x13>;

				pins_cmd_dat {
					pinmux = <0xb00>;
					slew-rate = <0x01>;
					output-low;
				};
			};

			cam0@vcam5 {
				phandle = <0x14>;

				pins_cmd_dat {
					pinmux = <0xb00>;
					slew-rate = <0x01>;
					output-high;
				};
			};

			cam0@vcam6 {
				phandle = <0x32>;

				pins_cmd_dat {
					pinmux = <0x400>;
					slew-rate = <0x01>;
					output-low;
				};
			};

			cam0@vcam7 {
				phandle = <0x33>;

				pins_cmd_dat {
					pinmux = <0x400>;
					slew-rate = <0x01>;
					output-high;
				};
			};

			cam2@vcam8 {
				phandle = <0x21>;

				pins_cmd_dat {
					pinmux = <0x600>;
					slew-rate = <0x01>;
					output-low;
				};
			};

			cam2@vcam9 {
				phandle = <0x22>;

				pins_cmd_dat {
					pinmux = <0x600>;
					slew-rate = <0x01>;
					output-high;
				};
			};

			cam1@vcam0 {
				phandle = <0x15>;

				pins_cmd_dat {
					pinmux = <0xc00>;
					slew-rate = <0x01>;
					output-low;
				};
			};

			cam1@vcam1 {
				phandle = <0x16>;

				pins_cmd_dat {
					pinmux = <0xc00>;
					slew-rate = <0x01>;
					output-high;
				};
			};

			cam1@vcam2 {
				phandle = <0x17>;

				pins_cmd_dat {
					pinmux = <0x900>;
					slew-rate = <0x01>;
					output-low;
				};
			};

			cam1@vcam3 {
				phandle = <0x18>;

				pins_cmd_dat {
					pinmux = <0x900>;
					slew-rate = <0x01>;
					output-high;
				};
			};

			cam1@vcam4 {
				phandle = <0x19>;

				pins_cmd_dat {
					pinmux = <0xb00>;
					slew-rate = <0x01>;
					output-low;
				};
			};

			cam1@vcam5 {
				phandle = <0x1a>;

				pins_cmd_dat {
					pinmux = <0xb00>;
					slew-rate = <0x01>;
					output-high;
				};
			};

			cam2@vcam0 {
				phandle = <0x1b>;

				pins_cmd_dat {
					pinmux = <0x1400>;
					slew-rate = <0x01>;
					output-low;
				};
			};

			cam2@vcam1 {
				phandle = <0x1c>;

				pins_cmd_dat {
					pinmux = <0x1400>;
					slew-rate = <0x01>;
					output-high;
				};
			};

			cam2@vcam2 {
				phandle = <0x1d>;

				pins_cmd_dat {
					pinmux = <0xa00>;
					slew-rate = <0x01>;
					output-low;
				};
			};

			cam2@vcam3 {
				phandle = <0x1e>;

				pins_cmd_dat {
					pinmux = <0xa00>;
					slew-rate = <0x01>;
					output-high;
				};
			};

			cam2@vcam4 {
				phandle = <0x1f>;

				pins_cmd_dat {
					pinmux = <0xb00>;
					slew-rate = <0x01>;
					output-low;
				};
			};

			cam2@vcam5 {
				phandle = <0x20>;

				pins_cmd_dat {
					pinmux = <0xb00>;
					slew-rate = <0x01>;
					output-high;
				};
			};

			camera_pins_cam0_mclk_off {
				phandle = <0x23>;

				pins_cmd_dat {
					pinmux = <0x6400>;
					drive-strength = <0x01>;
				};
			};

			camera_pins_cam0_mclk_2ma {
				phandle = <0x24>;

				pins_cmd_dat {
					pinmux = <0x6401>;
					drive-strength = <0x00>;
				};
			};

			camera_pins_cam0_mclk_4ma {
				phandle = <0x25>;

				pins_cmd_dat {
					pinmux = <0x6401>;
					drive-strength = <0x01>;
				};
			};

			camera_pins_cam0_mclk_6ma {
				phandle = <0x26>;

				pins_cmd_dat {
					pinmux = <0x6401>;
					drive-strength = <0x02>;
				};
			};

			camera_pins_cam0_mclk_8ma {
				phandle = <0x27>;

				pins_cmd_dat {
					pinmux = <0x6401>;
					drive-strength = <0x03>;
				};
			};

			camera_pins_cam1_mclk_off {
				phandle = <0x28>;

				pins_cmd_dat {
					pinmux = <0x6100>;
					drive-strength = <0x01>;
				};
			};

			camera_pins_cam1_mclk_2ma {
				phandle = <0x29>;

				pins_cmd_dat {
					pinmux = <0x6101>;
					drive-strength = <0x00>;
				};
			};

			camera_pins_cam1_mclk_4ma {
				phandle = <0x2a>;

				pins_cmd_dat {
					pinmux = <0x6101>;
					drive-strength = <0x01>;
				};
			};

			camera_pins_cam1_mclk_6ma {
				phandle = <0x2b>;

				pins_cmd_dat {
					pinmux = <0x6101>;
					drive-strength = <0x02>;
				};
			};

			camera_pins_cam1_mclk_8ma {
				phandle = <0x2c>;

				pins_cmd_dat {
					pinmux = <0x6101>;
					drive-strength = <0x03>;
				};
			};

			camera_pins_cam2_mclk_off {
				phandle = <0x2d>;

				pins_cmd_dat {
					pinmux = <0x6300>;
					drive-strength = <0x01>;
				};
			};

			camera_pins_cam2_mclk_2ma {
				phandle = <0x2e>;

				pins_cmd_dat {
					pinmux = <0x6301>;
					drive-strength = <0x00>;
				};
			};

			camera_pins_cam2_mclk_4ma {
				phandle = <0x2f>;

				pins_cmd_dat {
					pinmux = <0x6301>;
					drive-strength = <0x01>;
				};
			};

			camera_pins_cam2_mclk_6ma {
				phandle = <0x30>;

				pins_cmd_dat {
					pinmux = <0x6301>;
					drive-strength = <0x02>;
				};
			};

			camera_pins_cam2_mclk_8ma {
				phandle = <0x31>;

				pins_cmd_dat {
					pinmux = <0x6301>;
					drive-strength = <0x03>;
				};
			};

			camdefault {
				phandle = <0x08>;
			};

			flashlight@0 {
				phandle = <0x35>;

				pins_cmd_dat {
					pinmux = <0x1500>;
					slew-rate = <0x01>;
					output-high;
				};
			};

			flashlight@1 {
				phandle = <0x36>;

				pins_cmd_dat {
					pinmux = <0x1500>;
					slew-rate = <0x01>;
					output-low;
				};
			};

			flashlight@2 {
				phandle = <0x37>;

				pins_cmd_dat {
					pinmux = <0x1800>;
					slew-rate = <0x01>;
					output-high;
				};
			};

			flashlight@3 {
				phandle = <0x38>;

				pins_cmd_dat {
					pinmux = <0x1800>;
					slew-rate = <0x01>;
					output-low;
				};
			};

			flashlight@4 {
				phandle = <0x39>;

				pins_cmd_dat {
					pinmux = <0x1801>;
					slew-rate = <0x01>;
					output-high;
				};
			};

			flashlightdefault {
				phandle = <0x34>;
			};
		};
	};

	fragment@9 {
		target = <0xffffffff>;

		__overlay__ {
			pinctrl-names = "default\0cam0_rst0\0cam0_rst1\0cam1_rst0\0cam1_rst1\0cam2_rst0\0cam2_rst1\0cam0_ldo_vcamd_0\0cam0_ldo_vcamd_1\0cam0_ldo_vcama_0\0cam0_ldo_vcama_1\0cam0_ldo_vcamio_0\0cam0_ldo_vcamio_1\0cam1_ldo_vcamd_0\0cam1_ldo_vcamd_1\0cam1_ldo_vcama_0\0cam1_ldo_vcama_1\0cam1_ldo_vcamio_0\0cam1_ldo_vcamio_1\0cam2_ldo_vcamd_0\0cam2_ldo_vcamd_1\0cam2_ldo_vcama_0\0cam2_ldo_vcama_1\0cam2_ldo_vcamio_0\0cam2_ldo_vcamio_1\0cam0_ldo_vcamaf_0\0cam0_ldo_vcamaf_1\0cam0_mclk_off\0cam0_mclk_2mA\0cam0_mclk_4mA\0cam0_mclk_6mA\0cam0_mclk_8mA\0cam1_mclk_off\0cam1_mclk_2mA\0cam1_mclk_4mA\0cam1_mclk_6mA\0cam1_mclk_8mA\0cam2_mclk_off\0cam2_mclk_2mA\0cam2_mclk_4mA\0cam2_mclk_6mA\0cam2_mclk_8mA\0cam0_ldo_vcamd1_0\0cam0_ldo_vcamd1_1";
			pinctrl-0 = <0x08>;
			pinctrl-1 = <0x09>;
			pinctrl-2 = <0x0a>;
			pinctrl-3 = <0x0b>;
			pinctrl-4 = <0x0c>;
			pinctrl-5 = <0x0d>;
			pinctrl-6 = <0x0e>;
			pinctrl-7 = <0x0f>;
			pinctrl-8 = <0x10>;
			pinctrl-9 = <0x11>;
			pinctrl-10 = <0x12>;
			pinctrl-11 = <0x13>;
			pinctrl-12 = <0x14>;
			pinctrl-13 = <0x15>;
			pinctrl-14 = <0x16>;
			pinctrl-15 = <0x17>;
			pinctrl-16 = <0x18>;
			pinctrl-17 = <0x19>;
			pinctrl-18 = <0x1a>;
			pinctrl-19 = <0x1b>;
			pinctrl-20 = <0x1c>;
			pinctrl-21 = <0x1d>;
			pinctrl-22 = <0x1e>;
			pinctrl-23 = <0x1f>;
			pinctrl-24 = <0x20>;
			pinctrl-25 = <0x21>;
			pinctrl-26 = <0x22>;
			pinctrl-27 = <0x23>;
			pinctrl-28 = <0x24>;
			pinctrl-29 = <0x25>;
			pinctrl-30 = <0x26>;
			pinctrl-31 = <0x27>;
			pinctrl-32 = <0x28>;
			pinctrl-33 = <0x29>;
			pinctrl-34 = <0x2a>;
			pinctrl-35 = <0x2b>;
			pinctrl-36 = <0x2c>;
			pinctrl-37 = <0x2d>;
			pinctrl-38 = <0x2e>;
			pinctrl-39 = <0x2f>;
			pinctrl-40 = <0x30>;
			pinctrl-41 = <0x31>;
			pinctrl-42 = <0x32>;
			pinctrl-43 = <0x33>;
			cam2_vcamaf-supply = <0xffffffff>;
			cam0_pin_mclk = "mclk";
			cam0_pin_rst = "gpio";
			cam0_pin_vcama = "gpio";
			cam0_pin_vcamd = "gpio";
			cam0_pin_vcamio = "gpio";
			cam0_pin_vcamd1 = "gpio";
			cam0_pin_vcamaf = "gpio";
			cam1_pin_mclk = "mclk";
			cam1_pin_rst = "gpio";
			cam1_pin_vcama = "gpio";
			cam1_pin_vcamd = "gpio";
			cam1_pin_vcamio = "gpio";
			cam2_pin_mclk = "mclk";
			cam2_pin_rst = "gpio";
			cam2_pin_vcama = "gpio";
			cam2_pin_vcamd = "gpio";
			cam2_pin_vcamio = "gpio";
			cam2_pin_vcamaf = "regulator";
			cam0_enable_sensor = "mot_cancunf_ov50d_mipi_raw mot_cancunf_s5kjns_mipi_raw mot_cancunf_jns_yova_mipi_raw";
			cam1_enable_sensor = "mot_cancunf_hi1634q_mipi_raw mot_cancunf_s5k3p9sp04_mipi_raw";
			cam2_enable_sensor = "mot_cancunf_s5k4h7_mipi_raw mot_cancunf_sc202_mipi_raw";
			status = "okay";
		};
	};

	fragment@10 {
		target = <0xffffffff>;

		__overlay__ {
			status = "okay";
			clock-frequency = <0xf4240>;
			#address-cells = <0x01>;
			size-cells = <0x00>;

			camera_eeprom0@50 {
				compatible = "mediatek,camera_eeprom";
				reg = <0x50>;
				status = "okay";
				phandle = <0x5f>;
			};

			camera_main@1a {
				compatible = "mediatek,camera_main";
				#thermal-sensor-cells = <0x00>;
				reg = <0x1a>;
				status = "okay";
				phandle = <0x60>;
			};
		};
	};

	fragment@11 {
		target = <0xffffffff>;

		__overlay__ {
			status = "okay";
			clock-frequency = <0xf4240>;
			#address-cells = <0x01>;
			#size-cells = <0x00>;

			camera_eeprom1@51 {
				compatible = "mediatek,camera_eeprom";
				reg = <0x51>;
				status = "okay";
				phandle = <0x61>;
			};

			camera_sub@1a {
				compatible = "mediatek,camera_sub";
				#thermal-sensor-cells = <0x00>;
				reg = <0x1a>;
				status = "okay";
				phandle = <0x62>;
			};
		};
	};

	fragment@12 {
		target = <0xffffffff>;

		__overlay__ {
			status = "okay";
			clock-frequency = <0x61a80>;
			#address-cells = <0x01>;
			#size-cells = <0x00>;

			camera_eeprom2@50 {
				compatible = "mediatek,camera_eeprom";
				reg = <0x50>;
				status = "okay";
				phandle = <0x63>;
			};

			camera_main_two@10 {
				compatible = "mediatek,camera_main_two";
				#thermal-sensor-cells = <0x00>;
				reg = <0x10>;
				status = "okay";
				phandle = <0x64>;
			};
		};
	};

	fragment@13 {
		target = <0xffffffff>;

		__overlay__ {
			compatible = "mediatek,flashlights_cancunf_pwm";
			pinctrl-names = "default\0flashlight_gpio_high\0flashlight_gpio_low\0flashlight_pwm_high\0flashlight_pwm_low\0flashlight_pwm_en";
			pinctrl-0 = <0x34>;
			pinctrl-1 = <0x35>;
			pinctrl-2 = <0x36>;
			pinctrl-3 = <0x37>;
			pinctrl-4 = <0x38>;
			pinctrl-5 = <0x39>;
			srcclk = <0xffffffff>;
			decouple = <0x01>;

			channel@1 {
				status = "okay";
				type = <0x00>;
				ct = <0x00>;
				part = <0x00>;
			};
		};
	};

	fragment@14 {
		target = <0xffffffff>;

		__overlay__ {

			camera_main_af@72 {
				compatible = "mediatek,camera_main_af";
				reg = <0x72>;
				status = "okay";
				phandle = <0x65>;
			};
		};
	};

	fragment@15 {
		target = <0xffffffff>;

		__overlay__ {

			camera_main_two_af@0c {
				compatible = "mediatek,camera_main_two_af";
				reg = <0x0c>;
				status = "okay";
				phandle = <0x66>;
			};
		};
	};

	fragment@16 {
		target = <0xffffffff>;

		__overlay__ {

			sar_int_default {
				phandle = <0x3a>;

				pins_cmd_dat {
					pinmux = <0x1200>;
					input-enable;
					drive-strength = <0x02>;
					bias-pull-up;
				};
			};

			sar_int_sleep {
				phandle = <0x3b>;

				pins_cmd_dat {
					pinmux = <0x1200>;
					input-enable;
					drive-strength = <0x02>;
					bias-pull-up;
				};
			};
		};
	};

	fragment@17 {
		target = <0xffffffff>;

		__overlay__ {
			regulator-min-microvolt = <0x1b7740>;
			regulator-max-microvolt = <0x200b20>;
		};
	};

	fragment@18 {
		target = <0xffffffff>;

		__overlay__ {
			status = "okay";

			sx937x@2c {
				compatible = "Semtech,sx937x";
				reg = <0x2c>;
				pinctrl-names = "default\0sleep";
				pinctrl-0 = <0x3a>;
				pinctrl-1 = <0x3b>;
				interrupt-parent = <0xffffffff>;
				interrupts = <0x12 0x02>;
				interrupt-names = "sx937x_irq";
				Semtech,nirq-gpio = <0xffffffff 0x12 0x02>;
				cap_vdd-supply = <0xffffffff>;
				Semtech,ref-phases-a = <0x05>;
				Semtech,ref-phases-b = <0x06>;
				Semtech,ref-phases-c = <0xff>;
				Semtech,button-flag = <0x1f>;
				Semtech,reg-num = <0x3d>;
				Semtech,reg-init = <0x8024 0x7f7f 0x4004 0x74 0x4008 0x08 0x8020 0x32 0x8028 0x877 0x8034 0x877 0x8040 0x877 0x804c 0x877 0x8058 0x877 0x8064 0x877 0x8070 0x877 0x807c 0x88e 0x8030 0x924925 0x803c 0xb24924 0x8048 0x925924 0x8054 0x92c924 0x8060 0x964924 0x806c 0x92492c 0x8078 0x924964 0x8084 0xfff9ff 0x8098 0x5035 0x80b8 0x2525 0x80d8 0x593f 0x80f8 0x1414 0x8118 0x2a2a 0x8138 0x8e 0x8158 0x8e 0x8178 0x8e 0x80a0 0x20200001 0x80c0 0x21210002 0x80e0 0x20200002 0x8100 0x9090003 0x8120 0xd0d0004 0x8188 0x8000015 0x818c 0x8000016 0x8190 0x8000015 0x8194 0x8000015 0x8090 0x54b85000 0x80b0 0x50b85000 0x80d0 0x54b85000 0x80f0 0x28d87000 0x8110 0x64a45000 0x8130 0x5300 0x8150 0x5300 0x8170 0x5300 0x8088 0x300000 0x80a8 0x300000 0x80c8 0x300000 0x80e8 0x300000 0x8108 0x300000 0x8128 0x300000 0x8148 0x300000 0x8168 0x300000 0x808c 0x602000c0 0x80ac 0x602000c0 0x80cc 0x602000c0 0x80ec 0x6020000c 0x810c 0x602000c0 0x812c 0x60200030 0x814c 0x60200030 0x816c 0x60200030>;
				status = "okay";
				phandle = <0x67>;
			};
		};
	};

	fragment@19 {
		target = <0xffffffff>;

		__overlay__ {

			speaker_amp@5c {
				compatible = "richtek,rt5512";
				#sound-dai-cells = <0x00>;
				reg = <0x5c>;
				sound-name-prefix = "Left";
				status = "disable";
				phandle = <0x51>;
			};
		};
	};

	fragment@20 {
		target = <0xffffffff>;

		__overlay__ {

			aw87xxx_pa@58 {
				compatible = "awinic,aw87xxx_pa";
				reg = <0x58>;
				dev_index = <0x00>;
				status = "okay";
			};

			aw87xxx_pa@59 {
				compatible = "awinic,aw87xxx_pa";
				reg = <0x59>;
				dev_index = <0x01>;
				status = "okay";
			};
		};
	};

	fragment@21 {
		target = <0xffffffff>;

		__overlay__ {

			aud_pins_hacamp_high {
				phandle = <0x3c>;

				pins_cmd_dat {
					pinmux = <0x9e00>;
					slew-rate = <0x01>;
					output-high;
				};
			};

			aud_pins_hacamp_low {
				phandle = <0x3d>;

				pins_cmd_dat {
					pinmux = <0x9e00>;
					slew-rate = <0x01>;
					output-low;
				};
			};
		};
	};

	fragment@22 {
		target = <0xffffffff>;

		__overlay__ {
			pinctrl-names = "aud_clk_mosi_off\0aud_clk_mosi_on\0aud_dat_mosi_off\0aud_dat_mosi_on\0aud_dat_miso0_off\0aud_dat_miso0_on\0aud_dat_miso1_off\0aud_dat_miso1_on\0aud_dat_miso2_off\0aud_dat_miso2_on\0vow_dat_miso_off\0vow_dat_miso_on\0vow_clk_miso_off\0vow_clk_miso_on\0aud_gpio_i2s0_off\0aud_gpio_i2s0_on\0aud_gpio_i2s3_off\0aud_gpio_i2s3_on\0hacamp_pullhigh\0hacamp_pulllow";
			pinctrl-0 = <0xffffffff>;
			pinctrl-1 = <0xffffffff>;
			pinctrl-2 = <0xffffffff>;
			pinctrl-3 = <0xffffffff>;
			pinctrl-4 = <0xffffffff>;
			pinctrl-5 = <0xffffffff>;
			pinctrl-6 = <0xffffffff>;
			pinctrl-7 = <0xffffffff>;
			pinctrl-8 = <0xffffffff>;
			pinctrl-9 = <0xffffffff>;
			pinctrl-10 = <0xffffffff>;
			pinctrl-11 = <0xffffffff>;
			pinctrl-12 = <0xffffffff>;
			pinctrl-13 = <0xffffffff>;
			pinctrl-14 = <0xffffffff>;
			pinctrl-15 = <0xffffffff>;
			pinctrl-16 = <0xffffffff>;
			pinctrl-17 = <0xffffffff>;
			pinctrl-18 = <0x3c>;
			pinctrl-19 = <0x3d>;
		};
	};

	fragment@23 {
		target = <0xffffffff>;

		__overlay__ {
			regulator-min-microvolt = <0x325aa0>;
			regulator-max-microvolt = <0x325aa0>;
		};
	};

	fragment@24 {
		target = <0xffffffff>;

		__overlay__ {

			fingerfp_rst_high {
				phandle = <0x68>;

				pins_cmd_dat {
					pinmux = <0x9d00>;
					slew-rate = <0x01>;
					output-high;
				};
			};

			fingerfp_rst_low {
				phandle = <0x69>;

				pins_cmd_dat {
					pinmux = <0x9d00>;
					slew-rate = <0x01>;
					output-low;
				};
			};

			fingerfp_irq_active {
				phandle = <0x6a>;

				pins_cmd_dat {
					pinmux = <0xf00>;
					slew-rate = <0x00>;
					bias-disable;
				};
			};

			fingerfp_spi_active {
				phandle = <0x6b>;

				pins_cmd_dat {
					pinmux = <0x4402 0x4202 0x4302 0x4102>;
					drive-strength = <0x02>;
				};
			};

			fingerfp_spi_default {
				phandle = <0x6c>;

				pins_cmd_dat {
					pinmux = <0x4400 0x4200 0x4300 0x4100>;
					slew-rate = <0x01>;
					output-low;
				};
			};

			fingerprint_irq {
				phandle = <0x3e>;

				pins_cmd_dat {
					pinmux = <0xf00>;
					slew-rate = <0x00>;
					bias-disable;
				};
			};

			fingerprint_reset_high {
				phandle = <0x3f>;

				pins_cmd_dat {
					pinmux = <0x9d00>;
					slew-rate = <0x01>;
					output-high;
				};
			};

			fingerprint_reset_low {
				phandle = <0x40>;

				pins_cmd_dat {
					pinmux = <0x9d00>;
					slew-rate = <0x01>;
					output-low;
				};
			};
		};
	};

	fragment@25 {
		target = <0xffffffff>;

		__overlay__ {
			status = "okay";
			mediatek,pad-select = <0x00 0x01>;
			tee-only;

			goodix_tee@0 {
				compatible = "mediatek,finger-goodix";
				reg = <0x00>;
				spi-max-frequency = <0x7a1200>;
				netlink-event = <0x1e>;
				status = "okay";
			};

			chipone_tee@1 {
				status = "okay";
				compatible = "mediatek,finger-chipone";
				reg = <0x01>;
				spi-max-frequency = <0x989680>;
				netlink-event = <0x1e>;
			};
		};
	};

	fragment@26 {
		target = <0xffffffff>;

		__overlay__ {

			fingerprint_int {
				compatible = "mediatek,fingerprint-goodix";
				fp_vdd-supply = <0xffffffff>;
				interrupt-parent = <0xffffffff>;
				goodix_rst = <0xffffffff 0x9d 0x00>;
				gf,gpio_irq = <0xffffffff 0x0f 0x00>;
				interrupts = <0x0f 0x01 0x0f 0x00>;
				pinctrl-names = "fingerprint_irq\0fingerprint_reset_high\0fingerprint_reset_low";
				pinctrl-0 = <0x3e>;
				pinctrl-1 = <0x3f>;
				pinctrl-2 = <0x40>;
				status = "okay";
				phandle = <0x6d>;
			};

			chipone_int {
				compatible = "mediatek,chipone-fingerprint";
				chipone,enable-wakeup;
				fp_vdd-supply = <0xffffffff>;
				interrupt-parent = <0xffffffff>;
				interrupts = <0x0f 0x01 0x0f 0x00>;
				pinctrl-names = "fingerprint_reset_low\0fingerprint_reset_high\0fingerprint_irq";
				pinctrl-0 = <0x40>;
				pinctrl-1 = <0x3f>;
				pinctrl-2 = <0x3e>;
				chipone,irq = <0xffffffff 0x0f 0x00>;
				status = "okay";
				phandle = <0x6e>;
			};
		};
	};

	fragment@27 {
		target = <0xffffffff>;

		__overlay__ {
			compatible = "mediatek,memory-ssmr-features";
			svp-region-based-size = <0x00 0x4000000>;
			svp-page-based-size = <0x00 0x19000000>;
			tui-size = <0x00 0x00>;
			wfd-region-based-size = <0x00 0x00>;
			wfd-page-based-size = <0x00 0x00>;
			prot-region-based-size = <0x00 0x00>;
			prot-page-based-size = <0x00 0x00>;
			sapu-data-shm-size = <0x00 0x00>;
		};
	};

	fragment@28 {
		target = <0xffffffff>;

		__overlay__ {
			bootargs_ext = "initcall_debug=0";
		};
	};

	fragment@29 {
		target = <0xffffffff>;

		__overlay__ {
			mediatek,xo-bbck4 = <0x01>;
		};
	};

	fragment@30 {
		target = <0xffffffff>;

		__overlay__ {

			sec-nfc@27 {
				compatible = "sec-nfc";
				reg = <0x27>;
				sec-nfc,ven-gpio = <0xffffffff 0xa1 0x00>;
				sec-nfc,firm-gpio = <0xffffffff 0x01 0x00>;
				sec-nfc,irq-gpio = <0xffffffff 0x02 0x00>;
				sec-nfc,clk_req-gpio = <0xffffffff 0xa0 0x00>;
				status = "okay";
			};

			nfc_pn5xx@28 {
				compatible = "qcom,sn-nci";
				reg = <0x28>;
				interrupt-parent = <0xffffffff>;
				interrupts = <0x02 0x04 0x01 0x00>;
				qcom,sn-irq = <0xffffffff 0x02 0x00>;
				qcom,sn-ven = <0xffffffff 0xa1 0x00>;
				status = "okay";
				phandle = <0x6f>;
			};
		};
	};

	fragment@31 {
		target = <0xffffffff>;

		__overlay__ {
			pinctrl-names = "lcm_rst_out1_gpio\0lcm_rst_out0_gpio\0mode_te_te";
			pinctrl-0 = <0x03>;
			pinctrl-1 = <0x04>;
			pinctrl-2 = <0x05>;
			status = "okay";
		};
	};

	fragment@32 {
		target = <0xffffffff>;

		__overlay__ {

			p61@0 {
				compatible = "nxp,p61";
				reg = <0x00>;
				spi-max-frequency = <0x1312d00>;
				nxp,nfcc = "3-0028";
				pinctrl-names = "pinctrl_state_mode_spi\0pinctrl_state_mode_idle";
				pinctrl-0 = <0x41>;
				pinctrl-1 = <0x42>;
				status = "okay";
				phandle = <0x70>;
			};
		};
	};

	fragment@33 {
		target = <0xffffffff>;

		__overlay__ {

			pinctrl_state_mode_spi {
				phandle = <0x41>;

				pins_cmd_dat {
					pinmux = <0x4d01 0x4e01 0x4f01 0x5001>;
					drive-strength = <0x02>;
				};
			};

			pinctrl_state_mode_idle {
				phandle = <0x42>;

				pins_cmd_dat {
					pinmux = <0x4e00>;
					slew-rate = <0x01>;
					output-high;
				};
			};
		};
	};

	fragment@34 {
		target = <0xffffffff>;

		__overlay__ {

			MTEE {
				compatible = "mediatek,mtk_svp_on_mtee_support";
				phandle = <0x71>;
			};

			SecureVideoPath {
				compatible = "mediatek,mtk_sec_video_path_support";
				phandle = <0x72>;
			};
		};
	};

	fragment@35 {
		target = <0xffffffff>;

		__overlay__ {
			min-volt = <0x2dc6c0>;
			max-volt = <0x3567e0>;
			status = "ok";
		};
	};

	fragment@36 {
		target = <0xffffffff>;

		__overlay__ {

			gps_default {
				phandle = <0x43>;
			};

			gps_l1_lna@0 {
				phandle = <0x44>;

				pins_cmd_dat {
					pinmux = <0x8500>;
					output-low;
				};
			};

			gps_l1_lna@1 {
				phandle = <0x45>;

				pins_cmd_dat {
					pinmux = <0x8503>;
				};
			};

			gps_l1_lna@2 {
				phandle = <0x46>;

				pins_cmd_dat {
					pinmux = <0x8500>;
					output-high;
				};
			};

			gps_l5_lna@0 {
				phandle = <0x47>;

				pins_cmd_dat {
					pinmux = <0x8600>;
					output-low;
				};
			};

			gps_l5_lna@1 {
				phandle = <0x48>;

				pins_cmd_dat {
					pinmux = <0x8603>;
				};
			};

			gps_l5_lna@2 {
				phandle = <0x49>;

				pins_cmd_dat {
					pinmux = <0x8600>;
					output-high;
				};
			};
		};
	};

	fragment@37 {
		target = <0xffffffff>;

		__overlay__ {
			pinctrl-names = "default\0gps_l1_lna_disable\0gps_l1_lna_dsp_ctrl\0gps_l1_lna_enable\0gps_l5_lna_disable\0gps_l5_lna_dsp_ctrl\0gps_l5_lna_enable";
			pinctrl-0 = <0x43>;
			pinctrl-1 = <0x44>;
			pinctrl-2 = <0x45>;
			pinctrl-3 = <0x46>;
			pinctrl-4 = <0x47>;
			pinctrl-5 = <0x48>;
			pinctrl-6 = <0x49>;
			status = "okay";
		};
	};

	fragment@38 {
		target = <0xffffffff>;

		__overlay__ {

			lm3644@63 {
				compatible = "mediatek,lm3644";
				reg = <0x63>;
				#cooling-cells = <0x02>;
				pinctrl-names = "default\0hwen_high\0hwen_low";
				pinctrl-0 = <0x4a>;
				pinctrl-1 = <0x4b>;
				pinctrl-2 = <0x4c>;
				status = "okay";
				phandle = <0x73>;

				flash@0 {
					reg = <0x00>;
					type = <0x00>;
					ct = <0x00>;
					part = <0x00>;

					port@0 {

						endpoint {
							remote-endpoint = <0x4d>;
							phandle = <0x4f>;
						};
					};
				};

				flash@1 {
					reg = <0x01>;
					type = <0x00>;
					ct = <0x01>;
					part = <0x00>;

					port@1 {

						endpoint {
							remote-endpoint = <0x4e>;
							phandle = <0x50>;
						};
					};
				};
			};
		};
	};

	fragment@39 {
		target = <0xffffffff>;

		__overlay__ {

			default {
				phandle = <0x4a>;
			};

			hwen_high {
				phandle = <0x4b>;

				pins_cmd_dat {
					pinmux = <0x400>;
					slew-rate = <0x01>;
					output-high;
				};
			};

			hwen_low {
				phandle = <0x4c>;

				pins_cmd_dat {
					pinmux = <0x400>;
					slew-rate = <0x01>;
					output-low;
				};
			};
		};
	};

	fragment@40 {
		target = <0xffffffff>;

		__overlay__ {

			port@0 {

				endpoint {
					remote-endpoint = <0x4f>;
					phandle = <0x4d>;
				};
			};

			port@1 {

				endpoint {
					remote-endpoint = <0x50>;
					phandle = <0x4e>;
				};
			};
		};
	};

	fragment@41 {
		target = <0xffffffff>;

		__overlay__ {
		};
	};

	fragment@42 {
		target = <0xffffffff>;

		__overlay__ {

			camera_main_three_af@0c {
				compatible = "mediatek,camera_main_three_af";
				reg = <0x0c>;
				status = "okay";
				phandle = <0x74>;
			};
		};
	};

	fragment@43 {
		target = <0xffffffff>;

		__overlay__ {
			camaf_m1_pmic-supply = <0xffffffff>;
			camaf_m2_pmic-supply = <0xffffffff>;
			camaf_m3_pmic-supply = <0xffffffff>;
			status = "okay";
		};
	};

	fragment@44 {
		target = <0xffffffff>;

		__overlay__ {
			mediatek,spk-i2s = <0x03 0x00>;

			mediatek,speaker-codec {
				sound-dai = <0x51>;
			};
		};
	};

	fragment@45 {
		target = <0xffffffff>;

		__overlay__ {
			pinctrl-0 = <0x52>;
			pinctrl-1 = <0x53>;
			cd-gpios = <0xffffffff 0x0e 0x00>;
			vmmc-supply = <0xffffffff>;
		};
	};

	fragment@46 {
		target = <0xffffffff>;

		__overlay__ {

			mmc1default {
				phandle = <0x52>;

				pins_clk {
					pinmux = <0x5201>;
					drive-strength = <0x07>;
					bias-pull-down = <0x66>;
				};
			};

			mmc1@0 {
				phandle = <0x53>;

				pins_clk {
					pinmux = <0x5201>;
					drive-strength = <0x07>;
					bias-pull-down = <0x66>;
				};
			};
		};
	};

	fragment@47 {
		target = <0xffffffff>;

		__overlay__ {
			status = "okay";
			#address-cells = <0x01>;
			#size-cells = <0x00>;
			mediatek,pad-select = <0x00 0x01 0x02>;
			pinctrl-names = "default\0ft8725_spi_mode";
			pinctrl-0 = <0x54>;
			pinctrl-1 = <0x55>;

			novatek@0 {
				compatible = "novatek,NVT-ts-spi";
				reg = <0x00>;
				status = "ok";
				spi-max-frequency = <0x927c00>;
				novatek,reset-gpio = <0xffffffff 0x03 0x00>;
				novatek,irq-gpio = <0xffffffff 0x16 0x2001>;
				novatek,usb_charger;
				novatek,report_gesture_key;
				novatek,supported_gesture_type = <0x06>;
				novatek,psy-name = "battery";
				novatek,swrst-n8-addr = <0x3f0fe>;
				novatek,spi-rd-fast-addr = <0x3f310>;
			};

			ilitek@1 {
				compatible = "tchip,ilitek";
				reg = <0x01>;
				status = "ok";
				touch,reset-gpio = <0xffffffff 0x03 0x00>;
				touch,irq-gpio = <0xffffffff 0x16 0x00>;
				touch,psy-name = "battery";
				ilitek,report_gesture_key;
				ilitek,supported_gesture_type = <0x06>;
			};

			focaltech@2 {
				compatible = "focaltech,fts";
				reg = <0x02>;
				status = "ok";
				spi-max-frequency = <0x5b8d80>;
				focaltech,reset-gpio = <0xffffffff 0x03 0x00>;
				focaltech,irq-gpio = <0xffffffff 0x16 0x00>;
				focaltech,max-touch-number = <0x0a>;
				focaltech,display-coords = <0x00 0x00 0x438 0x960>;
				focaltech,report_gesture_key = <0x3b>;
				focaltech,supported_gesture_type = <0x06>;
				focaltech,panel-supplier = "csot_ft8725";
				focaltech,touch-charger-detect-psy-name = "battery";
				focaltech,touch-charger-detect-psp = "POWER_SUPPLY_PROP_STATUS";
			};
		};
	};

	fragment@48 {
		target = <0xffffffff>;

		__overlay__ {

			pins_default {
				phandle = <0x54>;
			};

			spimode_default {
				phandle = <0x55>;

				pins_cmd_dat {
					pinmux = <0x4902 0x4a02 0x4b02 0x4c02>;
					drive-strength = <0x02>;
				};
			};
		};
	};

	fragment@49 {
		target = <0xffffffff>;

		__overlay__ {
			regulator-name = "mt6369_vio28";
			regulator-min-microvolt = <0x325aa0>;
			regulator-max-microvolt = <0x325aa0>;
			regulator-enable-ramp-delay = <0x780>;
		};
	};

	fragment@50 {
		target = <0xffffffff>;

		__overlay__ {
			mediatek,eye-vrt = <0x07>;
			mediatek,eye-term = <0x03>;
			mediatek,rev6 = <0x03>;
			mediatek,discth = <0x0f>;
		};
	};

	fragment@51 {
		target = <0xffffffff>;

		__overlay__ {

			pmic@4 {
				compatible = "mediatek,mt6363";
				reg = <0x04 0x00>;
				interrupts = <0x04>;
				#address-cells = <0x01>;
				#size-cells = <0x00>;
				interrupt-controller;
				#interrupt-cells = <0x02>;
				phandle = <0x75>;

				mtk-spmi-pmic-debug {
					compatible = "mediatek,spmi-pmic-debug";
				};

				mt6363-auxadc {
					compatible = "mediatek,mt6363-auxadc";
					#io-channel-cells = <0x01>;
					phandle = <0x56>;

					vin2_100k {
						channel = <0x14>;
						pures = <0x00>;
					};

					vin3_100k {
						channel = <0x15>;
						pures = <0x00>;
					};

					vin4_100k {
						channel = <0x16>;
						pures = <0x00>;
					};

					vin5_100k {
						channel = <0x17>;
						pures = <0x00>;
					};
				};
			};
		};
	};

	fragment@52 {
		target = <0xffffffff>;

		__overlay__ {
			compatible = "mediatek,mt6855-board-ntc";
			status = "okay";
			#thermal-sensor-cells = <0x00>;
			reg = <0x00 0x1c8050d4 0x00 0x04>;
			temperature-lookup-table = <0xffff63c0 0x43183f 0xffff67a8 0x3e73c9 0xffff6b90 0x3a2985 0xffff6f78 0x363204 0xffff7360 0x328683 0xffff7748 0x2f20d6 0xffff7b30 0x2bfb5b 0xffff7f18 0x2910ed 0xffff8300 0x265cd9 0xffff86e8 0x23dad1 0xffff8ad0 0x2186e9 0xffff8eb8 0x1f5d85 0xffff92a0 0x1d5b5b 0xffff9688 0x1b7d65 0xffff9a70 0x19c0dd 0xffff9e58 0x182338 0xffffa240 0x16a15b 0xffffa628 0x153a09 0xffffaa10 0x13eb44 0xffffadf8 0x12b33a 0xffffb1e0 0x11903c 0xffffb5c8 0x1080bf 0xffffb9b0 0xf8355 0xffffbd98 0xe96af 0xffffc180 0xdb998 0xffffc568 0xceaf2 0xffffc950 0xc29b7 0xffffcd38 0xb74f2 0xffffd120 0xacbc3 0xffffd508 0xa2d5c 0xffffd8f0 0x998fc 0xffffdcd8 0x90dbe 0xffffe0c0 0x88b3a 0xffffe4a8 0x810d9 0xffffe890 0x79e0c 0xffffec78 0x73250 0xfffff060 0x6cd4b 0xfffff448 0x66e67 0xfffff830 0x6153c 0xfffffc18 0x5c168 0x00 0x57293 0x3e8 0x52855 0x7d0 0x4e279 0xbb8 0x4a0b6 0xfa0 0x462c9 0x1388 0x42873 0x1770 0x3f17a 0x1b58 0x3bda8 0x1f40 0x38cc9 0x2328 0x35eaf 0x2710 0x3332e 0x2af8 0x30a1c 0x2ee0 0x2e354 0x32c8 0x2beb2 0x36b0 0x29c13 0x3a98 0x27b5b 0x3e80 0x25c66 0x4268 0x23f20 0x4650 0x2236e 0x4a38 0x20938 0x4e20 0x1f068 0x5208 0x1d8ea 0x55f0 0x1c2a8 0x59d8 0x1ad92 0x5dc0 0x19994 0x61a8 0x186a0 0x6590 0x174a6 0x6978 0x16398 0x6d60 0x15369 0x7148 0x1440c 0x7530 0x13576 0x7918 0x1279b 0x7d00 0x11a72 0x80e8 0x10df0 0x84d0 0x1020d 0x88b8 0xf6bf 0x8ca0 0xebff 0x9088 0xe1c5 0x9470 0xd80a 0x9858 0xcec6 0x9c40 0xc5f5 0xa028 0xbd90 0xa410 0xb592 0xa7f8 0xadf5 0xabe0 0xa6b3 0xafc8 0x9fc8 0xb3b0 0x992d 0xb798 0x92e1 0xbb80 0x8cdf 0xbf68 0x8723 0xc350 0x81ab 0xc738 0x7c73 0xcb20 0x7778 0xcf08 0x72b6 0xd2f0 0x6e2b 0xd6d8 0x69d3 0xdac0 0x65ac 0xdea8 0x61b5 0xe290 0x5dea 0xe678 0x5a49 0xea60 0x56d0 0xee48 0x537e 0xf230 0x5050 0xf618 0x4d46 0xfa00 0x4a5c 0xfde8 0x4792 0x101d0 0x44e8 0x105b8 0x425a 0x109a0 0x3fe8 0x10d88 0x3d8f 0x11170 0x3b50 0x11558 0x3927 0x11940 0x3714 0x11d28 0x3517 0x12110 0x332f 0x124f8 0x315b 0x128e0 0x2f9b 0x12cc8 0x2dec 0x130b0 0x2c4f 0x13498 0x2ac2 0x13880 0x2945 0x13c68 0x27d7 0x14050 0x2677 0x14438 0x2525 0x14820 0x23e0 0x14c08 0x22a8 0x14ff0 0x217c 0x153d8 0x205b 0x157c0 0x1f45 0x15ba8 0x1e3a 0x15f90 0x1d39 0x16378 0x1c42 0x16760 0x1b55 0x16b48 0x1a71 0x16f30 0x1994 0x17318 0x18c1 0x17700 0x17f4 0x17ae8 0x172e 0x17ed0 0x1670 0x182b8 0x15b9 0x186a0 0x1508 0x18a88 0x145e 0x18e70 0x13bb 0x19258 0x131d 0x19640 0x1285 0x19a28 0x11f2 0x19e10 0x1165 0x1a1f8 0x10dc 0x1a5e0 0x1058 0x1a9c8 0xfd9 0x1adb0 0xf5e 0x1b198 0xee8 0x1b580 0xe75 0x1b968 0xe07 0x1bd50 0xd9c 0x1c138 0xd34 0x1c520 0xcd1 0x1c908 0xc71 0x1ccf0 0xc15 0x1d0d8 0xbbb 0x1d4c0 0xb64 0x1d8a8 0xb10 0x1dc90 0xabf 0x1e078 0xa70 0x1e460 0xa24 0x1e848 0x9da>;
		};
	};

	fragment@53 {
		target = <0xffffffff>;

		__overlay__ {
			compatible = "mediatek,mt6855-board-ntc";
			status = "okay";
			#thermal-sensor-cells = <0x00>;
			reg = <0x00 0x1c8050d8 0x00 0x04>;
			temperature-lookup-table = <0xffff63c0 0x43183f 0xffff67a8 0x3e73c9 0xffff6b90 0x3a2985 0xffff6f78 0x363204 0xffff7360 0x328683 0xffff7748 0x2f20d6 0xffff7b30 0x2bfb5b 0xffff7f18 0x2910ed 0xffff8300 0x265cd9 0xffff86e8 0x23dad1 0xffff8ad0 0x2186e9 0xffff8eb8 0x1f5d85 0xffff92a0 0x1d5b5b 0xffff9688 0x1b7d65 0xffff9a70 0x19c0dd 0xffff9e58 0x182338 0xffffa240 0x16a15b 0xffffa628 0x153a09 0xffffaa10 0x13eb44 0xffffadf8 0x12b33a 0xffffb1e0 0x11903c 0xffffb5c8 0x1080bf 0xffffb9b0 0xf8355 0xffffbd98 0xe96af 0xffffc180 0xdb998 0xffffc568 0xceaf2 0xffffc950 0xc29b7 0xffffcd38 0xb74f2 0xffffd120 0xacbc3 0xffffd508 0xa2d5c 0xffffd8f0 0x998fc 0xffffdcd8 0x90dbe 0xffffe0c0 0x88b3a 0xffffe4a8 0x810d9 0xffffe890 0x79e0c 0xffffec78 0x73250 0xfffff060 0x6cd4b 0xfffff448 0x66e67 0xfffff830 0x6153c 0xfffffc18 0x5c168 0x00 0x57293 0x3e8 0x52855 0x7d0 0x4e279 0xbb8 0x4a0b6 0xfa0 0x462c9 0x1388 0x42873 0x1770 0x3f17a 0x1b58 0x3bda8 0x1f40 0x38cc9 0x2328 0x35eaf 0x2710 0x3332e 0x2af8 0x30a1c 0x2ee0 0x2e354 0x32c8 0x2beb2 0x36b0 0x29c13 0x3a98 0x27b5b 0x3e80 0x25c66 0x4268 0x23f20 0x4650 0x2236e 0x4a38 0x20938 0x4e20 0x1f068 0x5208 0x1d8ea 0x55f0 0x1c2a8 0x59d8 0x1ad92 0x5dc0 0x19994 0x61a8 0x186a0 0x6590 0x174a6 0x6978 0x16398 0x6d60 0x15369 0x7148 0x1440c 0x7530 0x13576 0x7918 0x1279b 0x7d00 0x11a72 0x80e8 0x10df0 0x84d0 0x1020d 0x88b8 0xf6bf 0x8ca0 0xebff 0x9088 0xe1c5 0x9470 0xd80a 0x9858 0xcec6 0x9c40 0xc5f5 0xa028 0xbd90 0xa410 0xb592 0xa7f8 0xadf5 0xabe0 0xa6b3 0xafc8 0x9fc8 0xb3b0 0x992d 0xb798 0x92e1 0xbb80 0x8cdf 0xbf68 0x8723 0xc350 0x81ab 0xc738 0x7c73 0xcb20 0x7778 0xcf08 0x72b6 0xd2f0 0x6e2b 0xd6d8 0x69d3 0xdac0 0x65ac 0xdea8 0x61b5 0xe290 0x5dea 0xe678 0x5a49 0xea60 0x56d0 0xee48 0x537e 0xf230 0x5050 0xf618 0x4d46 0xfa00 0x4a5c 0xfde8 0x4792 0x101d0 0x44e8 0x105b8 0x425a 0x109a0 0x3fe8 0x10d88 0x3d8f 0x11170 0x3b50 0x11558 0x3927 0x11940 0x3714 0x11d28 0x3517 0x12110 0x332f 0x124f8 0x315b 0x128e0 0x2f9b 0x12cc8 0x2dec 0x130b0 0x2c4f 0x13498 0x2ac2 0x13880 0x2945 0x13c68 0x27d7 0x14050 0x2677 0x14438 0x2525 0x14820 0x23e0 0x14c08 0x22a8 0x14ff0 0x217c 0x153d8 0x205b 0x157c0 0x1f45 0x15ba8 0x1e3a 0x15f90 0x1d39 0x16378 0x1c42 0x16760 0x1b55 0x16b48 0x1a71 0x16f30 0x1994 0x17318 0x18c1 0x17700 0x17f4 0x17ae8 0x172e 0x17ed0 0x1670 0x182b8 0x15b9 0x186a0 0x1508 0x18a88 0x145e 0x18e70 0x13bb 0x19258 0x131d 0x19640 0x1285 0x19a28 0x11f2 0x19e10 0x1165 0x1a1f8 0x10dc 0x1a5e0 0x1058 0x1a9c8 0xfd9 0x1adb0 0xf5e 0x1b198 0xee8 0x1b580 0xe75 0x1b968 0xe07 0x1bd50 0xd9c 0x1c138 0xd34 0x1c520 0xcd1 0x1c908 0xc71 0x1ccf0 0xc15 0x1d0d8 0xbbb 0x1d4c0 0xb64 0x1d8a8 0xb10 0x1dc90 0xabf 0x1e078 0xa70 0x1e460 0xa24 0x1e848 0x9da>;
		};
	};

	fragment@54 {
		target = <0xffffffff>;

		__overlay__ {
			compatible = "mediatek,mt6855-board-ntc";
			status = "okay";
			#thermal-sensor-cells = <0x00>;
			reg = <0x00 0x1c8050dc 0x00 0x04>;
			temperature-lookup-table = <0xffff63c0 0x43183f 0xffff67a8 0x3e73c9 0xffff6b90 0x3a2985 0xffff6f78 0x363204 0xffff7360 0x328683 0xffff7748 0x2f20d6 0xffff7b30 0x2bfb5b 0xffff7f18 0x2910ed 0xffff8300 0x265cd9 0xffff86e8 0x23dad1 0xffff8ad0 0x2186e9 0xffff8eb8 0x1f5d85 0xffff92a0 0x1d5b5b 0xffff9688 0x1b7d65 0xffff9a70 0x19c0dd 0xffff9e58 0x182338 0xffffa240 0x16a15b 0xffffa628 0x153a09 0xffffaa10 0x13eb44 0xffffadf8 0x12b33a 0xffffb1e0 0x11903c 0xffffb5c8 0x1080bf 0xffffb9b0 0xf8355 0xffffbd98 0xe96af 0xffffc180 0xdb998 0xffffc568 0xceaf2 0xffffc950 0xc29b7 0xffffcd38 0xb74f2 0xffffd120 0xacbc3 0xffffd508 0xa2d5c 0xffffd8f0 0x998fc 0xffffdcd8 0x90dbe 0xffffe0c0 0x88b3a 0xffffe4a8 0x810d9 0xffffe890 0x79e0c 0xffffec78 0x73250 0xfffff060 0x6cd4b 0xfffff448 0x66e67 0xfffff830 0x6153c 0xfffffc18 0x5c168 0x00 0x57293 0x3e8 0x52855 0x7d0 0x4e279 0xbb8 0x4a0b6 0xfa0 0x462c9 0x1388 0x42873 0x1770 0x3f17a 0x1b58 0x3bda8 0x1f40 0x38cc9 0x2328 0x35eaf 0x2710 0x3332e 0x2af8 0x30a1c 0x2ee0 0x2e354 0x32c8 0x2beb2 0x36b0 0x29c13 0x3a98 0x27b5b 0x3e80 0x25c66 0x4268 0x23f20 0x4650 0x2236e 0x4a38 0x20938 0x4e20 0x1f068 0x5208 0x1d8ea 0x55f0 0x1c2a8 0x59d8 0x1ad92 0x5dc0 0x19994 0x61a8 0x186a0 0x6590 0x174a6 0x6978 0x16398 0x6d60 0x15369 0x7148 0x1440c 0x7530 0x13576 0x7918 0x1279b 0x7d00 0x11a72 0x80e8 0x10df0 0x84d0 0x1020d 0x88b8 0xf6bf 0x8ca0 0xebff 0x9088 0xe1c5 0x9470 0xd80a 0x9858 0xcec6 0x9c40 0xc5f5 0xa028 0xbd90 0xa410 0xb592 0xa7f8 0xadf5 0xabe0 0xa6b3 0xafc8 0x9fc8 0xb3b0 0x992d 0xb798 0x92e1 0xbb80 0x8cdf 0xbf68 0x8723 0xc350 0x81ab 0xc738 0x7c73 0xcb20 0x7778 0xcf08 0x72b6 0xd2f0 0x6e2b 0xd6d8 0x69d3 0xdac0 0x65ac 0xdea8 0x61b5 0xe290 0x5dea 0xe678 0x5a49 0xea60 0x56d0 0xee48 0x537e 0xf230 0x5050 0xf618 0x4d46 0xfa00 0x4a5c 0xfde8 0x4792 0x101d0 0x44e8 0x105b8 0x425a 0x109a0 0x3fe8 0x10d88 0x3d8f 0x11170 0x3b50 0x11558 0x3927 0x11940 0x3714 0x11d28 0x3517 0x12110 0x332f 0x124f8 0x315b 0x128e0 0x2f9b 0x12cc8 0x2dec 0x130b0 0x2c4f 0x13498 0x2ac2 0x13880 0x2945 0x13c68 0x27d7 0x14050 0x2677 0x14438 0x2525 0x14820 0x23e0 0x14c08 0x22a8 0x14ff0 0x217c 0x153d8 0x205b 0x157c0 0x1f45 0x15ba8 0x1e3a 0x15f90 0x1d39 0x16378 0x1c42 0x16760 0x1b55 0x16b48 0x1a71 0x16f30 0x1994 0x17318 0x18c1 0x17700 0x17f4 0x17ae8 0x172e 0x17ed0 0x1670 0x182b8 0x15b9 0x186a0 0x1508 0x18a88 0x145e 0x18e70 0x13bb 0x19258 0x131d 0x19640 0x1285 0x19a28 0x11f2 0x19e10 0x1165 0x1a1f8 0x10dc 0x1a5e0 0x1058 0x1a9c8 0xfd9 0x1adb0 0xf5e 0x1b198 0xee8 0x1b580 0xe75 0x1b968 0xe07 0x1bd50 0xd9c 0x1c138 0xd34 0x1c520 0xcd1 0x1c908 0xc71 0x1ccf0 0xc15 0x1d0d8 0xbbb 0x1d4c0 0xb64 0x1d8a8 0xb10 0x1dc90 0xabf 0x1e078 0xa70 0x1e460 0xa24 0x1e848 0x9da>;
		};
	};

	fragment@55 {
		target = <0xffffffff>;

		__overlay__ {
			compatible = "mediatek,mt6855-board-ntc";
			status = "okay";
			#thermal-sensor-cells = <0x00>;
			io-channels = <0x56 0x14>;
			io-channel-names = "MD_Thermal_NTC";
			temperature-lookup-table = <0xffff63c0 0x43183f 0xffff67a8 0x3e73c9 0xffff6b90 0x3a2985 0xffff6f78 0x363204 0xffff7360 0x328683 0xffff7748 0x2f20d6 0xffff7b30 0x2bfb5b 0xffff7f18 0x2910ed 0xffff8300 0x265cd9 0xffff86e8 0x23dad1 0xffff8ad0 0x2186e9 0xffff8eb8 0x1f5d85 0xffff92a0 0x1d5b5b 0xffff9688 0x1b7d65 0xffff9a70 0x19c0dd 0xffff9e58 0x182338 0xffffa240 0x16a15b 0xffffa628 0x153a09 0xffffaa10 0x13eb44 0xffffadf8 0x12b33a 0xffffb1e0 0x11903c 0xffffb5c8 0x1080bf 0xffffb9b0 0xf8355 0xffffbd98 0xe96af 0xffffc180 0xdb998 0xffffc568 0xceaf2 0xffffc950 0xc29b7 0xffffcd38 0xb74f2 0xffffd120 0xacbc3 0xffffd508 0xa2d5c 0xffffd8f0 0x998fc 0xffffdcd8 0x90dbe 0xffffe0c0 0x88b3a 0xffffe4a8 0x810d9 0xffffe890 0x79e0c 0xffffec78 0x73250 0xfffff060 0x6cd4b 0xfffff448 0x66e67 0xfffff830 0x6153c 0xfffffc18 0x5c168 0x00 0x57293 0x3e8 0x52855 0x7d0 0x4e279 0xbb8 0x4a0b6 0xfa0 0x462c9 0x1388 0x42873 0x1770 0x3f17a 0x1b58 0x3bda8 0x1f40 0x38cc9 0x2328 0x35eaf 0x2710 0x3332e 0x2af8 0x30a1c 0x2ee0 0x2e354 0x32c8 0x2beb2 0x36b0 0x29c13 0x3a98 0x27b5b 0x3e80 0x25c66 0x4268 0x23f20 0x4650 0x2236e 0x4a38 0x20938 0x4e20 0x1f068 0x5208 0x1d8ea 0x55f0 0x1c2a8 0x59d8 0x1ad92 0x5dc0 0x19994 0x61a8 0x186a0 0x6590 0x174a6 0x6978 0x16398 0x6d60 0x15369 0x7148 0x1440c 0x7530 0x13576 0x7918 0x1279b 0x7d00 0x11a72 0x80e8 0x10df0 0x84d0 0x1020d 0x88b8 0xf6bf 0x8ca0 0xebff 0x9088 0xe1c5 0x9470 0xd80a 0x9858 0xcec6 0x9c40 0xc5f5 0xa028 0xbd90 0xa410 0xb592 0xa7f8 0xadf5 0xabe0 0xa6b3 0xafc8 0x9fc8 0xb3b0 0x992d 0xb798 0x92e1 0xbb80 0x8cdf 0xbf68 0x8723 0xc350 0x81ab 0xc738 0x7c73 0xcb20 0x7778 0xcf08 0x72b6 0xd2f0 0x6e2b 0xd6d8 0x69d3 0xdac0 0x65ac 0xdea8 0x61b5 0xe290 0x5dea 0xe678 0x5a49 0xea60 0x56d0 0xee48 0x537e 0xf230 0x5050 0xf618 0x4d46 0xfa00 0x4a5c 0xfde8 0x4792 0x101d0 0x44e8 0x105b8 0x425a 0x109a0 0x3fe8 0x10d88 0x3d8f 0x11170 0x3b50 0x11558 0x3927 0x11940 0x3714 0x11d28 0x3517 0x12110 0x332f 0x124f8 0x315b 0x128e0 0x2f9b 0x12cc8 0x2dec 0x130b0 0x2c4f 0x13498 0x2ac2 0x13880 0x2945 0x13c68 0x27d7 0x14050 0x2677 0x14438 0x2525 0x14820 0x23e0 0x14c08 0x22a8 0x14ff0 0x217c 0x153d8 0x205b 0x157c0 0x1f45 0x15ba8 0x1e3a 0x15f90 0x1d39 0x16378 0x1c42 0x16760 0x1b55 0x16b48 0x1a71 0x16f30 0x1994 0x17318 0x18c1 0x17700 0x17f4 0x17ae8 0x172e 0x17ed0 0x1670 0x182b8 0x15b9 0x186a0 0x1508 0x18a88 0x145e 0x18e70 0x13bb 0x19258 0x131d 0x19640 0x1285 0x19a28 0x11f2 0x19e10 0x1165 0x1a1f8 0x10dc 0x1a5e0 0x1058 0x1a9c8 0xfd9 0x1adb0 0xf5e 0x1b198 0xee8 0x1b580 0xe75 0x1b968 0xe07 0x1bd50 0xd9c 0x1c138 0xd34 0x1c520 0xcd1 0x1c908 0xc71 0x1ccf0 0xc15 0x1d0d8 0xbbb 0x1d4c0 0xb64 0x1d8a8 0xb10 0x1dc90 0xabf 0x1e078 0xa70 0x1e460 0xa24 0x1e848 0x9da>;
		};
	};

	fragment@56 {
		target = <0xffffffff>;

		__overlay__ {
			compatible = "mediatek,mt6855-board-ntc";
			status = "okay";
			#thermal-sensor-cells = <0x00>;
			io-channels = <0x56 0x15>;
			io-channel-names = "Charger_NTC";
			temperature-lookup-table = <0xffff63c0 0x43183f 0xffff67a8 0x3e73c9 0xffff6b90 0x3a2985 0xffff6f78 0x363204 0xffff7360 0x328683 0xffff7748 0x2f20d6 0xffff7b30 0x2bfb5b 0xffff7f18 0x2910ed 0xffff8300 0x265cd9 0xffff86e8 0x23dad1 0xffff8ad0 0x2186e9 0xffff8eb8 0x1f5d85 0xffff92a0 0x1d5b5b 0xffff9688 0x1b7d65 0xffff9a70 0x19c0dd 0xffff9e58 0x182338 0xffffa240 0x16a15b 0xffffa628 0x153a09 0xffffaa10 0x13eb44 0xffffadf8 0x12b33a 0xffffb1e0 0x11903c 0xffffb5c8 0x1080bf 0xffffb9b0 0xf8355 0xffffbd98 0xe96af 0xffffc180 0xdb998 0xffffc568 0xceaf2 0xffffc950 0xc29b7 0xffffcd38 0xb74f2 0xffffd120 0xacbc3 0xffffd508 0xa2d5c 0xffffd8f0 0x998fc 0xffffdcd8 0x90dbe 0xffffe0c0 0x88b3a 0xffffe4a8 0x810d9 0xffffe890 0x79e0c 0xffffec78 0x73250 0xfffff060 0x6cd4b 0xfffff448 0x66e67 0xfffff830 0x6153c 0xfffffc18 0x5c168 0x00 0x57293 0x3e8 0x52855 0x7d0 0x4e279 0xbb8 0x4a0b6 0xfa0 0x462c9 0x1388 0x42873 0x1770 0x3f17a 0x1b58 0x3bda8 0x1f40 0x38cc9 0x2328 0x35eaf 0x2710 0x3332e 0x2af8 0x30a1c 0x2ee0 0x2e354 0x32c8 0x2beb2 0x36b0 0x29c13 0x3a98 0x27b5b 0x3e80 0x25c66 0x4268 0x23f20 0x4650 0x2236e 0x4a38 0x20938 0x4e20 0x1f068 0x5208 0x1d8ea 0x55f0 0x1c2a8 0x59d8 0x1ad92 0x5dc0 0x19994 0x61a8 0x186a0 0x6590 0x174a6 0x6978 0x16398 0x6d60 0x15369 0x7148 0x1440c 0x7530 0x13576 0x7918 0x1279b 0x7d00 0x11a72 0x80e8 0x10df0 0x84d0 0x1020d 0x88b8 0xf6bf 0x8ca0 0xebff 0x9088 0xe1c5 0x9470 0xd80a 0x9858 0xcec6 0x9c40 0xc5f5 0xa028 0xbd90 0xa410 0xb592 0xa7f8 0xadf5 0xabe0 0xa6b3 0xafc8 0x9fc8 0xb3b0 0x992d 0xb798 0x92e1 0xbb80 0x8cdf 0xbf68 0x8723 0xc350 0x81ab 0xc738 0x7c73 0xcb20 0x7778 0xcf08 0x72b6 0xd2f0 0x6e2b 0xd6d8 0x69d3 0xdac0 0x65ac 0xdea8 0x61b5 0xe290 0x5dea 0xe678 0x5a49 0xea60 0x56d0 0xee48 0x537e 0xf230 0x5050 0xf618 0x4d46 0xfa00 0x4a5c 0xfde8 0x4792 0x101d0 0x44e8 0x105b8 0x425a 0x109a0 0x3fe8 0x10d88 0x3d8f 0x11170 0x3b50 0x11558 0x3927 0x11940 0x3714 0x11d28 0x3517 0x12110 0x332f 0x124f8 0x315b 0x128e0 0x2f9b 0x12cc8 0x2dec 0x130b0 0x2c4f 0x13498 0x2ac2 0x13880 0x2945 0x13c68 0x27d7 0x14050 0x2677 0x14438 0x2525 0x14820 0x23e0 0x14c08 0x22a8 0x14ff0 0x217c 0x153d8 0x205b 0x157c0 0x1f45 0x15ba8 0x1e3a 0x15f90 0x1d39 0x16378 0x1c42 0x16760 0x1b55 0x16b48 0x1a71 0x16f30 0x1994 0x17318 0x18c1 0x17700 0x17f4 0x17ae8 0x172e 0x17ed0 0x1670 0x182b8 0x15b9 0x186a0 0x1508 0x18a88 0x145e 0x18e70 0x13bb 0x19258 0x131d 0x19640 0x1285 0x19a28 0x11f2 0x19e10 0x1165 0x1a1f8 0x10dc 0x1a5e0 0x1058 0x1a9c8 0xfd9 0x1adb0 0xf5e 0x1b198 0xee8 0x1b580 0xe75 0x1b968 0xe07 0x1bd50 0xd9c 0x1c138 0xd34 0x1c520 0xcd1 0x1c908 0xc71 0x1ccf0 0xc15 0x1d0d8 0xbbb 0x1d4c0 0xb64 0x1d8a8 0xb10 0x1dc90 0xabf 0x1e078 0xa70 0x1e460 0xa24 0x1e848 0x9da>;
		};
	};

	fragment@57 {
		target = <0xffffffff>;

		__overlay__ {
			compatible = "mediatek,mt6855-board-ntc";
			status = "okay";
			#thermal-sensor-cells = <0x00>;
			io-channels = <0x56 0x16>;
			io-channel-names = "Flash_LED_NTC";
			temperature-lookup-table = <0xffff63c0 0x43183f 0xffff67a8 0x3e73c9 0xffff6b90 0x3a2985 0xffff6f78 0x363204 0xffff7360 0x328683 0xffff7748 0x2f20d6 0xffff7b30 0x2bfb5b 0xffff7f18 0x2910ed 0xffff8300 0x265cd9 0xffff86e8 0x23dad1 0xffff8ad0 0x2186e9 0xffff8eb8 0x1f5d85 0xffff92a0 0x1d5b5b 0xffff9688 0x1b7d65 0xffff9a70 0x19c0dd 0xffff9e58 0x182338 0xffffa240 0x16a15b 0xffffa628 0x153a09 0xffffaa10 0x13eb44 0xffffadf8 0x12b33a 0xffffb1e0 0x11903c 0xffffb5c8 0x1080bf 0xffffb9b0 0xf8355 0xffffbd98 0xe96af 0xffffc180 0xdb998 0xffffc568 0xceaf2 0xffffc950 0xc29b7 0xffffcd38 0xb74f2 0xffffd120 0xacbc3 0xffffd508 0xa2d5c 0xffffd8f0 0x998fc 0xffffdcd8 0x90dbe 0xffffe0c0 0x88b3a 0xffffe4a8 0x810d9 0xffffe890 0x79e0c 0xffffec78 0x73250 0xfffff060 0x6cd4b 0xfffff448 0x66e67 0xfffff830 0x6153c 0xfffffc18 0x5c168 0x00 0x57293 0x3e8 0x52855 0x7d0 0x4e279 0xbb8 0x4a0b6 0xfa0 0x462c9 0x1388 0x42873 0x1770 0x3f17a 0x1b58 0x3bda8 0x1f40 0x38cc9 0x2328 0x35eaf 0x2710 0x3332e 0x2af8 0x30a1c 0x2ee0 0x2e354 0x32c8 0x2beb2 0x36b0 0x29c13 0x3a98 0x27b5b 0x3e80 0x25c66 0x4268 0x23f20 0x4650 0x2236e 0x4a38 0x20938 0x4e20 0x1f068 0x5208 0x1d8ea 0x55f0 0x1c2a8 0x59d8 0x1ad92 0x5dc0 0x19994 0x61a8 0x186a0 0x6590 0x174a6 0x6978 0x16398 0x6d60 0x15369 0x7148 0x1440c 0x7530 0x13576 0x7918 0x1279b 0x7d00 0x11a72 0x80e8 0x10df0 0x84d0 0x1020d 0x88b8 0xf6bf 0x8ca0 0xebff 0x9088 0xe1c5 0x9470 0xd80a 0x9858 0xcec6 0x9c40 0xc5f5 0xa028 0xbd90 0xa410 0xb592 0xa7f8 0xadf5 0xabe0 0xa6b3 0xafc8 0x9fc8 0xb3b0 0x992d 0xb798 0x92e1 0xbb80 0x8cdf 0xbf68 0x8723 0xc350 0x81ab 0xc738 0x7c73 0xcb20 0x7778 0xcf08 0x72b6 0xd2f0 0x6e2b 0xd6d8 0x69d3 0xdac0 0x65ac 0xdea8 0x61b5 0xe290 0x5dea 0xe678 0x5a49 0xea60 0x56d0 0xee48 0x537e 0xf230 0x5050 0xf618 0x4d46 0xfa00 0x4a5c 0xfde8 0x4792 0x101d0 0x44e8 0x105b8 0x425a 0x109a0 0x3fe8 0x10d88 0x3d8f 0x11170 0x3b50 0x11558 0x3927 0x11940 0x3714 0x11d28 0x3517 0x12110 0x332f 0x124f8 0x315b 0x128e0 0x2f9b 0x12cc8 0x2dec 0x130b0 0x2c4f 0x13498 0x2ac2 0x13880 0x2945 0x13c68 0x27d7 0x14050 0x2677 0x14438 0x2525 0x14820 0x23e0 0x14c08 0x22a8 0x14ff0 0x217c 0x153d8 0x205b 0x157c0 0x1f45 0x15ba8 0x1e3a 0x15f90 0x1d39 0x16378 0x1c42 0x16760 0x1b55 0x16b48 0x1a71 0x16f30 0x1994 0x17318 0x18c1 0x17700 0x17f4 0x17ae8 0x172e 0x17ed0 0x1670 0x182b8 0x15b9 0x186a0 0x1508 0x18a88 0x145e 0x18e70 0x13bb 0x19258 0x131d 0x19640 0x1285 0x19a28 0x11f2 0x19e10 0x1165 0x1a1f8 0x10dc 0x1a5e0 0x1058 0x1a9c8 0xfd9 0x1adb0 0xf5e 0x1b198 0xee8 0x1b580 0xe75 0x1b968 0xe07 0x1bd50 0xd9c 0x1c138 0xd34 0x1c520 0xcd1 0x1c908 0xc71 0x1ccf0 0xc15 0x1d0d8 0xbbb 0x1d4c0 0xb64 0x1d8a8 0xb10 0x1dc90 0xabf 0x1e078 0xa70 0x1e460 0xa24 0x1e848 0x9da>;
		};
	};

	fragment@58 {
		target = <0xffffffff>;

		__overlay__ {
			status = "disabled";
		};
	};

	fragment@59 {
		target = <0xffffffff>;

		__overlay__ {
			mmi,temperature-names = "FRONT_TEMP";
		};
	};

	fragment@60 {
		target = <0xffffffff>;

		__overlay__ {

			pa_therm1 {
				polling-delay = <0x00>;
				polling-delay-passive = <0x00>;
				thermal-sensors = <0xffffffff>;
				phandle = <0x76>;
			};

			nrpa_ntc {
				polling-delay = <0x00>;
				polling-delay-passive = <0x00>;
				thermal-sensors = <0xffffffff>;
				phandle = <0x77>;
			};

			emmc_therm {
				polling-delay = <0x00>;
				polling-delay-passive = <0x00>;
				thermal-sensors = <0xffffffff>;
			};

			chg_ntc {
				polling-delay = <0x00>;
				polling-delay-passive = <0x00>;
				thermal-sensors = <0xffffffff>;
			};

			mtktsflashlight {
				polling-delay = <0x00>;
				polling-delay-passive = <0x00>;
				thermal-sensors = <0xffffffff>;
			};
		};
	};

	fragment@model {
		target-path = "/";

		__overlay__ {
			mot,model = "cancunf";
			mot,board-id = <0x444 0xa100>;
		};
	};

	fragment@61 {
		target = <0xffffffff>;

		__overlay__ {
			GPIO_FDD_BAND_SUPPORT_DETECT_3RD_PIN = <0xffffffff 0x05 0x00>;
			GPIO_SIM1_HOT_PLUG = <0xffffffff 0x33 0x00>;
			GPIO_SIM2_HOT_PLUG = <0xffffffff 0x34 0x00>;
			GPIO_SIM1_SCLK = <0xffffffff 0x58 0x00>;
			GPIO_SIM1_SRST = <0xffffffff 0x59 0x00>;
			GPIO_SIM1_SIO = <0xffffffff 0x5a 0x00>;
			GPIO_SIM2_SCLK = <0xffffffff 0x5b 0x00>;
			GPIO_SIM2_SRST = <0xffffffff 0x5c 0x00>;
			GPIO_SIM2_SIO = <0xffffffff 0x5d 0x00>;
			GPIO_FDD_BAND_SUPPORT_DETECT_1ST_PIN = <0xffffffff 0xb7 0x00>;
		};
	};

	fragment@62 {
		target = <0xffffffff>;

		__overlay__ {
			gpio_init_default = <0x00 0x00 0x00 0x00 0x01 0x01 0x01 0x01 0x00 0x01 0x00 0x01 0x00 0x01 0x02 0x00 0x00 0x00 0x01 0x00 0x01 0x03 0x00 0x01 0x01 0x00 0x00 0x01 0x04 0x00 0x01 0x00 0x01 0x00 0x01 0x05 0x00 0x00 0x00 0x00 0x00 0x01 0x06 0x01 0x01 0x00 0x00 0x00 0x00 0x07 0x00 0x00 0x00 0x01 0x01 0x01 0x08 0x06 0x00 0x00 0x01 0x00 0x01 0x09 0x01 0x01 0x00 0x00 0x00 0x00 0x0a 0x01 0x01 0x00 0x00 0x00 0x00 0x0b 0x01 0x01 0x00 0x00 0x00 0x00 0x0c 0x01 0x01 0x00 0x00 0x00 0x00 0x0d 0x00 0x00 0x00 0x01 0x01 0x01 0x0e 0x00 0x00 0x00 0x01 0x01 0x01 0x0f 0x00 0x00 0x00 0x01 0x00 0x01 0x10 0x00 0x00 0x00 0x01 0x00 0x01 0x11 0x00 0x00 0x00 0x01 0x01 0x01 0x12 0x00 0x00 0x00 0x01 0x00 0x01 0x13 0x00 0x00 0x00 0x01 0x01 0x01 0x14 0x01 0x01 0x00 0x00 0x00 0x00 0x15 0x00 0x01 0x00 0x01 0x00 0x01 0x16 0x00 0x00 0x00 0x01 0x00 0x01 0x17 0x00 0x01 0x00 0x01 0x00 0x01 0x18 0x00 0x01 0x00 0x01 0x00 0x00 0x19 0x01 0x01 0x00 0x00 0x00 0x00 0x1a 0x01 0x00 0x00 0x00 0x00 0x00 0x1b 0x00 0x00 0x00 0x01 0x00 0x01 0x1c 0x00 0x00 0x00 0x01 0x00 0x01 0x1d 0x01 0x01 0x00 0x00 0x00 0x00 0x1e 0x00 0x01 0x00 0x01 0x00 0x01 0x1f 0x01 0x01 0x00 0x00 0x00 0x00 0x20 0x01 0x01 0x00 0x00 0x00 0x00 0x21 0x00 0x00 0x00 0x01 0x00 0x01 0x22 0x00 0x00 0x00 0x01 0x00 0x01 0x23 0x03 0x00 0x00 0x01 0x01 0x01 0x24 0x03 0x00 0x00 0x00 0x00 0x01 0x25 0x03 0x00 0x00 0x00 0x00 0x01 0x26 0x00 0x01 0x00 0x01 0x00 0x01 0x27 0x00 0x00 0x00 0x01 0x01 0x01 0x28 0x00 0x00 0x00 0x01 0x01 0x01 0x29 0x00 0x00 0x00 0x01 0x01 0x01 0x2a 0x01 0x00 0x00 0x00 0x00 0x01 0x2b 0x01 0x01 0x00 0x00 0x00 0x01 0x2c 0x01 0x01 0x00 0x00 0x00 0x01 0x2d 0x00 0x00 0x00 0x01 0x01 0x01 0x2e 0x00 0x00 0x00 0x01 0x01 0x01 0x2f 0x01 0x00 0x00 0x00 0x00 0x01 0x30 0x01 0x00 0x00 0x00 0x00 0x01 0x31 0x01 0x00 0x00 0x00 0x00 0x01 0x32 0x03 0x00 0x00 0x01 0x00 0x01 0x33 0x01 0x00 0x00 0x01 0x01 0x01 0x34 0x01 0x00 0x00 0x01 0x01 0x01 0x35 0x01 0x00 0x00 0x00 0x00 0x01 0x36 0x01 0x00 0x00 0x01 0x01 0x01 0x37 0x01 0x00 0x00 0x00 0x00 0x01 0x38 0x01 0x00 0x00 0x01 0x01 0x01 0x39 0x01 0x00 0x00 0x01 0x00 0x01 0x3a 0x00 0x01 0x00 0x01 0x00 0x01 0x3b 0x01 0x00 0x00 0x01 0x01 0x01 0x3c 0x07 0x00 0x00 0x01 0x00 0x01 0x3d 0x07 0x00 0x00 0x01 0x00 0x01 0x3e 0x07 0x00 0x00 0x01 0x00 0x01 0x3f 0x07 0x00 0x00 0x00 0x00 0x01 0x40 0x07 0x00 0x00 0x01 0x00 0x01 0x41 0x02 0x00 0x00 0x00 0x00 0x01 0x42 0x02 0x00 0x00 0x01 0x01 0x01 0x43 0x02 0x00 0x00 0x00 0x00 0x01 0x44 0x02 0x00 0x00 0x01 0x00 0x01 0x45 0x01 0x00 0x00 0x00 0x00 0x01 0x46 0x01 0x00 0x00 0x00 0x00 0x01 0x47 0x01 0x00 0x00 0x00 0x00 0x01 0x48 0x01 0x00 0x00 0x01 0x00 0x01 0x49 0x02 0x01 0x00 0x00 0x00 0x01 0x4a 0x02 0x01 0x01 0x00 0x00 0x01 0x4b 0x02 0x01 0x00 0x00 0x00 0x01 0x4c 0x02 0x00 0x00 0x01 0x00 0x01 0x4d 0x01 0x00 0x00 0x00 0x00 0x01 0x4e 0x01 0x00 0x00 0x00 0x00 0x01 0x4f 0x01 0x00 0x00 0x00 0x00 0x01 0x50 0x01 0x00 0x00 0x01 0x00 0x01 0x52 0x01 0x00 0x00 0x00 0x00 0x01 0x53 0x01 0x00 0x00 0x01 0x01 0x01 0x54 0x01 0x00 0x00 0x01 0x01 0x01 0x55 0x01 0x00 0x00 0x01 0x01 0x01 0x56 0x01 0x00 0x00 0x01 0x01 0x01 0x57 0x01 0x00 0x00 0x01 0x01 0x01 0x58 0x01 0x00 0x00 0x00 0x00 0x01 0x59 0x01 0x00 0x00 0x00 0x00 0x01 0x5a 0x01 0x00 0x00 0x01 0x01 0x01 0x5b 0x01 0x00 0x00 0x00 0x00 0x01 0x5c 0x01 0x00 0x00 0x00 0x00 0x01 0x5d 0x01 0x00 0x00 0x01 0x01 0x01 0x5e 0x01 0x00 0x00 0x01 0x00 0x01 0x5f 0x01 0x00 0x00 0x00 0x00 0x01 0x60 0x01 0x00 0x00 0x00 0x00 0x01 0x61 0x01 0x01 0x00 0x00 0x00 0x00 0x62 0x01 0x00 0x00 0x01 0x00 0x01 0x63 0x01 0x01 0x00 0x00 0x00 0x00 0x64 0x01 0x01 0x00 0x00 0x00 0x00 0x65 0x00 0x00 0x00 0x00 0x00 0x01 0x66 0x00 0x00 0x00 0x00 0x00 0x01 0x67 0x01 0x00 0x00 0x01 0x00 0x01 0x68 0x01 0x00 0x00 0x01 0x00 0x01 0x69 0x01 0x00 0x00 0x00 0x00 0x01 0x6a 0x01 0x00 0x00 0x00 0x00 0x01 0x6b 0x01 0x00 0x00 0x00 0x00 0x01 0x6c 0x01 0x00 0x00 0x00 0x00 0x01 0x6d 0x01 0x00 0x00 0x00 0x00 0x01 0x6e 0x01 0x00 0x00 0x00 0x00 0x01 0x6f 0x01 0x00 0x00 0x00 0x00 0x01 0x70 0x01 0x00 0x00 0x00 0x00 0x01 0x71 0x01 0x00 0x00 0x00 0x00 0x01 0x72 0x01 0x00 0x00 0x00 0x00 0x01 0x73 0x01 0x00 0x00 0x00 0x00 0x01 0x74 0x01 0x00 0x00 0x00 0x00 0x01 0x75 0x01 0x00 0x00 0x00 0x00 0x01 0x76 0x01 0x00 0x00 0x00 0x00 0x01 0x77 0x01 0x00 0x00 0x00 0x00 0x01 0x78 0x01 0x00 0x00 0x00 0x00 0x01 0x79 0x01 0x00 0x00 0x00 0x00 0x01 0x7a 0x01 0x00 0x00 0x00 0x00 0x01 0x7b 0x01 0x00 0x00 0x00 0x00 0x01 0x7c 0x01 0x00 0x00 0x00 0x00 0x01 0x7d 0x01 0x00 0x00 0x00 0x00 0x01 0x7e 0x01 0x00 0x00 0x00 0x00 0x01 0x7f 0x01 0x00 0x00 0x00 0x00 0x00 0x80 0x01 0x00 0x00 0x01 0x00 0x00 0x81 0x01 0x00 0x00 0x00 0x00 0x00 0x82 0x01 0x00 0x00 0x01 0x00 0x00 0x83 0x01 0x00 0x00 0x00 0x00 0x00 0x84 0x01 0x00 0x00 0x01 0x00 0x00 0x85 0x03 0x00 0x00 0x01 0x00 0x01 0x86 0x03 0x00 0x00 0x01 0x00 0x01 0x87 0x01 0x00 0x00 0x01 0x00 0x01 0x88 0x01 0x00 0x00 0x01 0x00 0x01 0x89 0x01 0x00 0x00 0x01 0x01 0x01 0x8a 0x01 0x00 0x00 0x01 0x01 0x01 0x8b 0x02 0x00 0x00 0x01 0x01 0x01 0x8c 0x02 0x00 0x00 0x01 0x01 0x01 0x8d 0x01 0x00 0x00 0x01 0x01 0x01 0x8e 0x01 0x00 0x00 0x01 0x01 0x01 0x8f 0x01 0x00 0x00 0x01 0x01 0x01 0x90 0x01 0x00 0x00 0x01 0x01 0x01 0x91 0x01 0x00 0x00 0x01 0x01 0x01 0x92 0x01 0x00 0x00 0x01 0x01 0x01 0x93 0x01 0x00 0x00 0x01 0x01 0x01 0x94 0x01 0x00 0x00 0x01 0x01 0x01 0x95 0x01 0x00 0x00 0x01 0x01 0x01 0x96 0x01 0x00 0x00 0x01 0x01 0x01 0x97 0x01 0x00 0x00 0x01 0x01 0x01 0x98 0x01 0x00 0x00 0x01 0x01 0x01 0x99 0x01 0x00 0x00 0x01 0x01 0x01 0x9a 0x01 0x00 0x00 0x01 0x01 0x01 0x9b 0x01 0x00 0x00 0x01 0x01 0x01 0x9c 0x01 0x00 0x00 0x01 0x01 0x01 0x9d 0x00 0x01 0x00 0x01 0x00 0x01 0x9e 0x00 0x01 0x00 0x01 0x00 0x01 0x9f 0x00 0x01 0x00 0x01 0x00 0x01 0xa0 0x03 0x00 0x00 0x01 0x00 0x01 0xa1 0x00 0x01 0x00 0x01 0x00 0x01 0xa2 0x00 0x01 0x00 0x01 0x00 0x01 0xa3 0x01 0x00 0x00 0x00 0x00 0x01 0xa4 0x01 0x00 0x00 0x00 0x00 0x01 0xa5 0x01 0x00 0x00 0x00 0x00 0x01 0xa6 0x01 0x00 0x00 0x00 0x00 0x01 0xa7 0x01 0x00 0x00 0x00 0x00 0x01 0xa8 0x01 0x00 0x00 0x00 0x00 0x01 0xa9 0x01 0x00 0x00 0x00 0x00 0x01 0xaa 0x01 0x00 0x00 0x01 0x00 0x01 0xab 0x01 0x00 0x00 0x00 0x00 0x01 0xac 0x01 0x00 0x00 0x00 0x00 0x01 0xad 0x01 0x00 0x00 0x00 0x00 0x01 0xae 0x01 0x00 0x00 0x00 0x00 0x01 0xaf 0x01 0x00 0x00 0x00 0x00 0x01 0xb0 0x01 0x00 0x00 0x00 0x00 0x01 0xb1 0x01 0x00 0x00 0x00 0x00 0x01 0xb2 0x01 0x00 0x00 0x00 0x00 0x01 0xb3 0x01 0x00 0x00 0x01 0x00 0x01 0xb4 0x01 0x00 0x00 0x01 0x00 0x01 0xb5 0x01 0x00 0x00 0x01 0x00 0x01 0xb6 0x00 0x01 0x00 0x01 0x00 0x01 0xb7 0x00 0x00 0x00 0x00 0x00 0x01 0xb8 0x00 0x00 0x00 0x01 0x00 0x01 0xb9 0x00 0x00 0x00 0x01 0x00 0x01 0xba 0x00 0x00 0x00 0x01 0x00 0x01 0xbb 0x00 0x00 0x00 0x01 0x00 0x01 0xbc 0x00 0x00 0x00 0x01 0x00 0x01 0xbd 0x00 0x00 0x00 0x01 0x00 0x01 0xbe 0x00 0x00 0x00 0x01 0x00 0x01 0xbf 0x00 0x00 0x00 0x01 0x00 0x01 0xc0 0x00 0x00 0x00 0x01 0x00 0x01 0xc1 0x01 0x00 0x00 0x00 0x00 0x01 0xc2 0x00 0x01 0x00 0x01 0x00 0x01 0xc3 0x00 0x01 0x00 0x01 0x00 0x01 0xc4 0x01 0x00 0x00 0x01 0x01 0x01 0xc5 0x01 0x00 0x00 0x00 0x00 0x01 0xc6 0x01 0x00 0x00 0x01 0x01 0x01 0xc7 0x00 0x01 0x00 0x01 0x00 0x01 0xc8 0x01 0x00 0x00 0x01 0x01 0x01 0xc9 0x01 0x00 0x00 0x01 0x01 0x01 0xca 0x01 0x00 0x00 0x01 0x01 0x01 0xcb 0x00 0x01 0x00 0x01 0x00 0x01 0xcc 0x01 0x00 0x00 0x01 0x01 0x01 0xcd 0x00 0x01 0x00 0x01 0x00 0x01 0xce 0x00 0x00 0x00 0x01 0x00 0x00 0xcf 0x00 0x00 0x00 0x01 0x00 0x00 0xd0 0x00 0x00 0x00 0x01 0x00 0x00 0xd1 0x00 0x00 0x00 0x01 0x00 0x00 0xd2 0x00 0x00 0x00 0x01 0x00 0x00 0xd3 0x00 0x00 0x00 0x01 0x00 0x00 0xd4 0x00 0x00 0x00 0x01 0x00 0x00 0xd5 0x00 0x00 0x00 0x01 0x00 0x00 0xd6 0x00 0x00 0x00 0x01 0x00 0x00 0xd7 0x00 0x00 0x00 0x01 0x00 0x00 0xd8 0x00 0x00 0x00 0x01 0x00 0x00 0xd9 0x00 0x00 0x00 0x01 0x00 0x00 0xda 0x00 0x00 0x00 0x01 0x00 0x00 0xdb 0x00 0x00 0x00 0x01 0x00 0x00 0xdc 0x00 0x00 0x00 0x01 0x00 0x00 0xdd 0x00 0x00 0x00 0x01 0x00 0x00 0xde 0x00 0x00 0x00 0x01 0x00 0x00 0xdf 0x00 0x00 0x00 0x01 0x00 0x00 0xe0 0x00 0x00 0x00 0x01 0x00 0x00 0xe1 0x00 0x00 0x00 0x01 0x00 0x00>;
		};
	};

	fragment@63 {
		target = <0xffffffff>;

		__overlay__ {
			interrupt-parent = <0xffffffff>;
			interrupts = <0x07 0x08>;
			status = "okay";
		};
	};

	fragment@64 {
		target = <0xffffffff>;

		__overlay__ {
			interrupt-parent = <0xffffffff>;
			interrupts = <0x0d 0x08>;
			deb-gpios = <0xffffffff 0x0d 0x00>;
			debounce = <0x7d000>;
			status = "okay";
		};
	};

	fragment@65 {
		target = <0xffffffff>;

		__overlay__ {
			interrupt-parent = <0xffffffff>;
			interrupts = <0x16 0x02>;
			status = "okay";
		};
	};

	fragment@66 {
		target = <0xffffffff>;

		__overlay__ {
			interrupt-parent = <0xffffffff>;
			interrupts = <0x17 0x02>;
			status = "okay";
		};
	};

	fragment@67 {
		target = <0xffffffff>;

		__overlay__ {
			interrupt-parent = <0xffffffff>;
			interrupts = <0x27 0x04>;
			deb-gpios = <0xffffffff 0x27 0x00>;
			debounce = <0x7d000>;
			status = "okay";
		};
	};

	fragment@68 {
		target = <0xffffffff>;

		__overlay__ {
			interrupt-parent = <0xffffffff>;
			interrupts = <0x28 0x04>;
			deb-gpios = <0xffffffff 0x28 0x00>;
			debounce = <0x7d000>;
			status = "okay";
		};
	};

	fragment@69 {
		target = <0xffffffff>;

		__overlay__ {
			interrupt-parent = <0xffffffff>;
			interrupts = <0x29 0x04>;
			deb-gpios = <0xffffffff 0x29 0x00>;
			debounce = <0x7d000>;
			status = "okay";
		};
	};

	fragment@70 {
		target = <0xffffffff>;

		__overlay__ {
			interrupt-parent = <0xffffffff>;
			interrupts = <0x2d 0x04>;
			deb-gpios = <0xffffffff 0x2d 0x00>;
			debounce = <0x7d000>;
			status = "okay";
		};
	};

	fragment@71 {
		target = <0xffffffff>;

		__overlay__ {
			interrupt-parent = <0xffffffff>;
			interrupts = <0x2e 0x08>;
			status = "okay";
		};
	};

	fragment@72 {
		target = <0xffffffff>;

		__overlay__ {
			interrupt-parent = <0xffffffff>;
			interrupts = <0x5e 0x01>;
			status = "okay";
		};
	};

	fragment@73 {
		target = <0xffffffff>;

		__overlay__ {
			compatible = "mediatek,md1_sim1_hot_plug_eint-eint";
			interrupts = <0x00 0x08>;
			debounce = <0x00 0x2710>;
			dedicated = <0x00 0x00>;
			src_pin = <0x00 0x01>;
			sockettype = <0x00 0x00>;
			status = "okay";
		};
	};

	fragment@74 {
		target = <0xffffffff>;

		__overlay__ {
			compatible = "mediatek,md1_sim2_hot_plug_eint-eint";
			interrupts = <0x01 0x08>;
			debounce = <0x01 0x2710>;
			dedicated = <0x01 0x00>;
			src_pin = <0x01 0x02>;
			sockettype = <0x01 0x00>;
			status = "okay";
		};
	};

	fragment@75 {
		target = <0xffffffff>;

		__overlay__ {
			mediatek,key-debounce = <0x400>;
			mediatek,sw-pwrkey = <0x74>;
			mediatek,hw-pwrkey = <0x08>;
			mediatek,sw-rstkey = <0x72>;
			mediatek,hw-rstkey = <0x11>;
			mediatek,use-extend-type = <0x00>;
			mediatek,hw-map-num = <0x48>;
			mediatek,hw-init-map = <0x73 0x00 0x00 0x00 0x00 0x00 0x00 0x00 0x00 0x00 0x00 0x00 0x00 0x00 0x00 0x00 0x00 0x00 0x00 0x00 0x00 0x00 0x00 0x00 0x00 0x00 0x00 0x00 0x00 0x00 0x00 0x00 0x00 0x00 0x00 0x00 0x00 0x00 0x00 0x00 0x00 0x00 0x00 0x00 0x00 0x00 0x00 0x00 0x00 0x00 0x00 0x00 0x00 0x00 0x00 0x00 0x00 0x00 0x00 0x00 0x00 0x00 0x00 0x00 0x00 0x00 0x00 0x00 0x00 0x00 0x00 0x00>;
			mediatek,pwrkey-eint-gpio = <0x00>;
			mediatek,pwkey-gpio-din = <0x00>;
			mediatek,hw-dl-key0 = <0x00>;
			mediatek,hw-dl-key1 = <0x11>;
			mediatek,hw-dl-key2 = <0x08>;
			mediatek,hw-recovery-key = <0x00>;
			mediatek,hw-factory-key = <0x11>;
			status = "okay";
		};
	};

	fragment@76 {
		target = <0xffffffff>;

		__overlay__ {
			usb_charger_current = <0x7a120>;
			ac_charger_current = <0x16e360>;
			ac_charger_input_current = <0x16e360>;
			non_std_ac_charger_current = <0xf4240>;
			charging_host_input_current = <0x16e360>;
			charging_host_charger_current = <0xf4240>;
			temp_t4_threshold = <0x3c>;
			boot_battery_voltage = <0x365240>;
		};
	};

	fragment@77 {
		target = <0xffffffff>;

		__overlay__ {
			enable_vbat_mon = <0x00>;
			boot_battery_voltage = <0x365240>;
			battery_cv = <0x44aa20>;
			max_charger_voltage = <0xa7d8c0>;
			disable_aicl;
			enable_dynamic_mivr;
			fast_charging_indicator = <0x0e>;
			usb_charger_current_suspend = <0x00>;
			usb_charger_current_unconfigured = <0x11170>;
			usb_charger_current_configured = <0x7a120>;
			usb_charger_current = <0x7a120>;
			ac_charger_current = <0x2dc6c0>;
			ac_charger_input_current = <0x1e8480>;
			non_std_ac_charger_current = <0xf4240>;
			charging_host_charger_current = <0x16e360>;
			apple_1_0a_charger_current = <0x9eb10>;
			apple_2_1a_charger_current = "\0\f5";
			ta_ac_charger_current = <0x1e8480>;
			typec_limit_aicr = <0x2dc6c0>;
			typecotp_charger = <0x01>;
			mmi,iterm-ma = <0xf3>;
			mmi,mmi-temp-zones = <0x00 0x1068 0x3e8 0x00 0x0a 0x1194 0xbb8 0x3e8 0x0f 0x1194 0xbb8 0xbb8 0x2d 0x1194 0xfa0 0xfa0 0x3c 0x1068 0xfa0 0x00>;
			mmi,mmi-ffc-zones = <0x00 0x1068 0xf3 0x0a 0x1194 0xf3 0x0f 0x1194 0xf3 0x19 0x11b2 0x1fa 0x23 0x11b2 0x230 0x2d 0x11b2 0x3c5 0x3c 0x1068 0xf3>;
			mmi,enable-charging-limit;
			mmi,upper-limit-capacity = <0x4b>;
			mmi,lower-limit-capacity = <0x46>;
			mmi,min-cp-therm-current-ua = <0x186a00>;
		};
	};

	fragment@78 {
		target = <0xffffffff>;

		__overlay__ {
			io-channels = <0xffffffff 0x01 0xffffffff 0x03 0xffffffff 0x04 0xffffffff 0x05 0xffffffff 0x06 0xffffffff 0x08 0xffffffff 0x02 0xffffffff 0x07 0xffffffff 0x0f 0xffffffff 0x09 0xffffffff 0x0a>;
			typecotp_chg = <0x01>;
			pinctrl-names = "mos_on\0mos_off";
			pinctrl-0 = <0x57>;
			pinctrl-1 = <0x58>;
			cv = <0x1194>;
			ircmp_r = <0x00>;
			ircmp_v = <0x00>;
		};
	};

	fragment@79 {
		target = <0xffffffff>;

		__overlay__ {

			mos_on {
				phandle = <0x57>;

				pins_cmd_dat {
					pinmux = <0x2600>;
					slew-rate = <0x01>;
					output-high;
				};
			};

			mos_off {
				phandle = <0x58>;

				pins_cmd_dat {
					pinmux = <0x2600>;
					slew-rate = <0x01>;
					output-low;
				};
			};
		};
	};

	fragment@80 {
		target = <0xffffffff>;

		__overlay__ {
			sc_input_current = <0x2dc6c0>;
		};
	};

	fragment@81 {
		target = <0xffffffff>;

		__overlay__ {
			typecotp_tcpc = <0x01>;

			pd-data {
				pd,source-pdo-data = <0x1905a>;
				pd,sink-pdo-size = <0x02>;
				pd,sink-pdo-data = <0x2d0c8 0x2d0c8>;
			};
		};
	};

	fragment@82 {
		target = <0xffffffff>;

		__overlay__ {
			vbus-current = <0x10c8e0>;
		};
	};

	fragment@83 {
		target = <0xffffffff>;

		__overlay__ {
			pd_vbus_low_bound = <0x4c4b40>;
			pd_vbus_upper_bound = <0x895440>;
			sc_input_current = <0x2dc6c0>;
			sc_charger_current = "\0=\t";
		};
	};

	fragment@84 {
		target = <0xffffffff>;

		__overlay__ {
			pe40_max_vbus = <0x1770>;
			pe40_max_ibus = <0xbb8>;
		};
	};

	fragment@85 {
		target = <0xffffffff>;

		__overlay__ {
			ita_min = <0x3e8>;
		};
	};

	fragment@86 {
		target = <0xffffffff>;

		__overlay__ {
			DIFFERENCE_FULLOCV_ITH = <0x50>;
			EMBEDDED_SEL = <0x01>;
			VIR_OLDOCV_DIFF_EMB = <0xbb8>;
			VIR_OLDOCV_DIFF_EMB_LT = <0xbb8>;
			CURR_MEASURE_20A = <0x00>;
			UNIT_MULTIPLE = <0x01>;
			g_temperature = <0x32 0x19 0x0a 0x00 0xfffffff6 0xffffffe7 0xffffffe2 0xffffffdd 0xffffffd8 0xffffffd3>;
			g_FG_PSEUDO100 = <0x62 0x63 0x64 0x64 0x62 0x63 0x64 0x64 0x62 0x63 0x64 0x64 0x62 0x63 0x64 0x64 0x62 0x63 0x64 0x64 0x64 0x64 0x64 0x64 0x64 0x64 0x64 0x64 0x64 0x64 0x64 0x64 0x64 0x64 0x64 0x64 0x64 0x64 0x64 0x64>;
			g_Q_MAX = <0x137e 0x1384 0x1384 0x1384 0x1384 0x1384 0x1384 0x1384 0x1384 0x1384 0x1384 0x1384 0x1384 0x1384 0x1384 0x1384 0x137e 0x1384 0x1384 0x1384 0x137e 0x1384 0x1384 0x1384 0x137e 0x1384 0x1384 0x1384 0x137e 0x1384 0x1384 0x1384 0x137e 0x1384 0x1384 0x1384 0x137e 0x1384 0x1384 0x1384>;
			g_Q_MAX_H_CURRENT = <0x136a 0x137e 0x137e 0x137e 0x1374 0x137e 0x137e 0x137e 0x1374 0x137e 0x137e 0x137e 0x1374 0x137e 0x137e 0x137e 0x136a 0x137e 0x137e 0x137e 0x136a 0x137e 0x137e 0x137e 0x136a 0x137e 0x137e 0x137e 0x136a 0x137e 0x137e 0x137e 0x136a 0x137e 0x137e 0x137e 0x136a 0x137e 0x137e 0x137e>;
			g_PMIC_MIN_VOL_row = <0x04>;
			g_PMIC_MIN_VOL_col = <0x0a>;
			g_PMIC_MIN_VOL = <0x7d00 0x7d00 0x82dc 0x82dc 0x7d00 0x7d00 0x80e8 0x80e8 0x80e8 0x80e8 0x80e8 0x80e8 0x7dc8 0x7dc8 0x7dc8 0x7dc8 0x7a80 0x7a80 0x7a80 0x7a80 0x7918 0x7918 0x7918 0x7918 0x7918 0x7918 0x7918 0x7918 0x7918 0x7918 0x7918 0x7918 0x7918 0x7918 0x7918 0x7918 0x7918 0x7918 0x7918 0x79e0>;
			g_QMAX_SYS_VOL_row = <0x04>;
			g_QMAX_SYS_VOL_col = <0x0a>;
			g_QMAX_SYS_VOL = <0x7ef4 0x7ef4 0x8886 0x8886 0x7ef4 0x7ef4 0x8886 0x8886 0x85ca 0x85ca 0x85ca 0x85ca 0x85ca 0x85ca 0x85ca 0x85ca 0x85ca 0x85ca 0x85ca 0x85ca 0x85ca 0x85ca 0x85ca 0x85ca 0x8020 0x8020 0x8020 0x8020 0x8020 0x8020 0x8020 0x8020 0x8020 0x8020 0x8020 0x8020 0x8020 0x8020 0x8020 0x8020>;
			SHUTDOWN_1_TIME = <0x1e>;
			ACTIVE_TABLE = <0x05>;
			R_FG_VALUE = <0x05>;
			NO_BAT_TEMP_COMPENSATE = <0x01>;
			df-serialnum = "SB18D86478";
			CAR_TUNE_VALUE = <0x63>;
			serialnum_0 = "SB18D86478";
			battery0_profile_t0_num = <0x64>;
			battery0_profile_t0_col = <0x03>;
			battery0_profile_t0 = <0x00 0xadbb 0x343 0x1ff 0xacf5 0x343 0x3fd 0xac54 0x345 0x5fc 0xabc9 0x345 0x7fb 0xab4a 0x349 0x9f9 0xaad2 0x34d 0xbf8 0xaa5f 0x34f 0xdf7 0xa9ed 0x35b 0xff5 0xa97b 0x35c 0x11f4 0xa906 0x357 0x13f3 0xa88f 0x358 0x15f1 0xa818 0x35f 0x17f0 0xa7a0 0x364 0x19ee 0xa725 0x364 0x1bed 0xa6a8 0x363 0x1dec 0xa62c 0x363 0x1fea 0xa5af 0x365 0x21e9 0xa530 0x366 0x23e8 0xa4b1 0x363 0x25e6 0xa433 0x35d 0x27e5 0xa3b7 0x364 0x29e4 0xa33e 0x36c 0x2be2 0xa2c4 0x371 0x2de1 0xa24b 0x372 0x2fe0 0xa1d3 0x36f 0x31de 0xa15c 0x36b 0x33dd 0xa0e6 0x36d 0x35dc 0xa078 0x37a 0x37da 0xa004 0x376 0x39d9 0x9f94 0x375 0x3bd8 0x9f27 0x378 0x3dd6 0x9ebb 0x37d 0x3fd5 0x9e52 0x382 0x41d4 0x9de9 0x383 0x43d2 0x9d88 0x392 0x45d1 0x9d24 0x393 0x47d0 0x9cc5 0x3a1 0x49ce 0x9c69 0x3ad 0x4bcd 0x9c0d 0x3b6 0x4dcb 0x9bb1 0x3c5 0x4fca 0x9b5b 0x3db 0x51c9 0x9b04 0x3fb 0x53c7 0x9a9f 0x40c 0x55c6 0x9a15 0x3dc 0x57c5 0x997b 0x396 0x59c3 0x98f3 0x369 0x5bc2 0x988d 0x364 0x5dc1 0x9839 0x363 0x5fbf 0x97ec 0x35d 0x61be 0x97a6 0x357 0x63bd 0x9763 0x350 0x65bb 0x9725 0x350 0x67ba 0x96ec 0x355 0x69b9 0x96b2 0x356 0x6bb7 0x967e 0x35e 0x6db6 0x9646 0x34e 0x6fb5 0x9613 0x351 0x71b3 0x95e4 0x358 0x73b2 0x95b7 0x35f 0x75b1 0x958a 0x362 0x77af 0x955d 0x35d 0x79ae 0x9536 0x36a 0x7bad 0x950e 0x365 0x7dab 0x94e7 0x368 0x7faa 0x94c4 0x373 0x81a8 0x94a3 0x37e 0x83a7 0x9481 0x386 0x85a6 0x9461 0x39b 0x87a4 0x943f 0x3a1 0x89a3 0x940f 0x3a2 0x8ba2 0x93c4 0x375 0x8da0 0x9371 0x34e 0x8f9f 0x932a 0x34a 0x919e 0x92f4 0x358 0x939c 0x92c4 0x36d 0x959b 0x928f 0x36d 0x979a 0x925d 0x362 0x9998 0x922c 0x35c 0x9b97 0x9201 0x366 0x9d96 0x91da 0x379 0x9f94 0x91ac 0x383 0xa193 0x9172 0x37d 0xa392 0x912e 0x36f 0xa590 0x90ee 0x371 0xa78f 0x90ad 0x37f 0xa98e 0x9063 0x372 0xab8c 0x9018 0x341 0xad8b 0x8fec 0x32f 0xaf89 0x8fe2 0x357 0xb188 0x8fd8 0x3a3 0xb387 0x8fca 0x400 0xb585 0x8fac 0x458 0xb784 0x8f46 0x457 0xb983 0x8e47 0x3d9 0xbb81 0x8c7e 0x3c0 0xbd80 0x8a05 0x3ef 0xbf7f 0x8670 0x423 0xc17d 0x7fa7 0x655 0xc37c 0x72e6 0xde5 0xc57b 0x72e6 0xde5>;
			battery0_profile_t1_num = <0x64>;
			battery0_profile_t1_col = <0x03>;
			battery0_profile_t1 = <0x00 0xae0f 0x492 0x1ff 0xad7b 0x492 0x3fd 0xace5 0x487 0x5fc 0xac5e 0x47f 0x7fb 0xabe6 0x47f 0x9f9 0xab74 0x47f 0xbf8 0xab03 0x474 0xdf7 0xaa95 0x474 0xff5 0xaa23 0x46c 0x11f4 0xa9b1 0x46c 0x13f3 0xa93f 0x46c 0x15f1 0xa8c8 0x469 0x17f0 0xa84e 0x461 0x19ee 0xa7d2 0x45b 0x1bed 0xa756 0x45d 0x1dec 0xa6d8 0x45e 0x1fea 0xa659 0x45c 0x21e9 0xa5da 0x45b 0x23e8 0xa55b 0x459 0x25e6 0xa4dd 0x453 0x27e5 0xa45f 0x44f 0x29e4 0xa3e3 0x453 0x2be2 0xa368 0x459 0x2de1 0xa2ee 0x458 0x2fe0 0xa274 0x452 0x31de 0xa1fd 0x44f 0x33dd 0xa187 0x457 0x35dc 0xa110 0x45b 0x37da 0xa09c 0x451 0x39d9 0xa02e 0x45e 0x3bd8 0x9fbf 0x468 0x3dd6 0x9f4f 0x46b 0x3fd5 0x9ee5 0x470 0x41d4 0x9e7d 0x47d 0x43d2 0x9e14 0x491 0x45d1 0x9daf 0x498 0x47d0 0x9d4f 0x4a5 0x49ce 0x9cf0 0x4c1 0x4bcd 0x9c92 0x4db 0x4dcb 0x9c37 0x4e5 0x4fca 0x9bdc 0x500 0x51c9 0x9b80 0x528 0x53c7 0x9b21 0x533 0x55c6 0x9ab2 0x51e 0x57c5 0x9a2b 0x4e2 0x59c3 0x9998 0x48d 0x5bc2 0x9912 0x441 0x5dc1 0x98a9 0x41f 0x5fbf 0x9851 0x41d 0x61be 0x9803 0x412 0x63bd 0x97bd 0x409 0x65bb 0x977d 0x409 0x67ba 0x973e 0x40c 0x69b9 0x9703 0x407 0x6bb7 0x96d0 0x40d 0x6db6 0x9699 0x414 0x6fb5 0x9666 0x410 0x71b3 0x9635 0x40d 0x73b2 0x9608 0x414 0x75b1 0x95de 0x421 0x77af 0x95b1 0x426 0x79ae 0x9587 0x420 0x7bad 0x9564 0x42b 0x7dab 0x953e 0x42e 0x7faa 0x951b 0x432 0x81a8 0x94fa 0x438 0x83a7 0x94d8 0x441 0x85a6 0x94bb 0x453 0x87a4 0x949c 0x453 0x89a3 0x947e 0x466 0x8ba2 0x945e 0x471 0x8da0 0x9439 0x46d 0x8f9f 0x940e 0x45a 0x919e 0x93dc 0x443 0x939c 0x93ac 0x436 0x959b 0x937d 0x429 0x979a 0x934e 0x42c 0x9998 0x931e 0x42a 0x9b97 0x92f2 0x426 0x9d96 0x92cb 0x426 0x9f94 0x92a6 0x430 0xa193 0x927b 0x443 0xa392 0x9242 0x439 0xa590 0x9203 0x43a 0xa78f 0x91c4 0x439 0xa98e 0x9185 0x43d 0xab8c 0x913d 0x446 0xad8b 0x90e5 0x42b 0xaf89 0x90b4 0x427 0xb188 0x90a4 0x43d 0xb387 0x9096 0x44f 0xb585 0x9085 0x46e 0xb784 0x906d 0x4ac 0xb983 0x9037 0x4f8 0xbb81 0x8fa1 0x4f6 0xbd80 0x8deb 0x4ad 0xbf7f 0x8b91 0x4d2 0xc17d 0x8842 0x539 0xc37c 0x826f 0x7c6 0xc57b 0x7505 0x132c>;
			battery0_profile_t2_num = <0x64>;
			battery0_profile_t2_col = <0x03>;
			battery0_profile_t2 = <0x00 0xade6 0x78a 0x1ff 0xad2d 0x78a 0x3fd 0xac9e 0x785 0x5fc 0xac25 0x772 0x7fb 0xabb8 0x75d 0x9f9 0xab4e 0x74d 0xbf8 0xaae5 0x73c 0xdf7 0xaa7e 0x735 0xff5 0xaa12 0x723 0x11f4 0xa9a2 0x710 0x13f3 0xa932 0x703 0x15f1 0xa8c1 0x6f9 0x17f0 0xa84c 0x6eb 0x19ee 0xa7d2 0x6dd 0x1bed 0xa756 0x6d2 0x1dec 0xa6da 0x6cb 0x1fea 0xa65c 0x6bf 0x21e9 0xa5dd 0x6b1 0x23e8 0xa560 0x6a9 0x25e6 0xa4e4 0x6a8 0x27e5 0xa465 0x6a1 0x29e4 0xa3e9 0x6a2 0x2be2 0xa36c 0x69a 0x2de1 0xa2f1 0x699 0x2fe0 0xa276 0x697 0x31de 0xa1fd 0x695 0x33dd 0xa187 0x69b 0x35dc 0xa113 0x6a1 0x37da 0xa09f 0x6ae 0x39d9 0xa02b 0x6b1 0x3bd8 0x9fb8 0x6b1 0x3dd6 0x9f4a 0x6b9 0x3fd5 0x9ee0 0x6cb 0x41d4 0x9e75 0x6da 0x43d2 0x9e0e 0x6ee 0x45d1 0x9da4 0x6fb 0x47d0 0x9d40 0x711 0x49ce 0x9cdd 0x723 0x4bcd 0x9c7b 0x736 0x4dcb 0x9c1b 0x74e 0x4fca 0x9bb7 0x75a 0x51c9 0x9b50 0x75a 0x53c7 0x9ae0 0x74a 0x55c6 0x9a5e 0x708 0x57c5 0x99d4 0x6b5 0x59c3 0x9950 0x66b 0x5bc2 0x98d7 0x630 0x5dc1 0x986e 0x60e 0x5fbf 0x9816 0x5ff 0x61be 0x97cb 0x5f9 0x63bd 0x9782 0x5f3 0x65bb 0x973f 0x5ef 0x67ba 0x9700 0x5ee 0x69b9 0x96c4 0x5ee 0x6bb7 0x968a 0x5f0 0x6db6 0x9652 0x5f0 0x6fb5 0x961d 0x5eb 0x71b3 0x95ed 0x5f4 0x73b2 0x95bf 0x5fe 0x75b1 0x958f 0x5fd 0x77af 0x9561 0x600 0x79ae 0x9539 0x60d 0x7bad 0x950f 0x60e 0x7dab 0x94ea 0x61c 0x7faa 0x94c5 0x622 0x81a8 0x94a0 0x624 0x83a7 0x947e 0x62f 0x85a6 0x9461 0x63b 0x87a4 0x943f 0x63d 0x89a3 0x9421 0x63d 0x8ba2 0x9406 0x646 0x8da0 0x93e9 0x649 0x8f9f 0x93c9 0x644 0x919e 0x93a8 0x641 0x939c 0x9384 0x636 0x959b 0x9357 0x627 0x979a 0x9326 0x615 0x9998 0x92f6 0x60e 0x9b97 0x92c9 0x611 0x9d96 0x92a0 0x61a 0x9f94 0x927a 0x628 0xa193 0x924a 0x635 0xa392 0x920c 0x640 0xa590 0x91c9 0x649 0xa78f 0x9189 0x654 0xa98e 0x9147 0x664 0xab8c 0x90f9 0x677 0xad8b 0x909e 0x682 0xaf89 0x906c 0x69e 0xb188 0x9051 0x6c3 0xb387 0x9039 0x6f4 0xb585 0x901f 0x737 0xb784 0x8ff9 0x79a 0xb983 0x8fb1 0x830 0xbb81 0x8f0a 0x8f8 0xbd80 0x8d2f 0xa13 0xbf7f 0x8a96 0xdd9 0xc17d 0x86c7 0x2005 0xc37c 0x817f 0x324e 0xc57b 0x7e29 0x2a06>;
			battery0_profile_t3_num = <0x64>;
			battery0_profile_t3_col = <0x03>;
			battery0_profile_t3 = <0x00 0xae56 0xc62 0x1ff 0xad79 0xc62 0x3fd 0xacd8 0xc5d 0x5fc 0xac55 0xc44 0x7fb 0xabe0 0xc29 0x9f9 0xab74 0xc14 0xbf8 0xab0c 0xbf8 0xdf7 0xaaa0 0xbdf 0xff5 0xaa37 0xbc5 0x11f4 0xa9cd 0xbb6 0x13f3 0xa95f 0xb9c 0x15f1 0xa8ec 0xb7d 0x17f0 0xa879 0xb65 0x19ee 0xa807 0xb59 0x1bed 0xa78a 0xb37 0x1dec 0xa711 0xb28 0x1fea 0xa694 0xb0c 0x21e9 0xa615 0xaf2 0x23e8 0xa597 0xae0 0x25e6 0xa51a 0xad1 0x27e5 0xa499 0xabe 0x29e4 0xa41d 0xaba 0x2be2 0xa3a3 0xab2 0x2de1 0xa328 0xaab 0x2fe0 0xa2ac 0xaa4 0x31de 0xa232 0xaa2 0x33dd 0xa1bb 0xaa7 0x35dc 0xa142 0xaa3 0x37da 0xa0cb 0xa9a 0x39d9 0xa058 0xaa3 0x3bd8 0x9fe7 0xaad 0x3dd6 0x9f76 0xab3 0x3fd5 0x9f05 0xabb 0x41d4 0x9e99 0xac9 0x43d2 0x9e2a 0xacf 0x45d1 0x9dc0 0xae1 0x47d0 0x9d59 0xaf0 0x49ce 0x9cf0 0xaf9 0x4bcd 0x9c88 0xaff 0x4dcb 0x9c20 0xb01 0x4fca 0x9bb3 0xaf4 0x51c9 0x9b3f 0xada 0x53c7 0x9ac4 0xaa3 0x55c6 0x9a46 0xa67 0x57c5 0x99c7 0xa25 0x59c3 0x994c 0x9e6 0x5bc2 0x98da 0x9b8 0x5dc1 0x9871 0x992 0x5fbf 0x9819 0x989 0x61be 0x97c6 0x97d 0x63bd 0x977c 0x97a 0x65bb 0x9736 0x97a 0x67ba 0x96f3 0x97c 0x69b9 0x96b5 0x984 0x6bb7 0x967a 0x988 0x6db6 0x9640 0x988 0x6fb5 0x9608 0x988 0x71b3 0x95d4 0x991 0x73b2 0x95a4 0x99f 0x75b1 0x9577 0x9ac 0x77af 0x9548 0x9b8 0x79ae 0x951a 0x9c5 0x7bad 0x94f3 0x9d4 0x7dab 0x94cb 0x9e1 0x7faa 0x94a5 0x9ee 0x81a8 0x9481 0x9f8 0x83a7 0x945f 0xa01 0x85a6 0x943f 0xa14 0x87a4 0x9420 0xa1d 0x89a3 0x9407 0xa34 0x8ba2 0x93eb 0xa45 0x8da0 0x93d2 0xa58 0x8f9f 0x93bc 0xa70 0x919e 0x93a4 0xa87 0x939c 0x938a 0xaa7 0x959b 0x936a 0xab4 0x979a 0x9342 0xac6 0x9998 0x9315 0xada 0x9b97 0x92e5 0xaf5 0x9d96 0x92b6 0xb1a 0x9f94 0x9286 0xb4a 0xa193 0x9251 0xb92 0xa392 0x9213 0xbe8 0xa590 0x91c9 0xc39 0xa78f 0x9183 0xca7 0xa98e 0x913d 0xd32 0xab8c 0x90ed 0xdd1 0xad8b 0x908b 0xe8d 0xaf89 0x9035 0xf80 0xb188 0x9004 0x10e4 0xb387 0x8fd9 0x12dc 0xb585 0x8fac 0x15cf 0xb784 0x8f74 0x1ac9 0xb983 0x8f21 0x25f0 0xbb81 0x8e91 0x423c 0xbd80 0x8d14 0x4f44 0xbf7f 0x8b9b 0x4ba3 0xc17d 0x8b9b 0x4ba3 0xc37c 0x8b9b 0x4ba3 0xc57b 0x8b9b 0x4ba3>;
			battery0_profile_t4_num = <0x64>;
			battery0_profile_t4_col = <0x03>;
			battery0_profile_t4 = <0x00 0xaea3 0x1aea 0x1ff 0xad87 0x1aea 0x3fd 0xacb8 0x1ade 0x5fc 0xac15 0x1ac0 0x7fb 0xab8b 0x1a96 0x9f9 0xab0b 0x1a64 0xbf8 0xaa92 0x1a27 0xdf7 0xaa1c 0x19e7 0xff5 0xa9aa 0x19af 0x11f4 0xa936 0x197b 0x13f3 0xa8c3 0x193f 0x15f1 0xa84d 0x18fd 0x17f0 0xa7d6 0x18c0 0x19ee 0xa760 0x1893 0x1bed 0xa6ec 0x185c 0x1dec 0xa673 0x1828 0x1fea 0xa5fa 0x17ea 0x21e9 0xa582 0x17b7 0x23e8 0xa50a 0x178b 0x25e6 0xa491 0x1756 0x27e5 0xa41a 0x172e 0x29e4 0xa3a1 0x1701 0x2be2 0xa32a 0x16e3 0x2de1 0xa2b1 0x16c0 0x2fe0 0xa239 0x1699 0x31de 0xa1c3 0x1677 0x33dd 0xa14f 0x1663 0x35dc 0xa0db 0x1647 0x37da 0xa067 0x162e 0x39d9 0x9ff5 0x1620 0x3bd8 0x9f84 0x1609 0x3dd6 0x9f12 0x15f4 0x3fd5 0x9ea1 0x15e7 0x41d4 0x9e30 0x15d5 0x43d2 0x9dc4 0x15cf 0x45d1 0x9d52 0x15ad 0x47d0 0x9ce1 0x159a 0x49ce 0x9c70 0x1586 0x4bcd 0x9bfd 0x1564 0x4dcb 0x9b88 0x1536 0x4fca 0x9b0f 0x1508 0x51c9 0x9a95 0x14cd 0x53c7 0x9a21 0x14a4 0x55c6 0x99ae 0x1476 0x57c5 0x993f 0x1452 0x59c3 0x98d6 0x1433 0x5bc2 0x9873 0x140e 0x5dc1 0x9817 0x13fb 0x5fbf 0x97c0 0x13ee 0x61be 0x9770 0x13e7 0x63bd 0x9725 0x13f1 0x65bb 0x96df 0x1401 0x67ba 0x969c 0x140e 0x69b9 0x965d 0x141d 0x6bb7 0x9621 0x142a 0x6db6 0x95e9 0x1443 0x6fb5 0x95b1 0x1457 0x71b3 0x957b 0x146b 0x73b2 0x954a 0x148a 0x75b1 0x951e 0x14b4 0x77af 0x94f1 0x14c8 0x79ae 0x94c3 0x14e8 0x7bad 0x94a0 0x151b 0x7dab 0x947c 0x154c 0x7faa 0x945c 0x1580 0x81a8 0x943f 0x15bf 0x83a7 0x9425 0x1607 0x85a6 0x940e 0x164c 0x87a4 0x93f9 0x16b0 0x89a3 0x93e2 0x170c 0x8ba2 0x93cc 0x1779 0x8da0 0x93b5 0x17f6 0x8f9f 0x939c 0x1881 0x919e 0x937f 0x191c 0x939c 0x9362 0x19c7 0x959b 0x933d 0x1a7b 0x979a 0x9318 0x1b46 0x9998 0x92f0 0x1c29 0x9b97 0x92c2 0x1d20 0x9d96 0x928e 0x1e2e 0x9f94 0x9256 0x1f61 0xa193 0x9219 0x20c1 0xa392 0x91d3 0x2247 0xa590 0x918c 0x2429 0xa78f 0x9143 0x264f 0xa98e 0x90f7 0x28d5 0xab8c 0x90a6 0x2bf4 0xad8b 0x904d 0x2fd9 0xaf89 0x8ff7 0x3526 0xb188 0x8fba 0x3c7f 0xb387 0x8f8c 0x4734 0xb585 0x8f64 0x5345 0xb784 0x8f32 0x548c 0xb983 0x8ed7 0x53aa 0xbb81 0x8ed3 0x53a0 0xbd80 0x8ed3 0x53a0 0xbf7f 0x8ed3 0x53a0 0xc17d 0x8ed3 0x53a0 0xc37c 0x8ed3 0x53a0 0xc57b 0x8ed3 0x53a0>;
			serialnum_1 = "SB18D86479";
			battery1_profile_t0_num = <0x64>;
			battery1_profile_t0_col = <0x04>;
			battery1_profile_t0 = <0x00 0xaccf 0x355 0x355 0x1fe 0xac66 0x355 0x355 0x3fd 0xabfc 0x354 0x354 0x5fb 0xab96 0x35e 0x35e 0x7f9 0xab30 0x360 0x360 0x9f8 0xaac5 0x356 0x356 0xbf6 0xaa56 0x356 0x356 0xdf4 0xa9ed 0x363 0x363 0xff2 0xa97a 0x357 0x357 0x11f1 0xa905 0x354 0x354 0x13ef 0xa894 0x35c 0x35c 0x15ed 0xa822 0x364 0x364 0x17ec 0xa7a9 0x369 0x369 0x19ea 0xa72f 0x372 0x372 0x1be8 0xa6b0 0x365 0x365 0x1de7 0xa636 0x371 0x371 0x1fe5 0xa5b9 0x375 0x375 0x21e3 0xa53b 0x374 0x374 0x23e1 0xa4bb 0x36e 0x36e 0x25e0 0xa43c 0x367 0x367 0x27de 0xa3c3 0x375 0x375 0x29dc 0xa344 0x375 0x375 0x2bdb 0xa2ca 0x373 0x373 0x2dd9 0xa251 0x374 0x374 0x2fd7 0xa1d8 0x374 0x374 0x31d6 0xa160 0x377 0x377 0x33d4 0xa0eb 0x382 0x382 0x35d2 0xa072 0x373 0x373 0x37d0 0xa003 0x381 0x381 0x39cf 0x9f99 0x398 0x398 0x3bcd 0x9f2c 0x3a3 0x3a3 0x3dcb 0x9ebf 0x3a9 0x3a9 0x3fca 0x9e55 0x3b1 0x3b1 0x41c8 0x9dec 0x3b2 0x3b2 0x43c6 0x9d82 0x3bf 0x3bf 0x45c5 0x9d23 0x3d9 0x3d9 0x47c3 0x9cc0 0x3ea 0x3ea 0x49c1 0x9c5f 0x405 0x405 0x4bc0 0x9bfb 0x422 0x422 0x4dbe 0x9b8d 0x424 0x424 0x4fbc 0x9b0e 0x3fd 0x3fd 0x51ba 0x9a70 0x3ad 0x3ad 0x53b9 0x99df 0x369 0x369 0x55b7 0x996a 0x34c 0x34c 0x57b5 0x990c 0x34c 0x34c 0x59b4 0x98bb 0x355 0x355 0x5bb2 0x9870 0x354 0x354 0x5db0 0x9821 0x354 0x354 0x5faf 0x97e2 0x361 0x361 0x61ad 0x979e 0x359 0x359 0x63ab 0x975d 0x34c 0x34c 0x65a9 0x9720 0x34b 0x34b 0x67a8 0x96e6 0x350 0x350 0x69a6 0x96ac 0x343 0x343 0x6ba4 0x9671 0x345 0x345 0x6da3 0x9641 0x352 0x352 0x6fa1 0x9612 0x360 0x360 0x719f 0x95df 0x35d 0x35d 0x739e 0x95af 0x35a 0x35a 0x759c 0x9584 0x367 0x367 0x779a 0x955a 0x373 0x373 0x7998 0x9530 0x375 0x375 0x7b97 0x950a 0x37f 0x37f 0x7d95 0x94e6 0x395 0x395 0x7f93 0x94be 0x39a 0x39a 0x8192 0x9495 0x396 0x396 0x8390 0x9471 0x3a7 0x3a7 0x858e 0x944c 0x3c1 0x3c1 0x878d 0x9402 0x38c 0x38c 0x898b 0x93af 0x36e 0x36e 0x8b89 0x9365 0x35c 0x35c 0x8d88 0x932b 0x361 0x361 0x8f86 0x92f8 0x36a 0x36a 0x9184 0x92bf 0x356 0x356 0x9382 0x9290 0x363 0x363 0x9581 0x925b 0x357 0x357 0x977f 0x922e 0x35f 0x35f 0x997d 0x9204 0x36d 0x36d 0x9b7c 0x91d8 0x37b 0x37b 0x9d7a 0x91a4 0x37d 0x37d 0x9f78 0x9165 0x366 0x366 0xa177 0x9120 0x364 0x364 0xa375 0x90e5 0x371 0x371 0xa573 0x90a0 0x373 0x373 0xa771 0x9053 0x356 0x356 0xa970 0x9016 0x33b 0x33b 0xab6e 0x8ffa 0x348 0x348 0xad6c 0x8fea 0x356 0x356 0xaf6b 0x8fdf 0x38b 0x38b 0xb169 0x8fd0 0x3cc 0x3cc 0xb367 0x8fb1 0x421 0x421 0xb566 0x8f45 0x41c 0x41c 0xb764 0x8e42 0x3d2 0x3d2 0xb962 0x8c85 0x3b5 0x3b5 0xbb60 0x8a41 0x3cf 0x3cf 0xbd5f 0x8710 0x42c 0x42c 0xbf5d 0x81ed 0x52a 0x52a 0xc15b 0x7b0c 0xfbe 0xfbe 0xc35a 0x7704 0x181a 0x181a 0xc558 0x7704 0x181a 0x181a>;
			battery1_profile_t1_num = <0x64>;
			battery1_profile_t1_col = <0x04>;
			battery1_profile_t1 = <0x00 0xadc7 0x573 0x4f6 0x1fe 0xad34 0x573 0x532 0x3fd 0xacba 0x57e 0x50c 0x5fb 0xac4d 0x582 0x4dd 0x7f9 0xabe6 0x57d 0x4c1 0x9f8 0xab82 0x581 0x4a0 0xbf6 0xab1d 0x5a3 0x449 0xdf4 0xaab4 0x5a3 0x45d 0xff2 0xaa45 0x594 0x46c 0x11f1 0xa9d6 0x591 0x462 0x13ef 0xa967 0x589 0x456 0x15ed 0xa8f7 0x583 0x448 0x17ec 0xa885 0x58e 0x438 0x19ea 0xa81b 0x5b0 0x42e 0x1be8 0xa7a1 0x594 0x42e 0x1de7 0xa723 0x586 0x424 0x1fe5 0xa6a4 0x582 0x41e 0x21e3 0xa629 0x58a 0x403 0x23e1 0xa5ad 0x593 0x40a 0x25e0 0xa52c 0x58e 0x3fd 0x27de 0xa4a8 0x582 0x400 0x29dc 0xa42f 0x58f 0x3ff 0x2bdb 0xa3b1 0x593 0x3f3 0x2dd9 0xa336 0x59c 0x3fb 0x2fd7 0xa2ba 0x59b 0x3dd 0x31d6 0xa23d 0x596 0x3e5 0x33d4 0xa1c5 0x5a4 0x3e4 0x35d2 0xa151 0x5b1 0x3dc 0x37d0 0xa0dd 0x5b2 0x3e0 0x39cf 0xa069 0x5a6 0x3de 0x3bcd 0x9ff5 0x599 0x3c1 0x3dcb 0x9f86 0x59f 0x3dc 0x3fca 0x9f1c 0x5b8 0x3e4 0x41c8 0x9eb2 0x5d0 0x3c1 0x43c6 0x9e44 0x5d2 0x3d4 0x45c5 0x9dda 0x5ea 0x3d4 0x47c3 0x9d74 0x603 0x3e3 0x49c1 0x9d0d 0x615 0x3d8 0x4bc0 0x9ca5 0x61d 0x3af 0x4dbe 0x9c3f 0x61d 0x3dd 0x4fbc 0x9bd0 0x61b 0x3e3 0x51ba 0x9b51 0x5f5 0x3e2 0x53b9 0x9ac9 0x5ac 0x3d3 0x55b7 0x9a44 0x56f 0x3f0 0x57b5 0x99c5 0x53a 0x41a 0x59b4 0x9953 0x50d 0x41b 0x5bb2 0x98f0 0x4f4 0x434 0x5db0 0x9897 0x4e7 0x442 0x5faf 0x984d 0x4da 0x417 0x61ad 0x9803 0x4e2 0x42e 0x63ab 0x97c0 0x4ef 0x442 0x65a9 0x977e 0x4f0 0x43c 0x67a8 0x973c 0x4eb 0x438 0x69a6 0x9703 0x4f6 0x442 0x6ba4 0x96c8 0x4f6 0x438 0x6da3 0x9693 0x4f6 0x424 0x6fa1 0x9662 0x500 0x43e 0x719f 0x962f 0x505 0x432 0x739e 0x95fd 0x50a 0x434 0x759c 0x95cd 0x515 0x42e 0x779a 0x959f 0x517 0x426 0x7998 0x957a 0x524 0x42a 0x7b97 0x9551 0x533 0x408 0x7d95 0x9526 0x53f 0x428 0x7f93 0x9502 0x54c 0x40b 0x8192 0x94e0 0x559 0x416 0x8390 0x94bb 0x55f 0x44f 0x858e 0x9496 0x555 0x3e5 0x878d 0x9472 0x548 0x410 0x898b 0x944c 0x539 0x429 0x8b89 0x9424 0x536 0x410 0x8d88 0x93f8 0x529 0x415 0x8f86 0x93ca 0x512 0x41f 0x9184 0x939f 0x50b 0x41a 0x9382 0x9375 0x527 0x452 0x9581 0x9341 0x50d 0x429 0x977f 0x9310 0x4fd 0x41a 0x997d 0x92e4 0x500 0x448 0x9b7c 0x92ba 0x502 0x40b 0x9d7a 0x9290 0x503 0x42f 0x9f78 0x9265 0x526 0x429 0xa177 0x923b 0x526 0x429 0xa375 0x91fe 0x526 0x429 0xa573 0x91be 0x52f 0x41f 0xa771 0x9182 0x53c 0x419 0xa970 0x9144 0x54e 0x424 0xab6e 0x90fb 0x55c 0x40f 0xad6c 0x90a3 0x535 0x41a 0xaf6b 0x9084 0x542 0x419 0xb169 0x9076 0x567 0x404 0xb367 0x906b 0x58e 0x40c 0xb566 0x9058 0x5b5 0x3f2 0xb764 0x9038 0x5ec 0x3e4 0xb962 0x8ffc 0x633 0x3d4 0xbb60 0x8f62 0x64c 0x3bb 0xbd5f 0x8dc2 0x640 0x3d8 0xbf5d 0x8b8a 0x689 0x40f 0xc15b 0x887a 0x708 0x456 0xc35a 0x839a 0x853 0x51c 0xc558 0x7767 0x1912 0x5be>;
			battery1_profile_t2_num = <0x64>;
			battery1_profile_t2_col = <0x04>;
			battery1_profile_t2 = <0x00 0xadb5 0xd34 0xb18 0x1fe 0xad2c 0xd34 0xb2f 0x3fd 0xacb8 0xd32 0xb15 0x5fb 0xac4d 0xd21 0xabe 0x7f9 0xabe6 0xd0e 0xa46 0x9f8 0xab82 0xcfb 0x9dc 0xbf6 0xab1e 0xcd6 0x962 0xdf4 0xaab9 0xcc7 0x90a 0xff2 0xaa55 0xcae 0x8ae 0x11f1 0xa9e9 0xc94 0x85d 0x13ef 0xa97a 0xc7a 0x818 0x15ed 0xa909 0xc5e 0x7d0 0x17ec 0xa895 0xc43 0x78e 0x19ea 0xa821 0xc2a 0x747 0x1be8 0xa7ad 0xc1d 0x70c 0x1de7 0xa739 0xc11 0x6df 0x1fe5 0xa6bd 0xbf9 0x6b3 0x21e3 0xa63f 0xbdf 0x5d8 0x23e1 0xa5c1 0xbcf 0x604 0x25e0 0xa546 0xbcc 0x639 0x27de 0xa4c7 0xbbf 0x5d6 0x29dc 0xa448 0xbb0 0x60b 0x2bdb 0xa3ca 0xba3 0x5e7 0x2dd9 0xa34f 0xba9 0x5e3 0x2fd7 0xa2d3 0xba3 0x5cc 0x31d6 0xa256 0xb90 0x5dc 0x33d4 0xa1dd 0xb90 0x5d5 0x35d2 0xa164 0xb92 0x5c2 0x37d0 0xa0ef 0xb90 0x5d1 0x39cf 0xa07b 0xb86 0x5a8 0x3bcd 0xa008 0xb8a 0x5d2 0x3dcb 0x9f96 0xb97 0x5a5 0x3fca 0x9f25 0xb9c 0x5e1 0x41c8 0x9eb2 0xb90 0x5c3 0x43c6 0x9e44 0xb92 0x5cd 0x45c5 0x9dd4 0xb91 0x5ca 0x47c3 0x9d62 0xb90 0x5eb 0x49c1 0x9cee 0xb7a 0x5ad 0x4bc0 0x9c7a 0xb58 0x5dc 0x4dbe 0x9c03 0xb3a 0x5af 0x4fbc 0x9b85 0xb11 0x5f4 0x51ba 0x9b07 0xade 0x605 0x53b9 0x9a8c 0xaa9 0x629 0x55b7 0x9a1b 0xa74 0x628 0x57b5 0x99af 0xa4d 0x640 0x59b4 0x9947 0xa38 0x640 0x5bb2 0x98e4 0xa29 0x699 0x5db0 0x988b 0xa0f 0x677 0x5faf 0x9841 0xa0d 0x63b 0x61ad 0x97f3 0xa0d 0x68a 0x63ab 0x97ad 0xa15 0x68c 0x65a9 0x976c 0xa1c 0x690 0x67a8 0x972a 0xa22 0x69a 0x69a6 0x96f0 0xa2d 0x697 0x6ba4 0x96af 0xa2b 0x692 0x6da3 0x967a 0xa45 0x691 0x6fa1 0x9641 0xa4b 0x6a0 0x719f 0x960d 0xa53 0x6a8 0x739e 0x95de 0xa65 0x6a3 0x759c 0x95ad 0xa78 0x69a 0x779a 0x9579 0xa79 0x69a 0x7998 0x954f 0xa88 0x6c3 0x7b97 0x9525 0xaa0 0x6a7 0x7d95 0x94fb 0xabb 0x6b5 0x7f93 0x94d4 0xacf 0x6bd 0x8192 0x94ae 0xadc 0x6bc 0x8390 0x948a 0xae9 0x6c5 0x858e 0x9464 0xaf5 0x6cc 0x878d 0x9440 0xb04 0x6b9 0x898b 0x941f 0xb1c 0x6d8 0x8b89 0x9400 0xb2e 0x719 0x8d88 0x93de 0xb35 0x6ac 0x8f86 0x93ba 0xb38 0x6e2 0x9184 0x939b 0xb46 0x6e0 0x9382 0x937b 0xb62 0x6e9 0x9581 0x9356 0xb6f 0x6ea 0x977f 0x932d 0xb7c 0x6c4 0x997d 0x9306 0xb99 0x6e5 0x9b7c 0x92df 0xbc1 0x6c5 0x9d7a 0x92b3 0xbea 0x6f0 0x9f78 0x9284 0xc13 0x6dd 0xa177 0x9254 0xc55 0x6cc 0xa375 0x9211 0xc7d 0x6c2 0xa573 0x91d1 0xccc 0x6be 0xa771 0x918e 0xd29 0x6b1 0xa970 0x9148 0xd85 0x6a7 0xab6e 0x90fc 0xde5 0x6a6 0xad6c 0x90a8 0xe4e 0x690 0xaf6b 0x906e 0xed2 0x67c 0xb169 0x9046 0xf91 0x658 0xb367 0x9025 0x1087 0x627 0xb566 0x9002 0x11bf 0x613 0xb764 0x8fd0 0x134f 0x5f0 0xb962 0x8f7a 0x155a 0x562 0xbb60 0x8eec 0x1809 0x4ff 0xbd5f 0x8d96 0x1bbc 0x45f 0xbf5d 0x8b74 0x247b 0x37a 0xc15b 0x890e 0x363b 0x37a 0xc35a 0x87c1 0x41f3 0x37a 0xc558 0x87c1 0x41f3 0x37a>;
			battery1_profile_t3_num = <0x64>;
			battery1_profile_t3_col = <0x04>;
			battery1_profile_t3 = <0x00 0xadce 0x1838 0x1838 0x1fe 0xad25 0x1838 0x1838 0x3fd 0xac96 0x1859 0x1859 0x5fb 0xac1b 0x1824 0x1824 0x7f9 0xaba9 0x179b 0x179b 0x9f8 0xab3c 0x16e1 0x16e1 0xbf6 0xaad3 0x1628 0x1628 0xdf4 0xaa6e 0x1628 0x1628 0xff2 0xaa05 0x15f6 0x15f6 0x11f1 0xa998 0x15ad 0x15ad 0x13ef 0xa929 0x157e 0x157e 0x15ed 0xa8b9 0x154f 0x154f 0x17ec 0xa845 0x1509 0x1509 0x19ea 0xa7d0 0x14e0 0x14e0 0x1be8 0xa75d 0x14ab 0x14ab 0x1de7 0xa6e8 0x14a5 0x14a5 0x1fe5 0xa671 0x149c 0x149c 0x21e3 0xa5f5 0x148f 0x148f 0x23e1 0xa577 0x1487 0x1487 0x25e0 0xa4fb 0x1484 0x1484 0x27de 0xa47d 0x1479 0x1479 0x29dc 0xa404 0x1492 0x1492 0x2bdb 0xa386 0x1496 0x1496 0x2dd9 0xa30b 0x14a0 0x14a0 0x2fd7 0xa28f 0x149a 0x149a 0x31d6 0xa212 0x148b 0x148b 0x33d4 0xa199 0x1496 0x1496 0x35d2 0xa120 0x1498 0x1498 0x37d0 0xa0a6 0x1496 0x1496 0x39cf 0xa02d 0x1480 0x1480 0x3bcd 0x9fb3 0x1487 0x1487 0x3dcb 0x9f3a 0x1484 0x1484 0x3fca 0x9ec1 0x1460 0x1460 0x41c8 0x9e47 0x1446 0x1446 0x43c6 0x9dce 0x142c 0x142c 0x45c5 0x9d5a 0x1411 0x1411 0x47c3 0x9ce2 0x13f7 0x13f7 0x49c1 0x9c6c 0x13c5 0x13c5 0x4bc0 0x9bf5 0x1388 0x1388 0x4dbe 0x9b7d 0x1360 0x1360 0x4fbc 0x9b09 0x135d 0x135d 0x51ba 0x9a9b 0x130e 0x130e 0x53b9 0x9a31 0x12f7 0x12f7 0x55b7 0x99cb 0x12e9 0x12e9 0x57b5 0x9967 0x12cf 0x12cf 0x59b4 0x9908 0x12a8 0x12a8 0x5bb2 0x98b3 0x127e 0x127e 0x5db0 0x985f 0x1249 0x1249 0x5faf 0x9810 0x1222 0x1222 0x61ad 0x97c5 0x11f0 0x11f0 0x63ab 0x977b 0x11cc 0x11cc 0x65a9 0x9737 0x11bf 0x11bf 0x67a8 0x96f6 0x11b4 0x11b4 0x69a6 0x96b3 0x118c 0x118c 0x6ba4 0x967d 0x1156 0x1156 0x6da3 0x963e 0x111e 0x111e 0x6fa1 0x960b 0x1112 0x1112 0x719f 0x95d5 0x10ea 0x10ea 0x739e 0x95a2 0x10af 0x10af 0x759c 0x9577 0x107e 0x107e 0x779a 0x9547 0x1055 0x1055 0x7998 0x9518 0x1020 0x1020 0x7b97 0x94ed 0x1004 0x1004 0x7d95 0x94c7 0xff3 0xff3 0x7f93 0x949f 0xfe5 0xfe5 0x8192 0x9476 0xfd3 0xfd3 0x8390 0x9453 0xfc3 0xfc3 0x858e 0x9433 0xfde 0xfde 0x878d 0x9409 0xfcf 0xfcf 0x898b 0x93ec 0xfd8 0xfd8 0x8b89 0x93d1 0xff7 0xff7 0x8d88 0x93b7 0x101f 0x101f 0x8f86 0x939d 0x1043 0x1043 0x9184 0x9381 0x105d 0x105d 0x9382 0x935c 0x1079 0x1079 0x9581 0x9342 0x10c5 0x10c5 0x977f 0x931e 0x10f4 0x10f4 0x997d 0x92fd 0x114c 0x114c 0x9b7c 0x92d6 0x11b1 0x11b1 0x9d7a 0x92a8 0x1207 0x1207 0x9f78 0x927d 0x1273 0x1273 0xa177 0x9242 0x12e8 0x12e8 0xa375 0x920d 0x1383 0x1383 0xa573 0x91cd 0x1418 0x1418 0xa771 0x9188 0x14c6 0x14c6 0xa970 0x9142 0x159b 0x159b 0xab6e 0x90f8 0x1682 0x1682 0xad6c 0x90af 0x175a 0x175a 0xaf6b 0x9065 0x18b1 0x18b1 0xb169 0x9028 0x1a6b 0x1a6b 0xb367 0x8fed 0x1c7e 0x1c7e 0xb566 0x8fb5 0x1f38 0x1f38 0xb764 0x8f7a 0x2330 0x2330 0xb962 0x8f2b 0x296c 0x296c 0xbb60 0x8ec1 0x3390 0x3390 0xbd5f 0x8dfa 0x4ed5 0x4ed5 0xbf5d 0x8d72 0x502d 0x502d 0xc15b 0x8d72 0x502d 0x502d 0xc35a 0x8d72 0x502d 0x502d 0xc558 0x8d72 0x502d 0x502d>;
			battery1_profile_t4_num = <0x64>;
			battery1_profile_t4_col = <0x04>;
			battery1_profile_t4 = <0x00 0xade3 0x27c7 0x27c7 0x1fe 0xad10 0x27c7 0x27c7 0x3fd 0xac62 0x27f9 0x27f9 0x5fb 0xabca 0x27ef 0x27ef 0x7f9 0xab3c 0x27b7 0x27b7 0x9f8 0xaab5 0x2779 0x2779 0xbf6 0xaa31 0x273f 0x273f 0xdf4 0xa9b0 0x2710 0x2710 0xff2 0xa92f 0x26cf 0x26cf 0x11f1 0xa8ae 0x269c 0x269c 0x13ef 0xa82e 0x2663 0x2663 0x15ed 0xa7af 0x2628 0x2628 0x17ec 0xa72f 0x25f6 0x25f6 0x19ea 0xa6b3 0x25cb 0x25cb 0x1be8 0xa634 0x257c 0x257c 0x1de7 0xa5b8 0x2546 0x2546 0x1fe5 0xa53a 0x250d 0x250d 0x21e3 0xa4bd 0x24d8 0x24d8 0x23e1 0xa43f 0x24a4 0x24a4 0x25e0 0xa3bf 0x246a 0x246a 0x27de 0xa343 0x2444 0x2444 0x29dc 0xa2ca 0x2415 0x2415 0x2bdb 0xa24f 0x23ed 0x23ed 0x2dd9 0xa1d3 0x23ca 0x23ca 0x2fd7 0xa157 0x23a6 0x23a6 0x31d6 0xa0dc 0x2383 0x2383 0x33d4 0xa063 0x2369 0x2369 0x35d2 0x9fea 0x2355 0x2355 0x37d0 0x9f70 0x232e 0x232e 0x39cf 0x9ef7 0x2311 0x2311 0x3bcd 0x9e7c 0x22f8 0x22f8 0x3dcb 0x9e01 0x22d7 0x22d7 0x3fca 0x9d88 0x22b2 0x22b2 0x41c8 0x9d0f 0x2297 0x2297 0x43c6 0x9c9b 0x227d 0x227d 0x45c5 0x9c27 0x226a 0x226a 0x47c3 0x9bb5 0x2250 0x2250 0x49c1 0x9b45 0x223a 0x223a 0x4bc0 0x9ad8 0x222b 0x222b 0x4dbe 0x9a6f 0x2222 0x2222 0x4fbc 0x9a09 0x220f 0x220f 0x51ba 0x99a4 0x2200 0x2200 0x53b9 0x9943 0x21fb 0x21fb 0x55b7 0x98e5 0x21f8 0x21f8 0x57b5 0x988b 0x21fb 0x21fb 0x59b4 0x9834 0x2205 0x2205 0x5bb2 0x97de 0x220f 0x220f 0x5db0 0x978f 0x2215 0x2215 0x5faf 0x9743 0x2224 0x2224 0x61ad 0x96fb 0x2247 0x2247 0x63ab 0x96b3 0x2262 0x2262 0x65a9 0x966f 0x2276 0x2276 0x67a8 0x962f 0x2290 0x2290 0x69a6 0x95f2 0x22b3 0x22b3 0x6ba4 0x95b7 0x22cf 0x22cf 0x6da3 0x957f 0x22f7 0x22f7 0x6fa1 0x954c 0x2323 0x2323 0x719f 0x951b 0x234d 0x234d 0x739e 0x94ed 0x237d 0x237d 0x759c 0x94c3 0x23bc 0x23bc 0x779a 0x949d 0x2403 0x2403 0x7998 0x9476 0x243f 0x243f 0x7b97 0x9458 0x24aa 0x24aa 0x7d95 0x9437 0x2515 0x2515 0x7f93 0x9417 0x2589 0x2589 0x8192 0x93f8 0x2604 0x2604 0x8390 0x93d7 0x2682 0x2682 0x858e 0x93ba 0x271b 0x271b 0x878d 0x939b 0x27bf 0x27bf 0x898b 0x937b 0x2872 0x2872 0x8b89 0x9359 0x2941 0x2941 0x8d88 0x9337 0x2a20 0x2a20 0x8f86 0x9313 0x2b02 0x2b02 0x9184 0x92ec 0x2bef 0x2bef 0x9382 0x92c7 0x2d03 0x2d03 0x9581 0x929d 0x2e3e 0x2e3e 0x977f 0x9271 0x2f7b 0x2f7b 0x997d 0x9244 0x30d7 0x30d7 0x9b7c 0x9215 0x3253 0x3253 0x9d7a 0x91e2 0x33ed 0x33ed 0x9f78 0x91ad 0x35b1 0x35b1 0xa177 0x9176 0x379a 0x379a 0xa375 0x913c 0x39bd 0x39bd 0xa573 0x9104 0x3c0a 0x3c0a 0xa771 0x90c8 0x3e9d 0x3e9d 0xa970 0x9089 0x418b 0x418b 0xab6e 0x904a 0x44f3 0x44f3 0xad6c 0x900a 0x491a 0x491a 0xaf6b 0x8fce 0x4e83 0x4e83 0xb169 0x8f9e 0x53de 0x53de 0xb367 0x8f90 0x5578 0x5578 0xb566 0x8f90 0x5578 0x5578 0xb764 0x8f90 0x5578 0x5578 0xb962 0x8f90 0x5578 0x5578 0xbb60 0x8f90 0x5578 0x5578 0xbd5f 0x8f90 0x5578 0x5578 0xbf5d 0x8f90 0x5578 0x5578 0xc15b 0x8f90 0x5578 0x5578 0xc35a 0x8f90 0x5578 0x5578 0xc558 0x8f90 0x5578 0x5578>;
			serialnum_2 = "SB18E06276";
			battery2_profile_t0_num = <0x64>;
			battery2_profile_t0_col = <0x03>;
			battery2_profile_t0 = <0x00 0xadbb 0x343 0x1ff 0xacf5 0x343 0x3fd 0xac54 0x345 0x5fc 0xabc9 0x345 0x7fb 0xab4a 0x349 0x9f9 0xaad2 0x34d 0xbf8 0xaa5f 0x34f 0xdf7 0xa9ed 0x35b 0xff5 0xa97b 0x35c 0x11f4 0xa906 0x357 0x13f3 0xa88f 0x358 0x15f1 0xa818 0x35f 0x17f0 0xa7a0 0x364 0x19ee 0xa725 0x364 0x1bed 0xa6a8 0x363 0x1dec 0xa62c 0x363 0x1fea 0xa5af 0x365 0x21e9 0xa530 0x366 0x23e8 0xa4b1 0x363 0x25e6 0xa433 0x35d 0x27e5 0xa3b7 0x364 0x29e4 0xa33e 0x36c 0x2be2 0xa2c4 0x371 0x2de1 0xa24b 0x372 0x2fe0 0xa1d3 0x36f 0x31de 0xa15c 0x36b 0x33dd 0xa0e6 0x36d 0x35dc 0xa078 0x37a 0x37da 0xa004 0x376 0x39d9 0x9f94 0x375 0x3bd8 0x9f27 0x378 0x3dd6 0x9ebb 0x37d 0x3fd5 0x9e52 0x382 0x41d4 0x9de9 0x383 0x43d2 0x9d88 0x392 0x45d1 0x9d24 0x393 0x47d0 0x9cc5 0x3a1 0x49ce 0x9c69 0x3ad 0x4bcd 0x9c0d 0x3b6 0x4dcb 0x9bb1 0x3c5 0x4fca 0x9b5b 0x3db 0x51c9 0x9b04 0x3fb 0x53c7 0x9a9f 0x40c 0x55c6 0x9a15 0x3dc 0x57c5 0x997b 0x396 0x59c3 0x98f3 0x369 0x5bc2 0x988d 0x364 0x5dc1 0x9839 0x363 0x5fbf 0x97ec 0x35d 0x61be 0x97a6 0x357 0x63bd 0x9763 0x350 0x65bb 0x9725 0x350 0x67ba 0x96ec 0x355 0x69b9 0x96b2 0x356 0x6bb7 0x967e 0x35e 0x6db6 0x9646 0x34e 0x6fb5 0x9613 0x351 0x71b3 0x95e4 0x358 0x73b2 0x95b7 0x35f 0x75b1 0x958a 0x362 0x77af 0x955d 0x35d 0x79ae 0x9536 0x36a 0x7bad 0x950e 0x365 0x7dab 0x94e7 0x368 0x7faa 0x94c4 0x373 0x81a8 0x94a3 0x37e 0x83a7 0x9481 0x386 0x85a6 0x9461 0x39b 0x87a4 0x943f 0x3a1 0x89a3 0x940f 0x3a2 0x8ba2 0x93c4 0x375 0x8da0 0x9371 0x34e 0x8f9f 0x932a 0x34a 0x919e 0x92f4 0x358 0x939c 0x92c4 0x36d 0x959b 0x928f 0x36d 0x979a 0x925d 0x362 0x9998 0x922c 0x35c 0x9b97 0x9201 0x366 0x9d96 0x91da 0x379 0x9f94 0x91ac 0x383 0xa193 0x9172 0x37d 0xa392 0x912e 0x36f 0xa590 0x90ee 0x371 0xa78f 0x90ad 0x37f 0xa98e 0x9063 0x372 0xab8c 0x9018 0x341 0xad8b 0x8fec 0x32f 0xaf89 0x8fe2 0x357 0xb188 0x8fd8 0x3a3 0xb387 0x8fca 0x400 0xb585 0x8fac 0x458 0xb784 0x8f46 0x457 0xb983 0x8e47 0x3d9 0xbb81 0x8c7e 0x3c0 0xbd80 0x8a05 0x3ef 0xbf7f 0x8670 0x423 0xc17d 0x7fa7 0x655 0xc37c 0x72e6 0xde5 0xc57b 0x72e6 0xde5>;
			battery2_profile_t1_num = <0x64>;
			battery2_profile_t1_col = <0x03>;
			battery2_profile_t1 = <0x00 0xae0f 0x492 0x1ff 0xad7b 0x492 0x3fd 0xace5 0x487 0x5fc 0xac5e 0x47f 0x7fb 0xabe6 0x47f 0x9f9 0xab74 0x47f 0xbf8 0xab03 0x474 0xdf7 0xaa95 0x474 0xff5 0xaa23 0x46c 0x11f4 0xa9b1 0x46c 0x13f3 0xa93f 0x46c 0x15f1 0xa8c8 0x469 0x17f0 0xa84e 0x461 0x19ee 0xa7d2 0x45b 0x1bed 0xa756 0x45d 0x1dec 0xa6d8 0x45e 0x1fea 0xa659 0x45c 0x21e9 0xa5da 0x45b 0x23e8 0xa55b 0x459 0x25e6 0xa4dd 0x453 0x27e5 0xa45f 0x44f 0x29e4 0xa3e3 0x453 0x2be2 0xa368 0x459 0x2de1 0xa2ee 0x458 0x2fe0 0xa274 0x452 0x31de 0xa1fd 0x44f 0x33dd 0xa187 0x457 0x35dc 0xa110 0x45b 0x37da 0xa09c 0x451 0x39d9 0xa02e 0x45e 0x3bd8 0x9fbf 0x468 0x3dd6 0x9f4f 0x46b 0x3fd5 0x9ee5 0x470 0x41d4 0x9e7d 0x47d 0x43d2 0x9e14 0x491 0x45d1 0x9daf 0x498 0x47d0 0x9d4f 0x4a5 0x49ce 0x9cf0 0x4c1 0x4bcd 0x9c92 0x4db 0x4dcb 0x9c37 0x4e5 0x4fca 0x9bdc 0x500 0x51c9 0x9b80 0x528 0x53c7 0x9b21 0x533 0x55c6 0x9ab2 0x51e 0x57c5 0x9a2b 0x4e2 0x59c3 0x9998 0x48d 0x5bc2 0x9912 0x441 0x5dc1 0x98a9 0x41f 0x5fbf 0x9851 0x41d 0x61be 0x9803 0x412 0x63bd 0x97bd 0x409 0x65bb 0x977d 0x409 0x67ba 0x973e 0x40c 0x69b9 0x9703 0x407 0x6bb7 0x96d0 0x40d 0x6db6 0x9699 0x414 0x6fb5 0x9666 0x410 0x71b3 0x9635 0x40d 0x73b2 0x9608 0x414 0x75b1 0x95de 0x421 0x77af 0x95b1 0x426 0x79ae 0x9587 0x420 0x7bad 0x9564 0x42b 0x7dab 0x953e 0x42e 0x7faa 0x951b 0x432 0x81a8 0x94fa 0x438 0x83a7 0x94d8 0x441 0x85a6 0x94bb 0x453 0x87a4 0x949c 0x453 0x89a3 0x947e 0x466 0x8ba2 0x945e 0x471 0x8da0 0x9439 0x46d 0x8f9f 0x940e 0x45a 0x919e 0x93dc 0x443 0x939c 0x93ac 0x436 0x959b 0x937d 0x429 0x979a 0x934e 0x42c 0x9998 0x931e 0x42a 0x9b97 0x92f2 0x426 0x9d96 0x92cb 0x426 0x9f94 0x92a6 0x430 0xa193 0x927b 0x443 0xa392 0x9242 0x439 0xa590 0x9203 0x43a 0xa78f 0x91c4 0x439 0xa98e 0x9185 0x43d 0xab8c 0x913d 0x446 0xad8b 0x90e5 0x42b 0xaf89 0x90b4 0x427 0xb188 0x90a4 0x43d 0xb387 0x9096 0x44f 0xb585 0x9085 0x46e 0xb784 0x906d 0x4ac 0xb983 0x9037 0x4f8 0xbb81 0x8fa1 0x4f6 0xbd80 0x8deb 0x4ad 0xbf7f 0x8b91 0x4d2 0xc17d 0x8842 0x539 0xc37c 0x826f 0x7c6 0xc57b 0x7505 0x132c>;
			battery2_profile_t2_num = <0x64>;
			battery2_profile_t2_col = <0x03>;
			battery2_profile_t2 = <0x00 0xade6 0x78a 0x1ff 0xad2d 0x78a 0x3fd 0xac9e 0x785 0x5fc 0xac25 0x772 0x7fb 0xabb8 0x75d 0x9f9 0xab4e 0x74d 0xbf8 0xaae5 0x73c 0xdf7 0xaa7e 0x735 0xff5 0xaa12 0x723 0x11f4 0xa9a2 0x710 0x13f3 0xa932 0x703 0x15f1 0xa8c1 0x6f9 0x17f0 0xa84c 0x6eb 0x19ee 0xa7d2 0x6dd 0x1bed 0xa756 0x6d2 0x1dec 0xa6da 0x6cb 0x1fea 0xa65c 0x6bf 0x21e9 0xa5dd 0x6b1 0x23e8 0xa560 0x6a9 0x25e6 0xa4e4 0x6a8 0x27e5 0xa465 0x6a1 0x29e4 0xa3e9 0x6a2 0x2be2 0xa36c 0x69a 0x2de1 0xa2f1 0x699 0x2fe0 0xa276 0x697 0x31de 0xa1fd 0x695 0x33dd 0xa187 0x69b 0x35dc 0xa113 0x6a1 0x37da 0xa09f 0x6ae 0x39d9 0xa02b 0x6b1 0x3bd8 0x9fb8 0x6b1 0x3dd6 0x9f4a 0x6b9 0x3fd5 0x9ee0 0x6cb 0x41d4 0x9e75 0x6da 0x43d2 0x9e0e 0x6ee 0x45d1 0x9da4 0x6fb 0x47d0 0x9d40 0x711 0x49ce 0x9cdd 0x723 0x4bcd 0x9c7b 0x736 0x4dcb 0x9c1b 0x74e 0x4fca 0x9bb7 0x75a 0x51c9 0x9b50 0x75a 0x53c7 0x9ae0 0x74a 0x55c6 0x9a5e 0x708 0x57c5 0x99d4 0x6b5 0x59c3 0x9950 0x66b 0x5bc2 0x98d7 0x630 0x5dc1 0x986e 0x60e 0x5fbf 0x9816 0x5ff 0x61be 0x97cb 0x5f9 0x63bd 0x9782 0x5f3 0x65bb 0x973f 0x5ef 0x67ba 0x9700 0x5ee 0x69b9 0x96c4 0x5ee 0x6bb7 0x968a 0x5f0 0x6db6 0x9652 0x5f0 0x6fb5 0x961d 0x5eb 0x71b3 0x95ed 0x5f4 0x73b2 0x95bf 0x5fe 0x75b1 0x958f 0x5fd 0x77af 0x9561 0x600 0x79ae 0x9539 0x60d 0x7bad 0x950f 0x60e 0x7dab 0x94ea 0x61c 0x7faa 0x94c5 0x622 0x81a8 0x94a0 0x624 0x83a7 0x947e 0x62f 0x85a6 0x9461 0x63b 0x87a4 0x943f 0x63d 0x89a3 0x9421 0x63d 0x8ba2 0x9406 0x646 0x8da0 0x93e9 0x649 0x8f9f 0x93c9 0x644 0x919e 0x93a8 0x641 0x939c 0x9384 0x636 0x959b 0x9357 0x627 0x979a 0x9326 0x615 0x9998 0x92f6 0x60e 0x9b97 0x92c9 0x611 0x9d96 0x92a0 0x61a 0x9f94 0x927a 0x628 0xa193 0x924a 0x635 0xa392 0x920c 0x640 0xa590 0x91c9 0x649 0xa78f 0x9189 0x654 0xa98e 0x9147 0x664 0xab8c 0x90f9 0x677 0xad8b 0x909e 0x682 0xaf89 0x906c 0x69e 0xb188 0x9051 0x6c3 0xb387 0x9039 0x6f4 0xb585 0x901f 0x737 0xb784 0x8ff9 0x79a 0xb983 0x8fb1 0x830 0xbb81 0x8f0a 0x8f8 0xbd80 0x8d2f 0xa13 0xbf7f 0x8a96 0xdd9 0xc17d 0x86c7 0x2005 0xc37c 0x817f 0x324e 0xc57b 0x7e29 0x2a06>;
			battery2_profile_t3_num = <0x64>;
			battery2_profile_t3_col = <0x03>;
			battery2_profile_t3 = <0x00 0xae56 0xc62 0x1ff 0xad79 0xc62 0x3fd 0xacd8 0xc5d 0x5fc 0xac55 0xc44 0x7fb 0xabe0 0xc29 0x9f9 0xab74 0xc14 0xbf8 0xab0c 0xbf8 0xdf7 0xaaa0 0xbdf 0xff5 0xaa37 0xbc5 0x11f4 0xa9cd 0xbb6 0x13f3 0xa95f 0xb9c 0x15f1 0xa8ec 0xb7d 0x17f0 0xa879 0xb65 0x19ee 0xa807 0xb59 0x1bed 0xa78a 0xb37 0x1dec 0xa711 0xb28 0x1fea 0xa694 0xb0c 0x21e9 0xa615 0xaf2 0x23e8 0xa597 0xae0 0x25e6 0xa51a 0xad1 0x27e5 0xa499 0xabe 0x29e4 0xa41d 0xaba 0x2be2 0xa3a3 0xab2 0x2de1 0xa328 0xaab 0x2fe0 0xa2ac 0xaa4 0x31de 0xa232 0xaa2 0x33dd 0xa1bb 0xaa7 0x35dc 0xa142 0xaa3 0x37da 0xa0cb 0xa9a 0x39d9 0xa058 0xaa3 0x3bd8 0x9fe7 0xaad 0x3dd6 0x9f76 0xab3 0x3fd5 0x9f05 0xabb 0x41d4 0x9e99 0xac9 0x43d2 0x9e2a 0xacf 0x45d1 0x9dc0 0xae1 0x47d0 0x9d59 0xaf0 0x49ce 0x9cf0 0xaf9 0x4bcd 0x9c88 0xaff 0x4dcb 0x9c20 0xb01 0x4fca 0x9bb3 0xaf4 0x51c9 0x9b3f 0xada 0x53c7 0x9ac4 0xaa3 0x55c6 0x9a46 0xa67 0x57c5 0x99c7 0xa25 0x59c3 0x994c 0x9e6 0x5bc2 0x98da 0x9b8 0x5dc1 0x9871 0x992 0x5fbf 0x9819 0x989 0x61be 0x97c6 0x97d 0x63bd 0x977c 0x97a 0x65bb 0x9736 0x97a 0x67ba 0x96f3 0x97c 0x69b9 0x96b5 0x984 0x6bb7 0x967a 0x988 0x6db6 0x9640 0x988 0x6fb5 0x9608 0x988 0x71b3 0x95d4 0x991 0x73b2 0x95a4 0x99f 0x75b1 0x9577 0x9ac 0x77af 0x9548 0x9b8 0x79ae 0x951a 0x9c5 0x7bad 0x94f3 0x9d4 0x7dab 0x94cb 0x9e1 0x7faa 0x94a5 0x9ee 0x81a8 0x9481 0x9f8 0x83a7 0x945f 0xa01 0x85a6 0x943f 0xa14 0x87a4 0x9420 0xa1d 0x89a3 0x9407 0xa34 0x8ba2 0x93eb 0xa45 0x8da0 0x93d2 0xa58 0x8f9f 0x93bc 0xa70 0x919e 0x93a4 0xa87 0x939c 0x938a 0xaa7 0x959b 0x936a 0xab4 0x979a 0x9342 0xac6 0x9998 0x9315 0xada 0x9b97 0x92e5 0xaf5 0x9d96 0x92b6 0xb1a 0x9f94 0x9286 0xb4a 0xa193 0x9251 0xb92 0xa392 0x9213 0xbe8 0xa590 0x91c9 0xc39 0xa78f 0x9183 0xca7 0xa98e 0x913d 0xd32 0xab8c 0x90ed 0xdd1 0xad8b 0x908b 0xe8d 0xaf89 0x9035 0xf80 0xb188 0x9004 0x10e4 0xb387 0x8fd9 0x12dc 0xb585 0x8fac 0x15cf 0xb784 0x8f74 0x1ac9 0xb983 0x8f21 0x25f0 0xbb81 0x8e91 0x423c 0xbd80 0x8d14 0x4f44 0xbf7f 0x8b9b 0x4ba3 0xc17d 0x8b9b 0x4ba3 0xc37c 0x8b9b 0x4ba3 0xc57b 0x8b9b 0x4ba3>;
			battery2_profile_t4_num = <0x64>;
			battery2_profile_t4_col = <0x03>;
			battery2_profile_t4 = <0x00 0xaea3 0x1aea 0x1ff 0xad87 0x1aea 0x3fd 0xacb8 0x1ade 0x5fc 0xac15 0x1ac0 0x7fb 0xab8b 0x1a96 0x9f9 0xab0b 0x1a64 0xbf8 0xaa92 0x1a27 0xdf7 0xaa1c 0x19e7 0xff5 0xa9aa 0x19af 0x11f4 0xa936 0x197b 0x13f3 0xa8c3 0x193f 0x15f1 0xa84d 0x18fd 0x17f0 0xa7d6 0x18c0 0x19ee 0xa760 0x1893 0x1bed 0xa6ec 0x185c 0x1dec 0xa673 0x1828 0x1fea 0xa5fa 0x17ea 0x21e9 0xa582 0x17b7 0x23e8 0xa50a 0x178b 0x25e6 0xa491 0x1756 0x27e5 0xa41a 0x172e 0x29e4 0xa3a1 0x1701 0x2be2 0xa32a 0x16e3 0x2de1 0xa2b1 0x16c0 0x2fe0 0xa239 0x1699 0x31de 0xa1c3 0x1677 0x33dd 0xa14f 0x1663 0x35dc 0xa0db 0x1647 0x37da 0xa067 0x162e 0x39d9 0x9ff5 0x1620 0x3bd8 0x9f84 0x1609 0x3dd6 0x9f12 0x15f4 0x3fd5 0x9ea1 0x15e7 0x41d4 0x9e30 0x15d5 0x43d2 0x9dc4 0x15cf 0x45d1 0x9d52 0x15ad 0x47d0 0x9ce1 0x159a 0x49ce 0x9c70 0x1586 0x4bcd 0x9bfd 0x1564 0x4dcb 0x9b88 0x1536 0x4fca 0x9b0f 0x1508 0x51c9 0x9a95 0x14cd 0x53c7 0x9a21 0x14a4 0x55c6 0x99ae 0x1476 0x57c5 0x993f 0x1452 0x59c3 0x98d6 0x1433 0x5bc2 0x9873 0x140e 0x5dc1 0x9817 0x13fb 0x5fbf 0x97c0 0x13ee 0x61be 0x9770 0x13e7 0x63bd 0x9725 0x13f1 0x65bb 0x96df 0x1401 0x67ba 0x969c 0x140e 0x69b9 0x965d 0x141d 0x6bb7 0x9621 0x142a 0x6db6 0x95e9 0x1443 0x6fb5 0x95b1 0x1457 0x71b3 0x957b 0x146b 0x73b2 0x954a 0x148a 0x75b1 0x951e 0x14b4 0x77af 0x94f1 0x14c8 0x79ae 0x94c3 0x14e8 0x7bad 0x94a0 0x151b 0x7dab 0x947c 0x154c 0x7faa 0x945c 0x1580 0x81a8 0x943f 0x15bf 0x83a7 0x9425 0x1607 0x85a6 0x940e 0x164c 0x87a4 0x93f9 0x16b0 0x89a3 0x93e2 0x170c 0x8ba2 0x93cc 0x1779 0x8da0 0x93b5 0x17f6 0x8f9f 0x939c 0x1881 0x919e 0x937f 0x191c 0x939c 0x9362 0x19c7 0x959b 0x933d 0x1a7b 0x979a 0x9318 0x1b46 0x9998 0x92f0 0x1c29 0x9b97 0x92c2 0x1d20 0x9d96 0x928e 0x1e2e 0x9f94 0x9256 0x1f61 0xa193 0x9219 0x20c1 0xa392 0x91d3 0x2247 0xa590 0x918c 0x2429 0xa78f 0x9143 0x264f 0xa98e 0x90f7 0x28d5 0xab8c 0x90a6 0x2bf4 0xad8b 0x904d 0x2fd9 0xaf89 0x8ff7 0x3526 0xb188 0x8fba 0x3c7f 0xb387 0x8f8c 0x4734 0xb585 0x8f64 0x5345 0xb784 0x8f32 0x548c 0xb983 0x8ed7 0x53aa 0xbb81 0x8ed3 0x53a0 0xbd80 0x8ed3 0x53a0 0xbf7f 0x8ed3 0x53a0 0xc17d 0x8ed3 0x53a0 0xc37c 0x8ed3 0x53a0 0xc57b 0x8ed3 0x53a0>;
			serialnum_3 = "SB18E04471";
			battery3_profile_t0_num = <0x64>;
			battery3_profile_t0_col = <0x04>;
			battery3_profile_t0 = <0x00 0xaccf 0x355 0x355 0x1fe 0xac66 0x355 0x355 0x3fd 0xabfc 0x354 0x354 0x5fb 0xab96 0x35e 0x35e 0x7f9 0xab30 0x360 0x360 0x9f8 0xaac5 0x356 0x356 0xbf6 0xaa56 0x356 0x356 0xdf4 0xa9ed 0x363 0x363 0xff2 0xa97a 0x357 0x357 0x11f1 0xa905 0x354 0x354 0x13ef 0xa894 0x35c 0x35c 0x15ed 0xa822 0x364 0x364 0x17ec 0xa7a9 0x369 0x369 0x19ea 0xa72f 0x372 0x372 0x1be8 0xa6b0 0x365 0x365 0x1de7 0xa636 0x371 0x371 0x1fe5 0xa5b9 0x375 0x375 0x21e3 0xa53b 0x374 0x374 0x23e1 0xa4bb 0x36e 0x36e 0x25e0 0xa43c 0x367 0x367 0x27de 0xa3c3 0x375 0x375 0x29dc 0xa344 0x375 0x375 0x2bdb 0xa2ca 0x373 0x373 0x2dd9 0xa251 0x374 0x374 0x2fd7 0xa1d8 0x374 0x374 0x31d6 0xa160 0x377 0x377 0x33d4 0xa0eb 0x382 0x382 0x35d2 0xa072 0x373 0x373 0x37d0 0xa003 0x381 0x381 0x39cf 0x9f99 0x398 0x398 0x3bcd 0x9f2c 0x3a3 0x3a3 0x3dcb 0x9ebf 0x3a9 0x3a9 0x3fca 0x9e55 0x3b1 0x3b1 0x41c8 0x9dec 0x3b2 0x3b2 0x43c6 0x9d82 0x3bf 0x3bf 0x45c5 0x9d23 0x3d9 0x3d9 0x47c3 0x9cc0 0x3ea 0x3ea 0x49c1 0x9c5f 0x405 0x405 0x4bc0 0x9bfb 0x422 0x422 0x4dbe 0x9b8d 0x424 0x424 0x4fbc 0x9b0e 0x3fd 0x3fd 0x51ba 0x9a70 0x3ad 0x3ad 0x53b9 0x99df 0x369 0x369 0x55b7 0x996a 0x34c 0x34c 0x57b5 0x990c 0x34c 0x34c 0x59b4 0x98bb 0x355 0x355 0x5bb2 0x9870 0x354 0x354 0x5db0 0x9821 0x354 0x354 0x5faf 0x97e2 0x361 0x361 0x61ad 0x979e 0x359 0x359 0x63ab 0x975d 0x34c 0x34c 0x65a9 0x9720 0x34b 0x34b 0x67a8 0x96e6 0x350 0x350 0x69a6 0x96ac 0x343 0x343 0x6ba4 0x9671 0x345 0x345 0x6da3 0x9641 0x352 0x352 0x6fa1 0x9612 0x360 0x360 0x719f 0x95df 0x35d 0x35d 0x739e 0x95af 0x35a 0x35a 0x759c 0x9584 0x367 0x367 0x779a 0x955a 0x373 0x373 0x7998 0x9530 0x375 0x375 0x7b97 0x950a 0x37f 0x37f 0x7d95 0x94e6 0x395 0x395 0x7f93 0x94be 0x39a 0x39a 0x8192 0x9495 0x396 0x396 0x8390 0x9471 0x3a7 0x3a7 0x858e 0x944c 0x3c1 0x3c1 0x878d 0x9402 0x38c 0x38c 0x898b 0x93af 0x36e 0x36e 0x8b89 0x9365 0x35c 0x35c 0x8d88 0x932b 0x361 0x361 0x8f86 0x92f8 0x36a 0x36a 0x9184 0x92bf 0x356 0x356 0x9382 0x9290 0x363 0x363 0x9581 0x925b 0x357 0x357 0x977f 0x922e 0x35f 0x35f 0x997d 0x9204 0x36d 0x36d 0x9b7c 0x91d8 0x37b 0x37b 0x9d7a 0x91a4 0x37d 0x37d 0x9f78 0x9165 0x366 0x366 0xa177 0x9120 0x364 0x364 0xa375 0x90e5 0x371 0x371 0xa573 0x90a0 0x373 0x373 0xa771 0x9053 0x356 0x356 0xa970 0x9016 0x33b 0x33b 0xab6e 0x8ffa 0x348 0x348 0xad6c 0x8fea 0x356 0x356 0xaf6b 0x8fdf 0x38b 0x38b 0xb169 0x8fd0 0x3cc 0x3cc 0xb367 0x8fb1 0x421 0x421 0xb566 0x8f45 0x41c 0x41c 0xb764 0x8e42 0x3d2 0x3d2 0xb962 0x8c85 0x3b5 0x3b5 0xbb60 0x8a41 0x3cf 0x3cf 0xbd5f 0x8710 0x42c 0x42c 0xbf5d 0x81ed 0x52a 0x52a 0xc15b 0x7b0c 0xfbe 0xfbe 0xc35a 0x7704 0x181a 0x181a 0xc558 0x7704 0x181a 0x181a>;
			battery3_profile_t1_num = <0x64>;
			battery3_profile_t1_col = <0x04>;
			battery3_profile_t1 = <0x00 0xadc7 0x573 0x4f6 0x1fe 0xad34 0x573 0x532 0x3fd 0xacba 0x57e 0x50c 0x5fb 0xac4d 0x582 0x4dd 0x7f9 0xabe6 0x57d 0x4c1 0x9f8 0xab82 0x581 0x4a0 0xbf6 0xab1d 0x5a3 0x449 0xdf4 0xaab4 0x5a3 0x45d 0xff2 0xaa45 0x594 0x46c 0x11f1 0xa9d6 0x591 0x462 0x13ef 0xa967 0x589 0x456 0x15ed 0xa8f7 0x583 0x448 0x17ec 0xa885 0x58e 0x438 0x19ea 0xa81b 0x5b0 0x42e 0x1be8 0xa7a1 0x594 0x42e 0x1de7 0xa723 0x586 0x424 0x1fe5 0xa6a4 0x582 0x41e 0x21e3 0xa629 0x58a 0x403 0x23e1 0xa5ad 0x593 0x40a 0x25e0 0xa52c 0x58e 0x3fd 0x27de 0xa4a8 0x582 0x400 0x29dc 0xa42f 0x58f 0x3ff 0x2bdb 0xa3b1 0x593 0x3f3 0x2dd9 0xa336 0x59c 0x3fb 0x2fd7 0xa2ba 0x59b 0x3dd 0x31d6 0xa23d 0x596 0x3e5 0x33d4 0xa1c5 0x5a4 0x3e4 0x35d2 0xa151 0x5b1 0x3dc 0x37d0 0xa0dd 0x5b2 0x3e0 0x39cf 0xa069 0x5a6 0x3de 0x3bcd 0x9ff5 0x599 0x3c1 0x3dcb 0x9f86 0x59f 0x3dc 0x3fca 0x9f1c 0x5b8 0x3e4 0x41c8 0x9eb2 0x5d0 0x3c1 0x43c6 0x9e44 0x5d2 0x3d4 0x45c5 0x9dda 0x5ea 0x3d4 0x47c3 0x9d74 0x603 0x3e3 0x49c1 0x9d0d 0x615 0x3d8 0x4bc0 0x9ca5 0x61d 0x3af 0x4dbe 0x9c3f 0x61d 0x3dd 0x4fbc 0x9bd0 0x61b 0x3e3 0x51ba 0x9b51 0x5f5 0x3e2 0x53b9 0x9ac9 0x5ac 0x3d3 0x55b7 0x9a44 0x56f 0x3f0 0x57b5 0x99c5 0x53a 0x41a 0x59b4 0x9953 0x50d 0x41b 0x5bb2 0x98f0 0x4f4 0x434 0x5db0 0x9897 0x4e7 0x442 0x5faf 0x984d 0x4da 0x417 0x61ad 0x9803 0x4e2 0x42e 0x63ab 0x97c0 0x4ef 0x442 0x65a9 0x977e 0x4f0 0x43c 0x67a8 0x973c 0x4eb 0x438 0x69a6 0x9703 0x4f6 0x442 0x6ba4 0x96c8 0x4f6 0x438 0x6da3 0x9693 0x4f6 0x424 0x6fa1 0x9662 0x500 0x43e 0x719f 0x962f 0x505 0x432 0x739e 0x95fd 0x50a 0x434 0x759c 0x95cd 0x515 0x42e 0x779a 0x959f 0x517 0x426 0x7998 0x957a 0x524 0x42a 0x7b97 0x9551 0x533 0x408 0x7d95 0x9526 0x53f 0x428 0x7f93 0x9502 0x54c 0x40b 0x8192 0x94e0 0x559 0x416 0x8390 0x94bb 0x55f 0x44f 0x858e 0x9496 0x555 0x3e5 0x878d 0x9472 0x548 0x410 0x898b 0x944c 0x539 0x429 0x8b89 0x9424 0x536 0x410 0x8d88 0x93f8 0x529 0x415 0x8f86 0x93ca 0x512 0x41f 0x9184 0x939f 0x50b 0x41a 0x9382 0x9375 0x527 0x452 0x9581 0x9341 0x50d 0x429 0x977f 0x9310 0x4fd 0x41a 0x997d 0x92e4 0x500 0x448 0x9b7c 0x92ba 0x502 0x40b 0x9d7a 0x9290 0x503 0x42f 0x9f78 0x9265 0x526 0x429 0xa177 0x923b 0x526 0x429 0xa375 0x91fe 0x526 0x429 0xa573 0x91be 0x52f 0x41f 0xa771 0x9182 0x53c 0x419 0xa970 0x9144 0x54e 0x424 0xab6e 0x90fb 0x55c 0x40f 0xad6c 0x90a3 0x535 0x41a 0xaf6b 0x9084 0x542 0x419 0xb169 0x9076 0x567 0x404 0xb367 0x906b 0x58e 0x40c 0xb566 0x9058 0x5b5 0x3f2 0xb764 0x9038 0x5ec 0x3e4 0xb962 0x8ffc 0x633 0x3d4 0xbb60 0x8f62 0x64c 0x3bb 0xbd5f 0x8dc2 0x640 0x3d8 0xbf5d 0x8b8a 0x689 0x40f 0xc15b 0x887a 0x708 0x456 0xc35a 0x839a 0x853 0x51c 0xc558 0x7767 0x1912 0x5be>;
			battery3_profile_t2_num = <0x64>;
			battery3_profile_t2_col = <0x04>;
			battery3_profile_t2 = <0x00 0xadb5 0xd34 0xb18 0x1fe 0xad2c 0xd34 0xb2f 0x3fd 0xacb8 0xd32 0xb15 0x5fb 0xac4d 0xd21 0xabe 0x7f9 0xabe6 0xd0e 0xa46 0x9f8 0xab82 0xcfb 0x9dc 0xbf6 0xab1e 0xcd6 0x962 0xdf4 0xaab9 0xcc7 0x90a 0xff2 0xaa55 0xcae 0x8ae 0x11f1 0xa9e9 0xc94 0x85d 0x13ef 0xa97a 0xc7a 0x818 0x15ed 0xa909 0xc5e 0x7d0 0x17ec 0xa895 0xc43 0x78e 0x19ea 0xa821 0xc2a 0x747 0x1be8 0xa7ad 0xc1d 0x70c 0x1de7 0xa739 0xc11 0x6df 0x1fe5 0xa6bd 0xbf9 0x6b3 0x21e3 0xa63f 0xbdf 0x5d8 0x23e1 0xa5c1 0xbcf 0x604 0x25e0 0xa546 0xbcc 0x639 0x27de 0xa4c7 0xbbf 0x5d6 0x29dc 0xa448 0xbb0 0x60b 0x2bdb 0xa3ca 0xba3 0x5e7 0x2dd9 0xa34f 0xba9 0x5e3 0x2fd7 0xa2d3 0xba3 0x5cc 0x31d6 0xa256 0xb90 0x5dc 0x33d4 0xa1dd 0xb90 0x5d5 0x35d2 0xa164 0xb92 0x5c2 0x37d0 0xa0ef 0xb90 0x5d1 0x39cf 0xa07b 0xb86 0x5a8 0x3bcd 0xa008 0xb8a 0x5d2 0x3dcb 0x9f96 0xb97 0x5a5 0x3fca 0x9f25 0xb9c 0x5e1 0x41c8 0x9eb2 0xb90 0x5c3 0x43c6 0x9e44 0xb92 0x5cd 0x45c5 0x9dd4 0xb91 0x5ca 0x47c3 0x9d62 0xb90 0x5eb 0x49c1 0x9cee 0xb7a 0x5ad 0x4bc0 0x9c7a 0xb58 0x5dc 0x4dbe 0x9c03 0xb3a 0x5af 0x4fbc 0x9b85 0xb11 0x5f4 0x51ba 0x9b07 0xade 0x605 0x53b9 0x9a8c 0xaa9 0x629 0x55b7 0x9a1b 0xa74 0x628 0x57b5 0x99af 0xa4d 0x640 0x59b4 0x9947 0xa38 0x640 0x5bb2 0x98e4 0xa29 0x699 0x5db0 0x988b 0xa0f 0x677 0x5faf 0x9841 0xa0d 0x63b 0x61ad 0x97f3 0xa0d 0x68a 0x63ab 0x97ad 0xa15 0x68c 0x65a9 0x976c 0xa1c 0x690 0x67a8 0x972a 0xa22 0x69a 0x69a6 0x96f0 0xa2d 0x697 0x6ba4 0x96af 0xa2b 0x692 0x6da3 0x967a 0xa45 0x691 0x6fa1 0x9641 0xa4b 0x6a0 0x719f 0x960d 0xa53 0x6a8 0x739e 0x95de 0xa65 0x6a3 0x759c 0x95ad 0xa78 0x69a 0x779a 0x9579 0xa79 0x69a 0x7998 0x954f 0xa88 0x6c3 0x7b97 0x9525 0xaa0 0x6a7 0x7d95 0x94fb 0xabb 0x6b5 0x7f93 0x94d4 0xacf 0x6bd 0x8192 0x94ae 0xadc 0x6bc 0x8390 0x948a 0xae9 0x6c5 0x858e 0x9464 0xaf5 0x6cc 0x878d 0x9440 0xb04 0x6b9 0x898b 0x941f 0xb1c 0x6d8 0x8b89 0x9400 0xb2e 0x719 0x8d88 0x93de 0xb35 0x6ac 0x8f86 0x93ba 0xb38 0x6e2 0x9184 0x939b 0xb46 0x6e0 0x9382 0x937b 0xb62 0x6e9 0x9581 0x9356 0xb6f 0x6ea 0x977f 0x932d 0xb7c 0x6c4 0x997d 0x9306 0xb99 0x6e5 0x9b7c 0x92df 0xbc1 0x6c5 0x9d7a 0x92b3 0xbea 0x6f0 0x9f78 0x9284 0xc13 0x6dd 0xa177 0x9254 0xc55 0x6cc 0xa375 0x9211 0xc7d 0x6c2 0xa573 0x91d1 0xccc 0x6be 0xa771 0x918e 0xd29 0x6b1 0xa970 0x9148 0xd85 0x6a7 0xab6e 0x90fc 0xde5 0x6a6 0xad6c 0x90a8 0xe4e 0x690 0xaf6b 0x906e 0xed2 0x67c 0xb169 0x9046 0xf91 0x658 0xb367 0x9025 0x1087 0x627 0xb566 0x9002 0x11bf 0x613 0xb764 0x8fd0 0x134f 0x5f0 0xb962 0x8f7a 0x155a 0x562 0xbb60 0x8eec 0x1809 0x4ff 0xbd5f 0x8d96 0x1bbc 0x45f 0xbf5d 0x8b74 0x247b 0x37a 0xc15b 0x890e 0x363b 0x37a 0xc35a 0x87c1 0x41f3 0x37a 0xc558 0x87c1 0x41f3 0x37a>;
			battery3_profile_t3_num = <0x64>;
			battery3_profile_t3_col = <0x04>;
			battery3_profile_t3 = <0x00 0xadce 0x1838 0x1838 0x1fe 0xad25 0x1838 0x1838 0x3fd 0xac96 0x1859 0x1859 0x5fb 0xac1b 0x1824 0x1824 0x7f9 0xaba9 0x179b 0x179b 0x9f8 0xab3c 0x16e1 0x16e1 0xbf6 0xaad3 0x1628 0x1628 0xdf4 0xaa6e 0x1628 0x1628 0xff2 0xaa05 0x15f6 0x15f6 0x11f1 0xa998 0x15ad 0x15ad 0x13ef 0xa929 0x157e 0x157e 0x15ed 0xa8b9 0x154f 0x154f 0x17ec 0xa845 0x1509 0x1509 0x19ea 0xa7d0 0x14e0 0x14e0 0x1be8 0xa75d 0x14ab 0x14ab 0x1de7 0xa6e8 0x14a5 0x14a5 0x1fe5 0xa671 0x149c 0x149c 0x21e3 0xa5f5 0x148f 0x148f 0x23e1 0xa577 0x1487 0x1487 0x25e0 0xa4fb 0x1484 0x1484 0x27de 0xa47d 0x1479 0x1479 0x29dc 0xa404 0x1492 0x1492 0x2bdb 0xa386 0x1496 0x1496 0x2dd9 0xa30b 0x14a0 0x14a0 0x2fd7 0xa28f 0x149a 0x149a 0x31d6 0xa212 0x148b 0x148b 0x33d4 0xa199 0x1496 0x1496 0x35d2 0xa120 0x1498 0x1498 0x37d0 0xa0a6 0x1496 0x1496 0x39cf 0xa02d 0x1480 0x1480 0x3bcd 0x9fb3 0x1487 0x1487 0x3dcb 0x9f3a 0x1484 0x1484 0x3fca 0x9ec1 0x1460 0x1460 0x41c8 0x9e47 0x1446 0x1446 0x43c6 0x9dce 0x142c 0x142c 0x45c5 0x9d5a 0x1411 0x1411 0x47c3 0x9ce2 0x13f7 0x13f7 0x49c1 0x9c6c 0x13c5 0x13c5 0x4bc0 0x9bf5 0x1388 0x1388 0x4dbe 0x9b7d 0x1360 0x1360 0x4fbc 0x9b09 0x135d 0x135d 0x51ba 0x9a9b 0x130e 0x130e 0x53b9 0x9a31 0x12f7 0x12f7 0x55b7 0x99cb 0x12e9 0x12e9 0x57b5 0x9967 0x12cf 0x12cf 0x59b4 0x9908 0x12a8 0x12a8 0x5bb2 0x98b3 0x127e 0x127e 0x5db0 0x985f 0x1249 0x1249 0x5faf 0x9810 0x1222 0x1222 0x61ad 0x97c5 0x11f0 0x11f0 0x63ab 0x977b 0x11cc 0x11cc 0x65a9 0x9737 0x11bf 0x11bf 0x67a8 0x96f6 0x11b4 0x11b4 0x69a6 0x96b3 0x118c 0x118c 0x6ba4 0x967d 0x1156 0x1156 0x6da3 0x963e 0x111e 0x111e 0x6fa1 0x960b 0x1112 0x1112 0x719f 0x95d5 0x10ea 0x10ea 0x739e 0x95a2 0x10af 0x10af 0x759c 0x9577 0x107e 0x107e 0x779a 0x9547 0x1055 0x1055 0x7998 0x9518 0x1020 0x1020 0x7b97 0x94ed 0x1004 0x1004 0x7d95 0x94c7 0xff3 0xff3 0x7f93 0x949f 0xfe5 0xfe5 0x8192 0x9476 0xfd3 0xfd3 0x8390 0x9453 0xfc3 0xfc3 0x858e 0x9433 0xfde 0xfde 0x878d 0x9409 0xfcf 0xfcf 0x898b 0x93ec 0xfd8 0xfd8 0x8b89 0x93d1 0xff7 0xff7 0x8d88 0x93b7 0x101f 0x101f 0x8f86 0x939d 0x1043 0x1043 0x9184 0x9381 0x105d 0x105d 0x9382 0x935c 0x1079 0x1079 0x9581 0x9342 0x10c5 0x10c5 0x977f 0x931e 0x10f4 0x10f4 0x997d 0x92fd 0x114c 0x114c 0x9b7c 0x92d6 0x11b1 0x11b1 0x9d7a 0x92a8 0x1207 0x1207 0x9f78 0x927d 0x1273 0x1273 0xa177 0x9242 0x12e8 0x12e8 0xa375 0x920d 0x1383 0x1383 0xa573 0x91cd 0x1418 0x1418 0xa771 0x9188 0x14c6 0x14c6 0xa970 0x9142 0x159b 0x159b 0xab6e 0x90f8 0x1682 0x1682 0xad6c 0x90af 0x175a 0x175a 0xaf6b 0x9065 0x18b1 0x18b1 0xb169 0x9028 0x1a6b 0x1a6b 0xb367 0x8fed 0x1c7e 0x1c7e 0xb566 0x8fb5 0x1f38 0x1f38 0xb764 0x8f7a 0x2330 0x2330 0xb962 0x8f2b 0x296c 0x296c 0xbb60 0x8ec1 0x3390 0x3390 0xbd5f 0x8dfa 0x4ed5 0x4ed5 0xbf5d 0x8d72 0x502d 0x502d 0xc15b 0x8d72 0x502d 0x502d 0xc35a 0x8d72 0x502d 0x502d 0xc558 0x8d72 0x502d 0x502d>;
			battery3_profile_t4_num = <0x64>;
			battery3_profile_t4_col = <0x04>;
			battery3_profile_t4 = <0x00 0xade3 0x27c7 0x27c7 0x1fe 0xad10 0x27c7 0x27c7 0x3fd 0xac62 0x27f9 0x27f9 0x5fb 0xabca 0x27ef 0x27ef 0x7f9 0xab3c 0x27b7 0x27b7 0x9f8 0xaab5 0x2779 0x2779 0xbf6 0xaa31 0x273f 0x273f 0xdf4 0xa9b0 0x2710 0x2710 0xff2 0xa92f 0x26cf 0x26cf 0x11f1 0xa8ae 0x269c 0x269c 0x13ef 0xa82e 0x2663 0x2663 0x15ed 0xa7af 0x2628 0x2628 0x17ec 0xa72f 0x25f6 0x25f6 0x19ea 0xa6b3 0x25cb 0x25cb 0x1be8 0xa634 0x257c 0x257c 0x1de7 0xa5b8 0x2546 0x2546 0x1fe5 0xa53a 0x250d 0x250d 0x21e3 0xa4bd 0x24d8 0x24d8 0x23e1 0xa43f 0x24a4 0x24a4 0x25e0 0xa3bf 0x246a 0x246a 0x27de 0xa343 0x2444 0x2444 0x29dc 0xa2ca 0x2415 0x2415 0x2bdb 0xa24f 0x23ed 0x23ed 0x2dd9 0xa1d3 0x23ca 0x23ca 0x2fd7 0xa157 0x23a6 0x23a6 0x31d6 0xa0dc 0x2383 0x2383 0x33d4 0xa063 0x2369 0x2369 0x35d2 0x9fea 0x2355 0x2355 0x37d0 0x9f70 0x232e 0x232e 0x39cf 0x9ef7 0x2311 0x2311 0x3bcd 0x9e7c 0x22f8 0x22f8 0x3dcb 0x9e01 0x22d7 0x22d7 0x3fca 0x9d88 0x22b2 0x22b2 0x41c8 0x9d0f 0x2297 0x2297 0x43c6 0x9c9b 0x227d 0x227d 0x45c5 0x9c27 0x226a 0x226a 0x47c3 0x9bb5 0x2250 0x2250 0x49c1 0x9b45 0x223a 0x223a 0x4bc0 0x9ad8 0x222b 0x222b 0x4dbe 0x9a6f 0x2222 0x2222 0x4fbc 0x9a09 0x220f 0x220f 0x51ba 0x99a4 0x2200 0x2200 0x53b9 0x9943 0x21fb 0x21fb 0x55b7 0x98e5 0x21f8 0x21f8 0x57b5 0x988b 0x21fb 0x21fb 0x59b4 0x9834 0x2205 0x2205 0x5bb2 0x97de 0x220f 0x220f 0x5db0 0x978f 0x2215 0x2215 0x5faf 0x9743 0x2224 0x2224 0x61ad 0x96fb 0x2247 0x2247 0x63ab 0x96b3 0x2262 0x2262 0x65a9 0x966f 0x2276 0x2276 0x67a8 0x962f 0x2290 0x2290 0x69a6 0x95f2 0x22b3 0x22b3 0x6ba4 0x95b7 0x22cf 0x22cf 0x6da3 0x957f 0x22f7 0x22f7 0x6fa1 0x954c 0x2323 0x2323 0x719f 0x951b 0x234d 0x234d 0x739e 0x94ed 0x237d 0x237d 0x759c 0x94c3 0x23bc 0x23bc 0x779a 0x949d 0x2403 0x2403 0x7998 0x9476 0x243f 0x243f 0x7b97 0x9458 0x24aa 0x24aa 0x7d95 0x9437 0x2515 0x2515 0x7f93 0x9417 0x2589 0x2589 0x8192 0x93f8 0x2604 0x2604 0x8390 0x93d7 0x2682 0x2682 0x858e 0x93ba 0x271b 0x271b 0x878d 0x939b 0x27bf 0x27bf 0x898b 0x937b 0x2872 0x2872 0x8b89 0x9359 0x2941 0x2941 0x8d88 0x9337 0x2a20 0x2a20 0x8f86 0x9313 0x2b02 0x2b02 0x9184 0x92ec 0x2bef 0x2bef 0x9382 0x92c7 0x2d03 0x2d03 0x9581 0x929d 0x2e3e 0x2e3e 0x977f 0x9271 0x2f7b 0x2f7b 0x997d 0x9244 0x30d7 0x30d7 0x9b7c 0x9215 0x3253 0x3253 0x9d7a 0x91e2 0x33ed 0x33ed 0x9f78 0x91ad 0x35b1 0x35b1 0xa177 0x9176 0x379a 0x379a 0xa375 0x913c 0x39bd 0x39bd 0xa573 0x9104 0x3c0a 0x3c0a 0xa771 0x90c8 0x3e9d 0x3e9d 0xa970 0x9089 0x418b 0x418b 0xab6e 0x904a 0x44f3 0x44f3 0xad6c 0x900a 0x491a 0x491a 0xaf6b 0x8fce 0x4e83 0x4e83 0xb169 0x8f9e 0x53de 0x53de 0xb367 0x8f90 0x5578 0x5578 0xb566 0x8f90 0x5578 0x5578 0xb764 0x8f90 0x5578 0x5578 0xb962 0x8f90 0x5578 0x5578 0xbb60 0x8f90 0x5578 0x5578 0xbd5f 0x8f90 0x5578 0x5578 0xbf5d 0x8f90 0x5578 0x5578 0xc15b 0x8f90 0x5578 0x5578 0xc35a 0x8f90 0x5578 0x5578 0xc558 0x8f90 0x5578 0x5578>;
		};
	};

	fragment@87 {
		target = <0xffffffff>;

		__overlay__ {
			compatible = "gpio-leds";

			charging {
				label = "charging";
				gpios = <0xffffffff 0x17 0x00>;
				default-state = "off";
			};
		};
	};

	fragment@88 {
		target = <0xffffffff>;

		__overlay__ {
			bootmode = <0xffffffff>;
			mmi,thermal-mitigation = <0xffffffff 0x3567e0 0x325aa0 0x2dc6c0 0x2932e0 0x2625a0 0x2191c0 0x1e8480 0x1b7740 0x16e360 0xf4240 0xc3500 0x7a120>;
		};
	};

	fragment@89 {
		target = <0xffffffff>;

		__overlay__ {
			polling-delay = <0x1388>;
			polling-delay-passive = <0xbb8>;
			thermal-sensors = <0xffffffff>;
		};
	};

	fragment@90 {
		target = <0xffffffff>;

		__overlay__ {
			compatible = "mmi,moto-chg-tcmd";
			status = "okay";
			mmi,ntc_table = <0x01>;
			mmi,ntc_v_ref = <0x1b7740>;
			mmi,ntc_r_pull = <0x186a0>;
			mmi,batid_v_ref = <0x1b7740>;
			mmi,batid_r_pull = <0x186a0>;
			mmi,adc-channel-cpu = <0x00>;
			mmi,adc-channel-charger = <0x02>;
			mmi,adc-channel-pa = <0x01>;
			mmi,adc-channel-batid = <0x03>;
			mmi,adc-channel-vbat = <0x64>;
		};
	};

	fragment@91 {
		target = <0xffffffff>;

		__overlay__ {
			led_brightness = <0x3ff>;
		};
	};

	fragment@92 {
		target = <0xffffffff>;

		__overlay__ {
			compatible = "mediatek,mt6855-board-ntc";
			status = "okay";
			#thermal-sensor-cells = <0x00>;
			io-channels = <0x56 0x17>;
			io-channel-names = "Surface_NTC";
			temperature-lookup-table = <0xffff63c0 0x43183f 0xffff67a8 0x3e73c9 0xffff6b90 0x3a2985 0xffff6f78 0x363204 0xffff7360 0x328683 0xffff7748 0x2f20d6 0xffff7b30 0x2bfb5b 0xffff7f18 0x2910ed 0xffff8300 0x265cd9 0xffff86e8 0x23dad1 0xffff8ad0 0x2186e9 0xffff8eb8 0x1f5d85 0xffff92a0 0x1d5b5b 0xffff9688 0x1b7d65 0xffff9a70 0x19c0dd 0xffff9e58 0x182338 0xffffa240 0x16a15b 0xffffa628 0x153a09 0xffffaa10 0x13eb44 0xffffadf8 0x12b33a 0xffffb1e0 0x11903c 0xffffb5c8 0x1080bf 0xffffb9b0 0xf8355 0xffffbd98 0xe96af 0xffffc180 0xdb998 0xffffc568 0xceaf2 0xffffc950 0xc29b7 0xffffcd38 0xb74f2 0xffffd120 0xacbc3 0xffffd508 0xa2d5c 0xffffd8f0 0x998fc 0xffffdcd8 0x90dbe 0xffffe0c0 0x88b3a 0xffffe4a8 0x810d9 0xffffe890 0x79e0c 0xffffec78 0x73250 0xfffff060 0x6cd4b 0xfffff448 0x66e67 0xfffff830 0x6153c 0xfffffc18 0x5c168 0x00 0x57293 0x3e8 0x52855 0x7d0 0x4e279 0xbb8 0x4a0b6 0xfa0 0x462c9 0x1388 0x42873 0x1770 0x3f17a 0x1b58 0x3bda8 0x1f40 0x38cc9 0x2328 0x35eaf 0x2710 0x3332e 0x2af8 0x30a1c 0x2ee0 0x2e354 0x32c8 0x2beb2 0x36b0 0x29c13 0x3a98 0x27b5b 0x3e80 0x25c66 0x4268 0x23f20 0x4650 0x2236e 0x4a38 0x20938 0x4e20 0x1f068 0x5208 0x1d8ea 0x55f0 0x1c2a8 0x59d8 0x1ad92 0x5dc0 0x19994 0x61a8 0x186a0 0x6590 0x174a6 0x6978 0x16398 0x6d60 0x15369 0x7148 0x1440c 0x7530 0x13576 0x7918 0x1279b 0x7d00 0x11a72 0x80e8 0x10df0 0x84d0 0x1020d 0x88b8 0xf6bf 0x8ca0 0xebff 0x9088 0xe1c5 0x9470 0xd80a 0x9858 0xcec6 0x9c40 0xc5f5 0xa028 0xbd90 0xa410 0xb592 0xa7f8 0xadf5 0xabe0 0xa6b3 0xafc8 0x9fc8 0xb3b0 0x992d 0xb798 0x92e1 0xbb80 0x8cdf 0xbf68 0x8723 0xc350 0x81ab 0xc738 0x7c73 0xcb20 0x7778 0xcf08 0x72b6 0xd2f0 0x6e2b 0xd6d8 0x69d3 0xdac0 0x65ac 0xdea8 0x61b5 0xe290 0x5dea 0xe678 0x5a49 0xea60 0x56d0 0xee48 0x537e 0xf230 0x5050 0xf618 0x4d46 0xfa00 0x4a5c 0xfde8 0x4792 0x101d0 0x44e8 0x105b8 0x425a 0x109a0 0x3fe8 0x10d88 0x3d8f 0x11170 0x3b50 0x11558 0x3927 0x11940 0x3714 0x11d28 0x3517 0x12110 0x332f 0x124f8 0x315b 0x128e0 0x2f9b 0x12cc8 0x2dec 0x130b0 0x2c4f 0x13498 0x2ac2 0x13880 0x2945 0x13c68 0x27d7 0x14050 0x2677 0x14438 0x2525 0x14820 0x23e0 0x14c08 0x22a8 0x14ff0 0x217c 0x153d8 0x205b 0x157c0 0x1f45 0x15ba8 0x1e3a 0x15f90 0x1d39 0x16378 0x1c42 0x16760 0x1b55 0x16b48 0x1a71 0x16f30 0x1994 0x17318 0x18c1 0x17700 0x17f4 0x17ae8 0x172e 0x17ed0 0x1670 0x182b8 0x15b9 0x186a0 0x1508 0x18a88 0x145e 0x18e70 0x13bb 0x19258 0x131d 0x19640 0x1285 0x19a28 0x11f2 0x19e10 0x1165 0x1a1f8 0x10dc 0x1a5e0 0x1058 0x1a9c8 0xfd9 0x1adb0 0xf5e 0x1b198 0xee8 0x1b580 0xe75 0x1b968 0xe07 0x1bd50 0xd9c 0x1c138 0xd34 0x1c520 0xcd1 0x1c908 0xc71 0x1ccf0 0xc15 0x1d0d8 0xbbb 0x1d4c0 0xb64 0x1d8a8 0xb10 0x1dc90 0xabf 0x1e078 0xa70 0x1e460 0xa24 0x1e848 0x9da>;
		};
	};

	fragment@93 {
		target = <0xffffffff>;

		__overlay__ {

			surface_ntc {
				polling-delay = <0x00>;
				polling-delay-passive = <0x00>;
				thermal-sensors = <0xffffffff>;
				phandle = <0x78>;
			};
		};
	};

	__symbols__ {
		i2c_lcd_bias_mtk = "/fragment@3/__overlay__/i2c_lcd_bias@3e";
		aw99703_backlight = "/fragment@3/__overlay__/sprd_backlight@36";
		mtkfb_pins_lcd_bias_enp0 = "/fragment@5/__overlay__/lcd_bias_enp0_gpio";
		mtkfb_pins_lcd_bias_enn0 = "/fragment@5/__overlay__/lcd_bias_enn0_gpio";
		mtkfb_pins_lcm_rst_out1_gpio = "/fragment@5/__overlay__/lcm_rst_out1_gpio";
		mtkfb_pins_lcm_rst_out0_gpio = "/fragment@5/__overlay__/lcm_rst_out0_gpio";
		mtkfb_pins_lcm_dsi_te = "/fragment@5/__overlay__/lcm_dsi_te";
		panel_in1 = "/fragment@7/__overlay__/panel1@0/port/endpoint";
		panel_in2 = "/fragment@7/__overlay__/panel2@0/port/endpoint";
		panel_in3 = "/fragment@7/__overlay__/panel3@0/port/endpoint";
		panel_in4 = "/fragment@7/__overlay__/panel4@0/port/endpoint";
		panel_in5 = "/fragment@7/__overlay__/panel5@0/port/endpoint";
		dsi_out = "/fragment@7/__overlay__/ports/port/endpoint";
		camera_pins_cam0_rst_0 = "/fragment@8/__overlay__/cam0@0";
		camera_pins_cam0_rst_1 = "/fragment@8/__overlay__/cam0@1";
		camera_pins_cam1_rst_0 = "/fragment@8/__overlay__/cam1@0";
		camera_pins_cam1_rst_1 = "/fragment@8/__overlay__/cam1@1";
		camera_pins_cam2_rst_0 = "/fragment@8/__overlay__/cam2@0";
		camera_pins_cam2_rst_1 = "/fragment@8/__overlay__/cam2@1";
		camera_pins_cam0_vcamd_0 = "/fragment@8/__overlay__/cam0@vcam0";
		camera_pins_cam0_vcamd_1 = "/fragment@8/__overlay__/cam0@vcam1";
		camera_pins_cam0_vcama_0 = "/fragment@8/__overlay__/cam0@vcam2";
		camera_pins_cam0_vcama_1 = "/fragment@8/__overlay__/cam0@vcam3";
		camera_pins_cam0_vcamio_0 = "/fragment@8/__overlay__/cam0@vcam4";
		camera_pins_cam0_vcamio_1 = "/fragment@8/__overlay__/cam0@vcam5";
		camera_pins_cam0_vcamd1_0 = "/fragment@8/__overlay__/cam0@vcam6";
		camera_pins_cam0_vcamd1_1 = "/fragment@8/__overlay__/cam0@vcam7";
		camera_pins_cam0_vcamaf_0 = "/fragment@8/__overlay__/cam2@vcam8";
		camera_pins_cam0_vcamaf_1 = "/fragment@8/__overlay__/cam2@vcam9";
		camera_pins_cam1_vcamd_0 = "/fragment@8/__overlay__/cam1@vcam0";
		camera_pins_cam1_vcamd_1 = "/fragment@8/__overlay__/cam1@vcam1";
		camera_pins_cam1_vcama_0 = "/fragment@8/__overlay__/cam1@vcam2";
		camera_pins_cam1_vcama_1 = "/fragment@8/__overlay__/cam1@vcam3";
		camera_pins_cam1_vcamio_0 = "/fragment@8/__overlay__/cam1@vcam4";
		camera_pins_cam1_vcamio_1 = "/fragment@8/__overlay__/cam1@vcam5";
		camera_pins_cam2_vcamd_0 = "/fragment@8/__overlay__/cam2@vcam0";
		camera_pins_cam2_vcamd_1 = "/fragment@8/__overlay__/cam2@vcam1";
		camera_pins_cam2_vcama_0 = "/fragment@8/__overlay__/cam2@vcam2";
		camera_pins_cam2_vcama_1 = "/fragment@8/__overlay__/cam2@vcam3";
		camera_pins_cam2_vcamio_0 = "/fragment@8/__overlay__/cam2@vcam4";
		camera_pins_cam2_vcamio_1 = "/fragment@8/__overlay__/cam2@vcam5";
		camera_pins_cam0_mclk_off = "/fragment@8/__overlay__/camera_pins_cam0_mclk_off";
		camera_pins_cam0_mclk_2ma = "/fragment@8/__overlay__/camera_pins_cam0_mclk_2ma";
		camera_pins_cam0_mclk_4ma = "/fragment@8/__overlay__/camera_pins_cam0_mclk_4ma";
		camera_pins_cam0_mclk_6ma = "/fragment@8/__overlay__/camera_pins_cam0_mclk_6ma";
		camera_pins_cam0_mclk_8ma = "/fragment@8/__overlay__/camera_pins_cam0_mclk_8ma";
		camera_pins_cam1_mclk_off = "/fragment@8/__overlay__/camera_pins_cam1_mclk_off";
		camera_pins_cam1_mclk_2ma = "/fragment@8/__overlay__/camera_pins_cam1_mclk_2ma";
		camera_pins_cam1_mclk_4ma = "/fragment@8/__overlay__/camera_pins_cam1_mclk_4ma";
		camera_pins_cam1_mclk_6ma = "/fragment@8/__overlay__/camera_pins_cam1_mclk_6ma";
		camera_pins_cam1_mclk_8ma = "/fragment@8/__overlay__/camera_pins_cam1_mclk_8ma";
		camera_pins_cam2_mclk_off = "/fragment@8/__overlay__/camera_pins_cam2_mclk_off";
		camera_pins_cam2_mclk_2ma = "/fragment@8/__overlay__/camera_pins_cam2_mclk_2ma";
		camera_pins_cam2_mclk_4ma = "/fragment@8/__overlay__/camera_pins_cam2_mclk_4ma";
		camera_pins_cam2_mclk_6ma = "/fragment@8/__overlay__/camera_pins_cam2_mclk_6ma";
		camera_pins_cam2_mclk_8ma = "/fragment@8/__overlay__/camera_pins_cam2_mclk_8ma";
		camera_pins_default = "/fragment@8/__overlay__/camdefault";
		flashlight_gpio_high = "/fragment@8/__overlay__/flashlight@0";
		flashlight_gpio_low = "/fragment@8/__overlay__/flashlight@1";
		flashlight_pwm_high = "/fragment@8/__overlay__/flashlight@2";
		flashlight_pwm_low = "/fragment@8/__overlay__/flashlight@3";
		flashlight_pwm_en = "/fragment@8/__overlay__/flashlight@4";
		flash_default = "/fragment@8/__overlay__/flashlightdefault";
		mtk_camera_eeprom0 = "/fragment@10/__overlay__/camera_eeprom0@50";
		camera_main_mtk = "/fragment@10/__overlay__/camera_main@1a";
		mtk_camera_eeprom1 = "/fragment@11/__overlay__/camera_eeprom1@51";
		camera_sub_mtk = "/fragment@11/__overlay__/camera_sub@1a";
		mtk_camera_eeprom2 = "/fragment@12/__overlay__/camera_eeprom2@50";
		camera_main_two_mtk = "/fragment@12/__overlay__/camera_main_two@10";
		camera_main_af_mtk = "/fragment@14/__overlay__/camera_main_af@72";
		camera_main_two_af_mtk2 = "/fragment@15/__overlay__/camera_main_two_af@0c";
		sar_int_default = "/fragment@16/__overlay__/sar_int_default";
		sar_int_sleep = "/fragment@16/__overlay__/sar_int_sleep";
		sx937x = "/fragment@18/__overlay__/sx937x@2c";
		spk = "/fragment@19/__overlay__/speaker_amp@5c";
		aud_pins_hacamp_high = "/fragment@21/__overlay__/aud_pins_hacamp_high";
		aud_pins_hacamp_low = "/fragment@21/__overlay__/aud_pins_hacamp_low";
		fingerfp_rst_high = "/fragment@24/__overlay__/fingerfp_rst_high";
		fingerfp_rst_low = "/fragment@24/__overlay__/fingerfp_rst_low";
		fingerfp_irq_active = "/fragment@24/__overlay__/fingerfp_irq_active";
		fingerfp_spi_active = "/fragment@24/__overlay__/fingerfp_spi_active";
		fingerfp_spi_default = "/fragment@24/__overlay__/fingerfp_spi_default";
		fingerprint_irq = "/fragment@24/__overlay__/fingerprint_irq";
		fingerprint_reset_high = "/fragment@24/__overlay__/fingerprint_reset_high";
		fingerprint_reset_low = "/fragment@24/__overlay__/fingerprint_reset_low";
		fingerprint_int = "/fragment@26/__overlay__/fingerprint_int";
		chipone_int = "/fragment@26/__overlay__/chipone_int";
		nfc_pn5xx = "/fragment@30/__overlay__/nfc_pn5xx@28";
		p61 = "/fragment@32/__overlay__/p61@0";
		pinctrl_state_mode_spi = "/fragment@33/__overlay__/pinctrl_state_mode_spi";
		pinctrl_state_mode_idle = "/fragment@33/__overlay__/pinctrl_state_mode_idle";
		mtee = "/fragment@34/__overlay__/MTEE";
		svp = "/fragment@34/__overlay__/SecureVideoPath";
		gps_pins_default = "/fragment@36/__overlay__/gps_default";
		gps_l1_lna_pins_ol = "/fragment@36/__overlay__/gps_l1_lna@0";
		gps_l1_lna_pins_dsp_ctrl = "/fragment@36/__overlay__/gps_l1_lna@1";
		gps_l1_lna_pins_oh = "/fragment@36/__overlay__/gps_l1_lna@2";
		gps_l5_lna_pins_ol = "/fragment@36/__overlay__/gps_l5_lna@0";
		gps_l5_lna_pins_dsp_ctrl = "/fragment@36/__overlay__/gps_l5_lna@1";
		gps_l5_lna_pins_oh = "/fragment@36/__overlay__/gps_l5_lna@2";
		lm3644 = "/fragment@38/__overlay__/lm3644@63";
		fl_core_0 = "/fragment@38/__overlay__/lm3644@63/flash@0/port@0/endpoint";
		fl_core_1 = "/fragment@38/__overlay__/lm3644@63/flash@1/port@1/endpoint";
		lm3644_pins_default = "/fragment@39/__overlay__/default";
		lm3644_pins_hwen_high = "/fragment@39/__overlay__/hwen_high";
		lm3644_pins_hwen_low = "/fragment@39/__overlay__/hwen_low";
		flashlight_0 = "/fragment@40/__overlay__/port@0/endpoint";
		flashlight_1 = "/fragment@40/__overlay__/port@1/endpoint";
		camera_main_three_af_mtk = "/fragment@42/__overlay__/camera_main_three_af@0c";
		mmc1_pins_default = "/fragment@46/__overlay__/mmc1default";
		mmc1_pins_uhs = "/fragment@46/__overlay__/mmc1@0";
		ctp_ft8725_pins_default = "/fragment@48/__overlay__/pins_default";
		ctp_ft8725_spi_mode = "/fragment@48/__overlay__/spimode_default";
		main_pmic = "/fragment@51/__overlay__/pmic@4";
		pmic_adc = "/fragment@51/__overlay__/pmic@4/mt6363-auxadc";
		pa_therm1 = "/fragment@60/__overlay__/pa_therm1";
		nrpa_ntc = "/fragment@60/__overlay__/nrpa_ntc";
		mos_on = "/fragment@79/__overlay__/mos_on";
		mos_off = "/fragment@79/__overlay__/mos_off";
		surface_ntc = "/fragment@93/__overlay__/surface_ntc";
	};

	__fixups__ {
		utags = "/fragment@0:target:0";
		hw = "/fragment@1:target:0";
		dispsys_config = "/fragment@2:target:0\0/fragment@31:target:0";
		i2c6 = "/fragment@3:target:0\0/fragment@19:target:0\0/fragment@38:target:0";
		pio = "/fragment@3/__overlay__/i2c_lcd_bias@3e:sm,lcd-bias-enn-gpio:0\0/fragment@3/__overlay__/i2c_lcd_bias@3e:sm,lcd-bias-enp-gpio:0\0/fragment@3/__overlay__/sprd_backlight@36:hwen-gpio:0\0/fragment@3/__overlay__/sprd_backlight@36:aw99703,hwen-gpio:0\0/fragment@5:target:0\0/fragment@7/__overlay__/panel2@0:reset-gpios:0\0/fragment@7/__overlay__/panel2@0:bias_n-gpios:0\0/fragment@7/__overlay__/panel2@0:bias_p-gpios:0\0/fragment@7/__overlay__/panel3@0:reset-gpios:0\0/fragment@7/__overlay__/panel3@0:bias_n-gpios:0\0/fragment@7/__overlay__/panel3@0:bias_p-gpios:0\0/fragment@7/__overlay__/panel4@0:reset-gpios:0\0/fragment@7/__overlay__/panel4@0:bias_n-gpios:0\0/fragment@7/__overlay__/panel4@0:bias_p-gpios:0\0/fragment@7/__overlay__/panel5@0:reset-gpios:0\0/fragment@7/__overlay__/panel5@0:bias_n-gpios:0\0/fragment@7/__overlay__/panel5@0:bias_p-gpios:0\0/fragment@8:target:0\0/fragment@16:target:0\0/fragment@18/__overlay__/sx937x@2c:interrupt-parent:0\0/fragment@18/__overlay__/sx937x@2c:Semtech,nirq-gpio:0\0/fragment@21:target:0\0/fragment@24:target:0\0/fragment@26/__overlay__/fingerprint_int:interrupt-parent:0\0/fragment@26/__overlay__/fingerprint_int:goodix_rst:0\0/fragment@26/__overlay__/fingerprint_int:gf,gpio_irq:0\0/fragment@26/__overlay__/chipone_int:interrupt-parent:0\0/fragment@26/__overlay__/chipone_int:chipone,irq:0\0/fragment@30/__overlay__/sec-nfc@27:sec-nfc,ven-gpio:0\0/fragment@30/__overlay__/sec-nfc@27:sec-nfc,firm-gpio:0\0/fragment@30/__overlay__/sec-nfc@27:sec-nfc,irq-gpio:0\0/fragment@30/__overlay__/sec-nfc@27:sec-nfc,clk_req-gpio:0\0/fragment@30/__overlay__/nfc_pn5xx@28:interrupt-parent:0\0/fragment@30/__overlay__/nfc_pn5xx@28:qcom,sn-irq:0\0/fragment@30/__overlay__/nfc_pn5xx@28:qcom,sn-ven:0\0/fragment@33:target:0\0/fragment@36:target:0\0/fragment@39:target:0\0/fragment@45/__overlay__:cd-gpios:0\0/fragment@46:target:0\0/fragment@47/__overlay__/novatek@0:novatek,reset-gpio:0\0/fragment@47/__overlay__/novatek@0:novatek,irq-gpio:0\0/fragment@47/__overlay__/ilitek@1:touch,reset-gpio:0\0/fragment@47/__overlay__/ilitek@1:touch,irq-gpio:0\0/fragment@47/__overlay__/focaltech@2:focaltech,reset-gpio:0\0/fragment@47/__overlay__/focaltech@2:focaltech,irq-gpio:0\0/fragment@48:target:0\0/fragment@61/__overlay__:GPIO_FDD_BAND_SUPPORT_DETECT_3RD_PIN:0\0/fragment@61/__overlay__:GPIO_SIM1_HOT_PLUG:0\0/fragment@61/__overlay__:GPIO_SIM2_HOT_PLUG:0\0/fragment@61/__overlay__:GPIO_SIM1_SCLK:0\0/fragment@61/__overlay__:GPIO_SIM1_SRST:0\0/fragment@61/__overlay__:GPIO_SIM1_SIO:0\0/fragment@61/__overlay__:GPIO_SIM2_SCLK:0\0/fragment@61/__overlay__:GPIO_SIM2_SRST:0\0/fragment@61/__overlay__:GPIO_SIM2_SIO:0\0/fragment@61/__overlay__:GPIO_FDD_BAND_SUPPORT_DETECT_1ST_PIN:0\0/fragment@63/__overlay__:interrupt-parent:0\0/fragment@64/__overlay__:interrupt-parent:0\0/fragment@64/__overlay__:deb-gpios:0\0/fragment@65/__overlay__:interrupt-parent:0\0/fragment@66/__overlay__:interrupt-parent:0\0/fragment@67/__overlay__:interrupt-parent:0\0/fragment@67/__overlay__:deb-gpios:0\0/fragment@68/__overlay__:interrupt-parent:0\0/fragment@68/__overlay__:deb-gpios:0\0/fragment@69/__overlay__:interrupt-parent:0\0/fragment@69/__overlay__:deb-gpios:0\0/fragment@70/__overlay__:interrupt-parent:0\0/fragment@70/__overlay__:deb-gpios:0\0/fragment@71/__overlay__:interrupt-parent:0\0/fragment@72/__overlay__:interrupt-parent:0\0/fragment@79:target:0\0/fragment@87/__overlay__/charging:gpios:0";
		mtk_leds = "/fragment@4:target:0";
		mtkfb = "/fragment@6:target:0";
		dsi0 = "/fragment@7:target:0";
		kd_camera_hw1 = "/fragment@9:target:0";
		mt6369_vtp = "/fragment@9/__overlay__:cam2_vcamaf-supply:0";
		i2c2 = "/fragment@10:target:0\0/fragment@14:target:0\0/fragment@42:target:0";
		i2c4 = "/fragment@11:target:0";
		i2c8 = "/fragment@12:target:0\0/fragment@15:target:0";
		flashlights_cancunf = "/fragment@13:target:0";
		pericfg_ao_clk = "/fragment@13/__overlay__:srcclk:0";
		mt6363_vio18 = "/fragment@17:target:0\0/fragment@18/__overlay__/sx937x@2c:cap_vdd-supply:0";
		i2c0 = "/fragment@18:target:0";
		i2c7 = "/fragment@20:target:0\0/fragment@41:target:0";
		afe = "/fragment@22:target:0";
		aud_clk_mosi_off = "/fragment@22/__overlay__:pinctrl-0:0";
		aud_clk_mosi_on = "/fragment@22/__overlay__:pinctrl-1:0";
		aud_dat_mosi_off = "/fragment@22/__overlay__:pinctrl-2:0";
		aud_dat_mosi_on = "/fragment@22/__overlay__:pinctrl-3:0";
		aud_dat_miso0_off = "/fragment@22/__overlay__:pinctrl-4:0";
		aud_dat_miso0_on = "/fragment@22/__overlay__:pinctrl-5:0";
		aud_dat_miso1_off = "/fragment@22/__overlay__:pinctrl-6:0";
		aud_dat_miso1_on = "/fragment@22/__overlay__:pinctrl-7:0";
		aud_dat_miso2_off = "/fragment@22/__overlay__:pinctrl-8:0";
		aud_dat_miso2_on = "/fragment@22/__overlay__:pinctrl-9:0";
		vow_dat_miso_off = "/fragment@22/__overlay__:pinctrl-10:0";
		vow_dat_miso_on = "/fragment@22/__overlay__:pinctrl-11:0";
		vow_clk_miso_off = "/fragment@22/__overlay__:pinctrl-12:0";
		vow_clk_miso_on = "/fragment@22/__overlay__:pinctrl-13:0";
		aud_gpio_i2s0_off = "/fragment@22/__overlay__:pinctrl-14:0";
		aud_gpio_i2s0_on = "/fragment@22/__overlay__:pinctrl-15:0";
		aud_gpio_i2s3_off = "/fragment@22/__overlay__:pinctrl-16:0";
		aud_gpio_i2s3_on = "/fragment@22/__overlay__:pinctrl-17:0";
		mt6369_vfp = "/fragment@23:target:0\0/fragment@26/__overlay__/fingerprint_int:fp_vdd-supply:0\0/fragment@26/__overlay__/chipone_int:fp_vdd-supply:0";
		spi1 = "/fragment@25:target:0";
		odm = "/fragment@26:target:0";
		memory_ssmr_features = "/fragment@27:target:0";
		chosen = "/fragment@28:target:0\0/fragment@88/__overlay__:bootmode:0";
		clock_buffer_ctrl = "/fragment@29:target:0";
		i2c3 = "/fragment@30:target:0";
		spi5 = "/fragment@32:target:0";
		mtee_svp = "/fragment@34:target:0";
		regulator_vibrator = "/fragment@35:target:0";
		gps = "/fragment@37:target:0";
		mtk_composite_v4l2_1 = "/fragment@40:target:0";
		camera_af_hw_node = "/fragment@43:target:0";
		rt5133_ldo3 = "/fragment@43/__overlay__:camaf_m1_pmic-supply:0";
		rt5133_ldo2 = "/fragment@43/__overlay__:camaf_m2_pmic-supply:0";
		rt5133_gpio1 = "/fragment@43/__overlay__:camaf_m3_pmic-supply:0";
		sound = "/fragment@44:target:0";
		mmc1 = "/fragment@45:target:0";
		mt6369_vmch_eint_low = "/fragment@45/__overlay__:vmmc-supply:0";
		spi3 = "/fragment@47:target:0";
		mt6369_vio28 = "/fragment@49:target:0";
		u2port0 = "/fragment@50:target:0";
		spmi = "/fragment@51:target:0";
		tboard_thermistor1 = "/fragment@52:target:0\0/fragment@89/__overlay__:thermal-sensors:0";
		tboard_thermistor2 = "/fragment@53:target:0\0/fragment@60/__overlay__/pa_therm1:thermal-sensors:0";
		tboard_thermistor3 = "/fragment@54:target:0\0/fragment@60/__overlay__/nrpa_ntc:thermal-sensors:0";
		tboard_thermistor4 = "/fragment@55:target:0\0/fragment@60/__overlay__/emmc_therm:thermal-sensors:0";
		tboard_thermistor5 = "/fragment@56:target:0\0/fragment@60/__overlay__/chg_ntc:thermal-sensors:0";
		tboard_thermistor6 = "/fragment@57:target:0\0/fragment@60/__overlay__/mtktsflashlight:thermal-sensors:0";
		ltepa_ntc = "/fragment@58:target:0";
		therm_intf = "/fragment@59:target:0";
		thermal_zones = "/fragment@60:target:0\0/fragment@93:target:0";
		gpio_usage_mapping = "/fragment@61:target:0";
		gpio = "/fragment@62:target:0";
		subpmic_pmu_eint = "/fragment@63:target:0";
		mrdump_ext_rst = "/fragment@64:target:0";
		touch = "/fragment@65:target:0";
		rt5133_eint = "/fragment@66:target:0";
		swtp = "/fragment@67:target:0";
		swtp_1 = "/fragment@68:target:0";
		swtp_2 = "/fragment@69:target:0";
		swtp_3 = "/fragment@70:target:0";
		smart_pa = "/fragment@71:target:0";
		dsi_te = "/fragment@72:target:0";
		md1_sim1_hot_plug_eint = "/fragment@73:target:0";
		md1_sim2_hot_plug_eint = "/fragment@74:target:0";
		keypad = "/fragment@75:target:0";
		lk_charger = "/fragment@76:target:0\0/fragment@91:target:0";
		charger = "/fragment@77:target:0";
		mt6375_chg = "/fragment@78:target:0";
		mt6375_adc = "/fragment@78/__overlay__:io-channels:0\0/fragment@78/__overlay__:io-channels:8\0/fragment@78/__overlay__:io-channels:16\0/fragment@78/__overlay__:io-channels:24\0/fragment@78/__overlay__:io-channels:32\0/fragment@78/__overlay__:io-channels:40\0/fragment@78/__overlay__:io-channels:48\0/fragment@78/__overlay__:io-channels:56\0/fragment@78/__overlay__:io-channels:64\0/fragment@78/__overlay__:io-channels:72\0/fragment@78/__overlay__:io-channels:80";
		pe2 = "/fragment@80:target:0";
		mt6375_typec = "/fragment@81:target:0";
		extcon_usb = "/fragment@82:target:0";
		pdc = "/fragment@83:target:0";
		pe4 = "/fragment@84:target:0";
		pd_adapter = "/fragment@85:target:0";
		mtk_gauge = "/fragment@86:target:0";
		charge_leds = "/fragment@87:target:0";
		charger_cooler = "/fragment@88:target:0";
		ap_ntc = "/fragment@89:target:0";
		moto_chg_tcmd = "/fragment@90:target:0";
		tboard_thermistor7 = "/fragment@92:target:0\0/fragment@93/__overlay__/surface_ntc:thermal-sensors:0";
	};

	__local_fixups__ {

		fragment@6 {

			__overlay__ {
				pinctrl-0 = <0x00>;
				pinctrl-1 = <0x00>;
				pinctrl-2 = <0x00>;
				pinctrl-3 = <0x00>;
				pinctrl-4 = <0x00>;
			};
		};

		fragment@7 {

			__overlay__ {

				panel1@0 {

					port {

						endpoint {
							remote-endpoint = <0x00>;
						};
					};
				};

				panel2@0 {

					port {

						endpoint {
							remote-endpoint = <0x00>;
						};
					};
				};

				panel3@0 {

					port {

						endpoint {
							remote-endpoint = <0x00>;
						};
					};
				};

				panel4@0 {

					port {

						endpoint {
							remote-endpoint = <0x00>;
						};
					};
				};

				panel5@0 {

					port {

						endpoint {
							remote-endpoint = <0x00>;
						};
					};
				};

				ports {

					port {

						endpoint {
							remote-endpoint = <0x00>;
						};
					};
				};
			};
		};

		fragment@9 {

			__overlay__ {
				pinctrl-0 = <0x00>;
				pinctrl-1 = <0x00>;
				pinctrl-2 = <0x00>;
				pinctrl-3 = <0x00>;
				pinctrl-4 = <0x00>;
				pinctrl-5 = <0x00>;
				pinctrl-6 = <0x00>;
				pinctrl-7 = <0x00>;
				pinctrl-8 = <0x00>;
				pinctrl-9 = <0x00>;
				pinctrl-10 = <0x00>;
				pinctrl-11 = <0x00>;
				pinctrl-12 = <0x00>;
				pinctrl-13 = <0x00>;
				pinctrl-14 = <0x00>;
				pinctrl-15 = <0x00>;
				pinctrl-16 = <0x00>;
				pinctrl-17 = <0x00>;
				pinctrl-18 = <0x00>;
				pinctrl-19 = <0x00>;
				pinctrl-20 = <0x00>;
				pinctrl-21 = <0x00>;
				pinctrl-22 = <0x00>;
				pinctrl-23 = <0x00>;
				pinctrl-24 = <0x00>;
				pinctrl-25 = <0x00>;
				pinctrl-26 = <0x00>;
				pinctrl-27 = <0x00>;
				pinctrl-28 = <0x00>;
				pinctrl-29 = <0x00>;
				pinctrl-30 = <0x00>;
				pinctrl-31 = <0x00>;
				pinctrl-32 = <0x00>;
				pinctrl-33 = <0x00>;
				pinctrl-34 = <0x00>;
				pinctrl-35 = <0x00>;
				pinctrl-36 = <0x00>;
				pinctrl-37 = <0x00>;
				pinctrl-38 = <0x00>;
				pinctrl-39 = <0x00>;
				pinctrl-40 = <0x00>;
				pinctrl-41 = <0x00>;
				pinctrl-42 = <0x00>;
				pinctrl-43 = <0x00>;
			};
		};

		fragment@13 {

			__overlay__ {
				pinctrl-0 = <0x00>;
				pinctrl-1 = <0x00>;
				pinctrl-2 = <0x00>;
				pinctrl-3 = <0x00>;
				pinctrl-4 = <0x00>;
				pinctrl-5 = <0x00>;
			};
		};

		fragment@18 {

			__overlay__ {

				sx937x@2c {
					pinctrl-0 = <0x00>;
					pinctrl-1 = <0x00>;
				};
			};
		};

		fragment@22 {

			__overlay__ {
				pinctrl-18 = <0x00>;
				pinctrl-19 = <0x00>;
			};
		};

		fragment@26 {

			__overlay__ {

				fingerprint_int {
					pinctrl-0 = <0x00>;
					pinctrl-1 = <0x00>;
					pinctrl-2 = <0x00>;
				};

				chipone_int {
					pinctrl-0 = <0x00>;
					pinctrl-1 = <0x00>;
					pinctrl-2 = <0x00>;
				};
			};
		};

		fragment@31 {

			__overlay__ {
				pinctrl-0 = <0x00>;
				pinctrl-1 = <0x00>;
				pinctrl-2 = <0x00>;
			};
		};

		fragment@32 {

			__overlay__ {

				p61@0 {
					pinctrl-0 = <0x00>;
					pinctrl-1 = <0x00>;
				};
			};
		};

		fragment@37 {

			__overlay__ {
				pinctrl-0 = <0x00>;
				pinctrl-1 = <0x00>;
				pinctrl-2 = <0x00>;
				pinctrl-3 = <0x00>;
				pinctrl-4 = <0x00>;
				pinctrl-5 = <0x00>;
				pinctrl-6 = <0x00>;
			};
		};

		fragment@38 {

			__overlay__ {

				lm3644@63 {
					pinctrl-0 = <0x00>;
					pinctrl-1 = <0x00>;
					pinctrl-2 = <0x00>;

					flash@0 {

						port@0 {

							endpoint {
								remote-endpoint = <0x00>;
							};
						};
					};

					flash@1 {

						port@1 {

							endpoint {
								remote-endpoint = <0x00>;
							};
						};
					};
				};
			};
		};

		fragment@40 {

			__overlay__ {

				port@0 {

					endpoint {
						remote-endpoint = <0x00>;
					};
				};

				port@1 {

					endpoint {
						remote-endpoint = <0x00>;
					};
				};
			};
		};

		fragment@44 {

			__overlay__ {

				mediatek,speaker-codec {
					sound-dai = <0x00>;
				};
			};
		};

		fragment@45 {

			__overlay__ {
				pinctrl-0 = <0x00>;
				pinctrl-1 = <0x00>;
			};
		};

		fragment@47 {

			__overlay__ {
				pinctrl-0 = <0x00>;
				pinctrl-1 = <0x00>;
			};
		};

		fragment@55 {

			__overlay__ {
				io-channels = <0x00>;
			};
		};

		fragment@56 {

			__overlay__ {
				io-channels = <0x00>;
			};
		};

		fragment@57 {

			__overlay__ {
				io-channels = <0x00>;
			};
		};

		fragment@78 {

			__overlay__ {
				pinctrl-0 = <0x00>;
				pinctrl-1 = <0x00>;
			};
		};

		fragment@92 {

			__overlay__ {
				io-channels = <0x00>;
			};
		};
	};
};
