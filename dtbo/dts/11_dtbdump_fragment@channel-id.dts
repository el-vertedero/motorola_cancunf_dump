/dts-v1/;

/ {

	fragment@channel-id {
		target-path = "/";

		__overlay__ {
			channel-id-map = "acg\0amxbr\0amxpr\0amxmx\0amxcl\0amxar\0amxla\0amxpe\0amxco\0tefbr\0tefmx\0tefar\0tefcl\0tefpe\0tefco\0perar\0entcl\0iusmx\0niibr\0niicl\0niimx\0niipe\0oibr\0timbr\0tigco\0retbr\0retar\0retla\0retcl\0tefla\0retla1st\0tefunl\0tigca\0tigca1st\0retmx\0attmx\0womcl\0avaco\0retpe\0openla\0opencl\0openmx\0altmx\0openpe\0openpub\0undefined\0undefined\0undefined\0undefined\0undefined\0undefined\0undefined\0undefined\0undefined\0undefined\0undefined\0undefined\0undefined\0undefined\0undefined\0undefined\0undefined\0undefined\0undefined\0reteu\0retgb\0retfr\0retes\0retie\0retde\0vfgb\0vfde\0vffr\0o2gb\0o2de\0orafr\0bouyfr\0eegb\0tescogb\0yoigo\0oraes\0retapac\0retmea\0vfit\0vfes\0vfeu\03gb\0tescoie\0altfr\03ie\0altpt\0timit\0retma\0windit\0vfhu\0vfro\0telhu\0playpl\0oraeu\0dteu\0teleu\0pluspl\0dtpl\0tefes\0altice\0vipeu\0veoneu\0openeu\0reteu2\0demogb\0retdemo\0rettr\0undefined\0undefined\0undefined\0undefined\0undefined\0undefined\0undefined\0undefined\0undefined\0undefined\0undefined\0undefined\0undefined\0undefined\0undefined\0undefined\0retca\0bwaca\0tkpca\0vzw\0att\0tmo\0sprint\0repw\0attpre\0cricket\0cc\0usc\0tracfone\0retus\0metropcs\0rcica\0wndca\0dmc\0bby\0amz\0acg\0lra\0comcast\0fi\0vzwpre\0boost\0spectrum\0undefined\0undefined\0undefined\0undefined\0undefined\0undefined\0undefined\0undefined\0undefined\0undefined\0undefined\0undefined\0undefined\0undefined\0undefined\0undefined\0undefined\0undefined\0undefined\0undefined\0undefined\0undefined\0undefined\0undefined\0undefined\0undefined\0undefined\0undefined\0undefined\0undefined\0undefined\0undefined\0undefined\0undefined\0undefined\0undefined\0undefined\0retin\0retcn\0telstra\0vfau\0amzin\0jioin\0airin\0retid\0cmcc\0ctcn\0cucn\0retmm\0gt4gtw\0retth\0retru\0trueth\0smarthk\0mobilpk\0retsea\0retjp\0softbank\0optus\0retkr\0retjio\0ymobile\0lguplus\0docomo\0retanz\0cbncn\0kddi\0rakuten\0undefined\0undefined\0undefined\0undefined\0undefined\0undefined\0undefined\0undefined\0undefined\0undefined\0undefined\0undefined\0undefined\0undefined\0undefined\0undefined\0undefined\0undefined\0undefined\0undefined\0undefined\0undefined\0undefined\0undefined\0undefined\0undefined\0undefined\0undefined\0undefined\0undefined\0undefined\0undefined\0undefined";
		};
	};

	fragment@0 {
		target = <0xffffffff>;

		__overlay__ {
			compatible = "mmi,utags";
			mmi,main-utags = "/dev/block/by-name/utags";
			mmi,backup-utags = "/dev/block/by-name/utagsBackup";
		};
	};

	fragment@1 {
		target = <0xffffffff>;

		__overlay__ {
			compatible = "mmi,utags";
			mmi,dir-name = "hw";
			mmi,main-utags = "/dev/block/by-name/hw";
		};
	};

	fragment@2 {
		target = <0xffffffff>;

		__overlay__ {
			force_dyn_mipi_change;
		};
	};

	fragment@3 {
		target = <0xffffffff>;

		__overlay__ {
			id = <0x06>;

			i2c_lcd_bias@3e {
				compatible = "sm,bias_sm5109";
				reg = <0x3e>;
				sm,lcd-bias-enn-gpio = <0xffffffff 0x86 0x00>;
				sm,lcd-bias-enp-gpio = <0xffffffff 0xb6 0x00>;
				biasp_en_pin = <0xb6>;
				biasn_en_pin = <0x86>;
				status = "okay";
				phandle = <0x60>;
			};

			sprd_backlight@36 {
				compatible = "awinic,aw99703-bl\0sm-sm5350";
				reg = <0x36>;
				id = <0x06>;
				lk_hwen-gpio = <0x08>;
				status = "okay";
				pwm-cfg = <0x0f>;
				hwen-gpio = <0xffffffff 0x08 0x01>;
				boost-ctl = <0x02>;
				ctl-bank-en = <0x02>;
				full-scale-current = <0x19>;
				map-mode = <0x00>;
				current-align-type = <0x01>;
				sm5350,default-brightness = <0x3ff>;
				sm5350,init-seq-enable = <0x01>;
				sm5350,init-seq = <0x1a 0x02 0x1c 0x0f 0x10 0x07 0x16 0x00 0x18 0x19 0x23 0xff 0x24 0x02>;
				aw99703,hwen-gpio = <0xffffffff 0x08 0x01>;
				aw99703,bl-map = <0x03>;
				aw99703,using-lsb;
				aw99703,ovp-level = <0x03>;
				aw99703,ocp-level = <0x02>;
				aw99703,switch-freq = <0x01>;
				aw99703,auto-freq-high = <0x10>;
				aw99703,auto-freq-low = <0x05>;
				aw99703,bl-fscal-led = <0x19>;
				aw99703,bl-channel = <0x03>;
				aw99703,turn-on-ramp = <0x00>;
				aw99703,turn-off-ramp = <0x04>;
				aw99703,pwm-trans-dim = <0x00>;
				aw99703,i2c-trans-dim = <0x01>;
				aw99703,skip-first-trans;
				aw99703,reset-trans-delay;
				aw99703,pwm-mode = <0x01>;
				aw99703,map-type = <0x00>;
				aw99703,current-align-type = <0x01>;
				aw99703,work-mode = <0x01>;
				aw99703,default-brightness = <0x3ff>;
				aw99703,init-seq-enable = <0x01>;
				aw99703,init-seq = <0x02 0x00 0x03 0xcf 0x04 0x2e 0x09 0x00 0x05 0x50 0x06 0x02 0x07 0xe2 0x67 0x1c 0x25 0x61 0x24 0x4c 0x23 0x61 0x02 0x01>;
				phandle = <0x61>;
			};
		};
	};

	fragment@4 {
		target = <0xffffffff>;

		__overlay__ {
			compatible = "mediatek,i2c-leds";

			backlight {
				label = "lcd-backlight";
				led_mode = <0x06>;
				max-brightness = <0x7ff>;
				max-hw-brightness = <0x7ff>;
				default-brightness = <0x712>;
			};
		};
	};

	fragment@5 {
		target = <0xffffffff>;

		__overlay__ {

			lcd_bias_enp0_gpio {
				phandle = <0x01>;

				pins_cmd_dat {
					pinmux = <0xb600>;
					slew-rate = <0x01>;
					output-high;
				};
			};

			lcd_bias_enn0_gpio {
				phandle = <0x02>;

				pins_cmd_dat {
					pinmux = <0x8600>;
					slew-rate = <0x01>;
					output-low;
				};
			};

			lcm_rst_out1_gpio {
				phandle = <0x03>;

				pins_cmd_dat {
					pinmux = <0x5f00>;
					slew-rate = <0x01>;
					output-high;
				};
			};

			lcm_rst_out0_gpio {
				phandle = <0x04>;

				pins_cmd_dat {
					pinmux = <0x5f00>;
					slew-rate = <0x01>;
					output-low;
				};
			};

			lcm_dsi_te {
				phandle = <0x05>;

				pins_cmd_dat {
					pinmux = <0x5e01>;
				};
			};
		};
	};

	fragment@6 {
		target = <0xffffffff>;

		__overlay__ {
			pinctrl-names = "lcd_bias_enp0_gpio\0lcd_bias_enn0_gpio\0lcm_rst_out1_gpio\0lcm_rst_out0_gpio\0mode_te_te";
			pinctrl-0 = <0x01>;
			pinctrl-1 = <0x02>;
			pinctrl-2 = <0x03>;
			pinctrl-3 = <0x04>;
			pinctrl-4 = <0x05>;
			status = "okay";
		};
	};

	fragment@7 {
		target = <0xffffffff>;

		__overlay__ {
			status = "okay";
			#address-cells = <0x01>;
			#size-cells = <0x00>;

			panel1@0 {
				compatible = "mot,dummy,vdo,60hz";
				reg = <0x00>;
				pinctrl-names = "default";

				port {

					endpoint {
						remote-endpoint = <0x06>;
						phandle = <0x07>;
					};
				};
			};

			panel2@0 {
				compatible = "tm,nt36672c,vdo,120hz";
				reg = <0x01>;
				reset-gpios = <0xffffffff 0x5f 0x00>;
				bias_n-gpios = <0xffffffff 0x86 0x00>;
				bias_p-gpios = <0xffffffff 0xb6 0x00>;
				pinctrl-names = "default";

				port {

					endpoint {
						remote-endpoint = <0x06>;
						phandle = <0x62>;
					};
				};
			};

			panel3@0 {
				compatible = "txd,ili7807s,vdo,120hz";
				reg = <0x02>;
				reset-gpios = <0xffffffff 0x5f 0x00>;
				bias_n-gpios = <0xffffffff 0x86 0x00>;
				bias_p-gpios = <0xffffffff 0xb6 0x00>;
				pinctrl-names = "default";

				port {

					endpoint {
						remote-endpoint = <0x06>;
						phandle = <0x63>;
					};
				};
			};

			panel4@0 {
				compatible = "csot_ft8725,vid,120hz";
				reg = <0x03>;
				reset-gpios = <0xffffffff 0x5f 0x00>;
				bias_n-gpios = <0xffffffff 0x86 0x00>;
				bias_p-gpios = <0xffffffff 0xb6 0x00>;
				pinctrl-names = "default";

				port {

					endpoint {
						remote-endpoint = <0x06>;
						phandle = <0x64>;
					};
				};
			};

			panel5@0 {
				compatible = "csot_ft8725,vid,120hz";
				reg = <0x04>;
				reset-gpios = <0xffffffff 0x5f 0x00>;
				bias_n-gpios = <0xffffffff 0x86 0x00>;
				bias_p-gpios = <0xffffffff 0xb6 0x00>;
				pinctrl-names = "default";

				port {

					endpoint {
						remote-endpoint = <0x06>;
						phandle = <0x65>;
					};
				};
			};

			ports {

				port {

					endpoint {
						remote-endpoint = <0x07>;
						phandle = <0x06>;
					};
				};
			};
		};
	};

	fragment@8 {
		target = <0xffffffff>;

		__overlay__ {

			cam0@0 {
				phandle = <0x09>;

				pins_cmd_dat {
					pinmux = <0x1f00>;
					slew-rate = <0x01>;
					output-low;
				};
			};

			cam0@1 {
				phandle = <0x0a>;

				pins_cmd_dat {
					pinmux = <0x1f00>;
					slew-rate = <0x01>;
					output-high;
				};
			};

			cam1@0 {
				phandle = <0x0b>;

				pins_cmd_dat {
					pinmux = <0x1d00>;
					slew-rate = <0x01>;
					output-low;
				};
			};

			cam1@1 {
				phandle = <0x0c>;

				pins_cmd_dat {
					pinmux = <0x1d00>;
					slew-rate = <0x01>;
					output-high;
				};
			};

			cam2@0 {
				phandle = <0x0d>;

				pins_cmd_dat {
					pinmux = <0x2000>;
					slew-rate = <0x01>;
					output-low;
				};
			};

			cam2@1 {
				phandle = <0x0e>;

				pins_cmd_dat {
					pinmux = <0x2000>;
					slew-rate = <0x01>;
					output-high;
				};
			};

			cam0@vcam0 {
				phandle = <0x0f>;

				pins_cmd_dat {
					pinmux = <0x1900>;
					slew-rate = <0x01>;
					output-low;
				};
			};

			cam0@vcam1 {
				phandle = <0x10>;

				pins_cmd_dat {
					pinmux = <0x1900>;
					slew-rate = <0x01>;
					output-high;
				};
			};

			cam0@vcam2 {
				phandle = <0x11>;

				pins_cmd_dat {
					pinmux = <0x1a00>;
					slew-rate = <0x01>;
					output-low;
				};
			};

			cam0@vcam3 {
				phandle = <0x12>;

				pins_cmd_dat {
					pinmux = <0x1a00>;
					slew-rate = <0x01>;
					output-high;
				};
			};

			cam0@vcam4 {
				phandle = <0x13>;

				pins_cmd_dat {
					pinmux = <0xb00>;
					slew-rate = <0x01>;
					output-low;
				};
			};

			cam0@vcam5 {
				phandle = <0x14>;

				pins_cmd_dat {
					pinmux = <0xb00>;
					slew-rate = <0x01>;
					output-high;
				};
			};

			cam0@vcam6 {
				phandle = <0x32>;

				pins_cmd_dat {
					pinmux = <0x400>;
					slew-rate = <0x01>;
					output-low;
				};
			};

			cam0@vcam7 {
				phandle = <0x33>;

				pins_cmd_dat {
					pinmux = <0x400>;
					slew-rate = <0x01>;
					output-high;
				};
			};

			cam2@vcam8 {
				phandle = <0x21>;

				pins_cmd_dat {
					pinmux = <0x600>;
					slew-rate = <0x01>;
					output-low;
				};
			};

			cam2@vcam9 {
				phandle = <0x22>;

				pins_cmd_dat {
					pinmux = <0x600>;
					slew-rate = <0x01>;
					output-high;
				};
			};

			cam1@vcam0 {
				phandle = <0x15>;

				pins_cmd_dat {
					pinmux = <0xc00>;
					slew-rate = <0x01>;
					output-low;
				};
			};

			cam1@vcam1 {
				phandle = <0x16>;

				pins_cmd_dat {
					pinmux = <0xc00>;
					slew-rate = <0x01>;
					output-high;
				};
			};

			cam1@vcam2 {
				phandle = <0x17>;

				pins_cmd_dat {
					pinmux = <0x900>;
					slew-rate = <0x01>;
					output-low;
				};
			};

			cam1@vcam3 {
				phandle = <0x18>;

				pins_cmd_dat {
					pinmux = <0x900>;
					slew-rate = <0x01>;
					output-high;
				};
			};

			cam1@vcam4 {
				phandle = <0x19>;

				pins_cmd_dat {
					pinmux = <0xb00>;
					slew-rate = <0x01>;
					output-low;
				};
			};

			cam1@vcam5 {
				phandle = <0x1a>;

				pins_cmd_dat {
					pinmux = <0xb00>;
					slew-rate = <0x01>;
					output-high;
				};
			};

			cam2@vcam0 {
				phandle = <0x1b>;

				pins_cmd_dat {
					pinmux = <0x1400>;
					slew-rate = <0x01>;
					output-low;
				};
			};

			cam2@vcam1 {
				phandle = <0x1c>;

				pins_cmd_dat {
					pinmux = <0x1400>;
					slew-rate = <0x01>;
					output-high;
				};
			};

			cam2@vcam2 {
				phandle = <0x1d>;

				pins_cmd_dat {
					pinmux = <0xa00>;
					slew-rate = <0x01>;
					output-low;
				};
			};

			cam2@vcam3 {
				phandle = <0x1e>;

				pins_cmd_dat {
					pinmux = <0xa00>;
					slew-rate = <0x01>;
					output-high;
				};
			};

			cam2@vcam4 {
				phandle = <0x1f>;

				pins_cmd_dat {
					pinmux = <0xb00>;
					slew-rate = <0x01>;
					output-low;
				};
			};

			cam2@vcam5 {
				phandle = <0x20>;

				pins_cmd_dat {
					pinmux = <0xb00>;
					slew-rate = <0x01>;
					output-high;
				};
			};

			camera_pins_cam0_mclk_off {
				phandle = <0x23>;

				pins_cmd_dat {
					pinmux = <0x6400>;
					drive-strength = <0x01>;
				};
			};

			camera_pins_cam0_mclk_2ma {
				phandle = <0x24>;

				pins_cmd_dat {
					pinmux = <0x6401>;
					drive-strength = <0x00>;
				};
			};

			camera_pins_cam0_mclk_4ma {
				phandle = <0x25>;

				pins_cmd_dat {
					pinmux = <0x6401>;
					drive-strength = <0x01>;
				};
			};

			camera_pins_cam0_mclk_6ma {
				phandle = <0x26>;

				pins_cmd_dat {
					pinmux = <0x6401>;
					drive-strength = <0x02>;
				};
			};

			camera_pins_cam0_mclk_8ma {
				phandle = <0x27>;

				pins_cmd_dat {
					pinmux = <0x6401>;
					drive-strength = <0x03>;
				};
			};

			camera_pins_cam1_mclk_off {
				phandle = <0x28>;

				pins_cmd_dat {
					pinmux = <0x6100>;
					drive-strength = <0x01>;
				};
			};

			camera_pins_cam1_mclk_2ma {
				phandle = <0x29>;

				pins_cmd_dat {
					pinmux = <0x6101>;
					drive-strength = <0x00>;
				};
			};

			camera_pins_cam1_mclk_4ma {
				phandle = <0x2a>;

				pins_cmd_dat {
					pinmux = <0x6101>;
					drive-strength = <0x01>;
				};
			};

			camera_pins_cam1_mclk_6ma {
				phandle = <0x2b>;

				pins_cmd_dat {
					pinmux = <0x6101>;
					drive-strength = <0x02>;
				};
			};

			camera_pins_cam1_mclk_8ma {
				phandle = <0x2c>;

				pins_cmd_dat {
					pinmux = <0x6101>;
					drive-strength = <0x03>;
				};
			};

			camera_pins_cam2_mclk_off {
				phandle = <0x2d>;

				pins_cmd_dat {
					pinmux = <0x6300>;
					drive-strength = <0x01>;
				};
			};

			camera_pins_cam2_mclk_2ma {
				phandle = <0x2e>;

				pins_cmd_dat {
					pinmux = <0x6301>;
					drive-strength = <0x00>;
				};
			};

			camera_pins_cam2_mclk_4ma {
				phandle = <0x2f>;

				pins_cmd_dat {
					pinmux = <0x6301>;
					drive-strength = <0x01>;
				};
			};

			camera_pins_cam2_mclk_6ma {
				phandle = <0x30>;

				pins_cmd_dat {
					pinmux = <0x6301>;
					drive-strength = <0x02>;
				};
			};

			camera_pins_cam2_mclk_8ma {
				phandle = <0x31>;

				pins_cmd_dat {
					pinmux = <0x6301>;
					drive-strength = <0x03>;
				};
			};

			camdefault {
				phandle = <0x08>;
			};

			flashlight@0 {
				phandle = <0x35>;

				pins_cmd_dat {
					pinmux = <0x1500>;
					slew-rate = <0x01>;
					output-high;
				};
			};

			flashlight@1 {
				phandle = <0x36>;

				pins_cmd_dat {
					pinmux = <0x1500>;
					slew-rate = <0x01>;
					output-low;
				};
			};

			flashlight@2 {
				phandle = <0x37>;

				pins_cmd_dat {
					pinmux = <0x1800>;
					slew-rate = <0x01>;
					output-high;
				};
			};

			flashlight@3 {
				phandle = <0x38>;

				pins_cmd_dat {
					pinmux = <0x1800>;
					slew-rate = <0x01>;
					output-low;
				};
			};

			flashlight@4 {
				phandle = <0x39>;

				pins_cmd_dat {
					pinmux = <0x1801>;
					slew-rate = <0x01>;
					output-high;
				};
			};

			flashlightdefault {
				phandle = <0x34>;
			};
		};
	};

	fragment@9 {
		target = <0xffffffff>;

		__overlay__ {
			pinctrl-names = "default\0cam0_rst0\0cam0_rst1\0cam1_rst0\0cam1_rst1\0cam2_rst0\0cam2_rst1\0cam0_ldo_vcamd_0\0cam0_ldo_vcamd_1\0cam0_ldo_vcama_0\0cam0_ldo_vcama_1\0cam0_ldo_vcamio_0\0cam0_ldo_vcamio_1\0cam1_ldo_vcamd_0\0cam1_ldo_vcamd_1\0cam1_ldo_vcama_0\0cam1_ldo_vcama_1\0cam1_ldo_vcamio_0\0cam1_ldo_vcamio_1\0cam2_ldo_vcamd_0\0cam2_ldo_vcamd_1\0cam2_ldo_vcama_0\0cam2_ldo_vcama_1\0cam2_ldo_vcamio_0\0cam2_ldo_vcamio_1\0cam0_ldo_vcamaf_0\0cam0_ldo_vcamaf_1\0cam0_mclk_off\0cam0_mclk_2mA\0cam0_mclk_4mA\0cam0_mclk_6mA\0cam0_mclk_8mA\0cam1_mclk_off\0cam1_mclk_2mA\0cam1_mclk_4mA\0cam1_mclk_6mA\0cam1_mclk_8mA\0cam2_mclk_off\0cam2_mclk_2mA\0cam2_mclk_4mA\0cam2_mclk_6mA\0cam2_mclk_8mA\0cam0_ldo_vcamd1_0\0cam0_ldo_vcamd1_1";
			pinctrl-0 = <0x08>;
			pinctrl-1 = <0x09>;
			pinctrl-2 = <0x0a>;
			pinctrl-3 = <0x0b>;
			pinctrl-4 = <0x0c>;
			pinctrl-5 = <0x0d>;
			pinctrl-6 = <0x0e>;
			pinctrl-7 = <0x0f>;
			pinctrl-8 = <0x10>;
			pinctrl-9 = <0x11>;
			pinctrl-10 = <0x12>;
			pinctrl-11 = <0x13>;
			pinctrl-12 = <0x14>;
			pinctrl-13 = <0x15>;
			pinctrl-14 = <0x16>;
			pinctrl-15 = <0x17>;
			pinctrl-16 = <0x18>;
			pinctrl-17 = <0x19>;
			pinctrl-18 = <0x1a>;
			pinctrl-19 = <0x1b>;
			pinctrl-20 = <0x1c>;
			pinctrl-21 = <0x1d>;
			pinctrl-22 = <0x1e>;
			pinctrl-23 = <0x1f>;
			pinctrl-24 = <0x20>;
			pinctrl-25 = <0x21>;
			pinctrl-26 = <0x22>;
			pinctrl-27 = <0x23>;
			pinctrl-28 = <0x24>;
			pinctrl-29 = <0x25>;
			pinctrl-30 = <0x26>;
			pinctrl-31 = <0x27>;
			pinctrl-32 = <0x28>;
			pinctrl-33 = <0x29>;
			pinctrl-34 = <0x2a>;
			pinctrl-35 = <0x2b>;
			pinctrl-36 = <0x2c>;
			pinctrl-37 = <0x2d>;
			pinctrl-38 = <0x2e>;
			pinctrl-39 = <0x2f>;
			pinctrl-40 = <0x30>;
			pinctrl-41 = <0x31>;
			pinctrl-42 = <0x32>;
			pinctrl-43 = <0x33>;
			cam2_vcamaf-supply = <0xffffffff>;
			cam0_pin_mclk = "mclk";
			cam0_pin_rst = "gpio";
			cam0_pin_vcama = "gpio";
			cam0_pin_vcamd = "gpio";
			cam0_pin_vcamio = "gpio";
			cam0_pin_vcamd1 = "gpio";
			cam0_pin_vcamaf = "gpio";
			cam1_pin_mclk = "mclk";
			cam1_pin_rst = "gpio";
			cam1_pin_vcama = "gpio";
			cam1_pin_vcamd = "gpio";
			cam1_pin_vcamio = "gpio";
			cam2_pin_mclk = "mclk";
			cam2_pin_rst = "gpio";
			cam2_pin_vcama = "gpio";
			cam2_pin_vcamd = "gpio";
			cam2_pin_vcamio = "gpio";
			cam2_pin_vcamaf = "regulator";
			cam0_enable_sensor = "mot_cancunf_ov50d_mipi_raw mot_cancunf_s5kjns_mipi_raw mot_cancunf_jns_yova_mipi_raw";
			cam1_enable_sensor = "mot_cancunf_hi1634q_mipi_raw mot_cancunf_s5k3p9sp04_mipi_raw";
			cam2_enable_sensor = "mot_cancunf_s5k4h7_mipi_raw mot_cancunf_sc202_mipi_raw";
			status = "okay";
		};
	};

	fragment@10 {
		target = <0xffffffff>;

		__overlay__ {
			status = "okay";
			clock-frequency = <0xf4240>;
			#address-cells = <0x01>;
			size-cells = <0x00>;

			camera_eeprom0@50 {
				compatible = "mediatek,camera_eeprom";
				reg = <0x50>;
				status = "okay";
				phandle = <0x66>;
			};

			camera_main@1a {
				compatible = "mediatek,camera_main";
				#thermal-sensor-cells = <0x00>;
				reg = <0x1a>;
				status = "okay";
				phandle = <0x67>;
			};
		};
	};

	fragment@11 {
		target = <0xffffffff>;

		__overlay__ {
			status = "okay";
			clock-frequency = <0xf4240>;
			#address-cells = <0x01>;
			#size-cells = <0x00>;

			camera_eeprom1@51 {
				compatible = "mediatek,camera_eeprom";
				reg = <0x51>;
				status = "okay";
				phandle = <0x68>;
			};

			camera_sub@1a {
				compatible = "mediatek,camera_sub";
				#thermal-sensor-cells = <0x00>;
				reg = <0x1a>;
				status = "okay";
				phandle = <0x69>;
			};
		};
	};

	fragment@12 {
		target = <0xffffffff>;

		__overlay__ {
			status = "okay";
			clock-frequency = <0x61a80>;
			#address-cells = <0x01>;
			#size-cells = <0x00>;

			camera_eeprom2@50 {
				compatible = "mediatek,camera_eeprom";
				reg = <0x50>;
				status = "okay";
				phandle = <0x6a>;
			};

			camera_main_two@10 {
				compatible = "mediatek,camera_main_two";
				#thermal-sensor-cells = <0x00>;
				reg = <0x10>;
				status = "okay";
				phandle = <0x6b>;
			};
		};
	};

	fragment@13 {
		target = <0xffffffff>;

		__overlay__ {
			compatible = "mediatek,flashlights_cancunf_pwm";
			pinctrl-names = "default\0flashlight_gpio_high\0flashlight_gpio_low\0flashlight_pwm_high\0flashlight_pwm_low\0flashlight_pwm_en";
			pinctrl-0 = <0x34>;
			pinctrl-1 = <0x35>;
			pinctrl-2 = <0x36>;
			pinctrl-3 = <0x37>;
			pinctrl-4 = <0x38>;
			pinctrl-5 = <0x39>;
			srcclk = <0xffffffff>;
			decouple = <0x01>;

			channel@1 {
				status = "okay";
				type = <0x00>;
				ct = <0x00>;
				part = <0x00>;
			};
		};
	};

	fragment@14 {
		target = <0xffffffff>;

		__overlay__ {

			camera_main_af@72 {
				compatible = "mediatek,camera_main_af";
				reg = <0x72>;
				status = "okay";
				phandle = <0x6c>;
			};
		};
	};

	fragment@15 {
		target = <0xffffffff>;

		__overlay__ {

			camera_main_two_af@0c {
				compatible = "mediatek,camera_main_two_af";
				reg = <0x0c>;
				status = "okay";
				phandle = <0x6d>;
			};
		};
	};

	fragment@16 {
		target = <0xffffffff>;

		__overlay__ {

			sar_int_default {
				phandle = <0x3a>;

				pins_cmd_dat {
					pinmux = <0x1200>;
					input-enable;
					drive-strength = <0x02>;
					bias-pull-up;
				};
			};

			sar_int_sleep {
				phandle = <0x3b>;

				pins_cmd_dat {
					pinmux = <0x1200>;
					input-enable;
					drive-strength = <0x02>;
					bias-pull-up;
				};
			};
		};
	};

	fragment@17 {
		target = <0xffffffff>;

		__overlay__ {
			regulator-min-microvolt = <0x1b7740>;
			regulator-max-microvolt = <0x200b20>;
		};
	};

	fragment@18 {
		target = <0xffffffff>;

		__overlay__ {
			status = "okay";

			sx937x@2c {
				compatible = "Semtech,sx937x";
				reg = <0x2c>;
				pinctrl-names = "default\0sleep";
				pinctrl-0 = <0x3a>;
				pinctrl-1 = <0x3b>;
				interrupt-parent = <0xffffffff>;
				interrupts = <0x12 0x02>;
				interrupt-names = "sx937x_irq";
				Semtech,nirq-gpio = <0xffffffff 0x12 0x02>;
				cap_vdd-supply = <0xffffffff>;
				Semtech,ref-phases-a = <0x05>;
				Semtech,ref-phases-b = <0x06>;
				Semtech,ref-phases-c = <0xff>;
				Semtech,button-flag = <0x1f>;
				Semtech,reg-num = <0x3d>;
				Semtech,reg-init = <0x8024 0x7f7f 0x4004 0x74 0x4008 0x08 0x8020 0x32 0x8028 0x877 0x8034 0x877 0x8040 0x877 0x804c 0x877 0x8058 0x877 0x8064 0x877 0x8070 0x877 0x807c 0x88e 0x8030 0x924925 0x803c 0xb24924 0x8048 0x925924 0x8054 0x92c924 0x8060 0x964924 0x806c 0x92492c 0x8078 0x924964 0x8084 0xfff9ff 0x8098 0x5035 0x80b8 0x2525 0x80d8 0x593f 0x80f8 0x1414 0x8118 0x2a2a 0x8138 0x8e 0x8158 0x8e 0x8178 0x8e 0x80a0 0x20200001 0x80c0 0x21210002 0x80e0 0x20200002 0x8100 0x9090003 0x8120 0xd0d0004 0x8188 0x8000015 0x818c 0x8000016 0x8190 0x8000015 0x8194 0x8000015 0x8090 0x54b85000 0x80b0 0x50b85000 0x80d0 0x54b85000 0x80f0 0x28d87000 0x8110 0x64a45000 0x8130 0x5300 0x8150 0x5300 0x8170 0x5300 0x8088 0x300000 0x80a8 0x300000 0x80c8 0x300000 0x80e8 0x300000 0x8108 0x300000 0x8128 0x300000 0x8148 0x300000 0x8168 0x300000 0x808c 0x602000c0 0x80ac 0x602000c0 0x80cc 0x602000c0 0x80ec 0x6020000c 0x810c 0x602000c0 0x812c 0x60200030 0x814c 0x60200030 0x816c 0x60200030>;
				status = "okay";
				phandle = <0x6e>;
			};
		};
	};

	fragment@19 {
		target = <0xffffffff>;

		__overlay__ {

			speaker_amp@5c {
				compatible = "richtek,rt5512";
				#sound-dai-cells = <0x00>;
				reg = <0x5c>;
				sound-name-prefix = "Left";
				status = "disable";
				phandle = <0x51>;
			};
		};
	};

	fragment@20 {
		target = <0xffffffff>;

		__overlay__ {

			aw87xxx_pa@58 {
				compatible = "awinic,aw87xxx_pa";
				reg = <0x58>;
				dev_index = <0x00>;
				status = "okay";
			};

			aw87xxx_pa@59 {
				compatible = "awinic,aw87xxx_pa";
				reg = <0x59>;
				dev_index = <0x01>;
				status = "okay";
			};
		};
	};

	fragment@21 {
		target = <0xffffffff>;

		__overlay__ {

			aud_pins_hacamp_high {
				phandle = <0x3c>;

				pins_cmd_dat {
					pinmux = <0x9e00>;
					slew-rate = <0x01>;
					output-high;
				};
			};

			aud_pins_hacamp_low {
				phandle = <0x3d>;

				pins_cmd_dat {
					pinmux = <0x9e00>;
					slew-rate = <0x01>;
					output-low;
				};
			};
		};
	};

	fragment@22 {
		target = <0xffffffff>;

		__overlay__ {
			pinctrl-names = "aud_clk_mosi_off\0aud_clk_mosi_on\0aud_dat_mosi_off\0aud_dat_mosi_on\0aud_dat_miso0_off\0aud_dat_miso0_on\0aud_dat_miso1_off\0aud_dat_miso1_on\0aud_dat_miso2_off\0aud_dat_miso2_on\0vow_dat_miso_off\0vow_dat_miso_on\0vow_clk_miso_off\0vow_clk_miso_on\0aud_gpio_i2s0_off\0aud_gpio_i2s0_on\0aud_gpio_i2s3_off\0aud_gpio_i2s3_on\0hacamp_pullhigh\0hacamp_pulllow";
			pinctrl-0 = <0xffffffff>;
			pinctrl-1 = <0xffffffff>;
			pinctrl-2 = <0xffffffff>;
			pinctrl-3 = <0xffffffff>;
			pinctrl-4 = <0xffffffff>;
			pinctrl-5 = <0xffffffff>;
			pinctrl-6 = <0xffffffff>;
			pinctrl-7 = <0xffffffff>;
			pinctrl-8 = <0xffffffff>;
			pinctrl-9 = <0xffffffff>;
			pinctrl-10 = <0xffffffff>;
			pinctrl-11 = <0xffffffff>;
			pinctrl-12 = <0xffffffff>;
			pinctrl-13 = <0xffffffff>;
			pinctrl-14 = <0xffffffff>;
			pinctrl-15 = <0xffffffff>;
			pinctrl-16 = <0xffffffff>;
			pinctrl-17 = <0xffffffff>;
			pinctrl-18 = <0x3c>;
			pinctrl-19 = <0x3d>;
		};
	};

	fragment@23 {
		target = <0xffffffff>;

		__overlay__ {
			regulator-min-microvolt = <0x325aa0>;
			regulator-max-microvolt = <0x325aa0>;
		};
	};

	fragment@24 {
		target = <0xffffffff>;

		__overlay__ {

			fingerfp_rst_high {
				phandle = <0x6f>;

				pins_cmd_dat {
					pinmux = <0x9d00>;
					slew-rate = <0x01>;
					output-high;
				};
			};

			fingerfp_rst_low {
				phandle = <0x70>;

				pins_cmd_dat {
					pinmux = <0x9d00>;
					slew-rate = <0x01>;
					output-low;
				};
			};

			fingerfp_irq_active {
				phandle = <0x71>;

				pins_cmd_dat {
					pinmux = <0xf00>;
					slew-rate = <0x00>;
					bias-disable;
				};
			};

			fingerfp_spi_active {
				phandle = <0x72>;

				pins_cmd_dat {
					pinmux = <0x4402 0x4202 0x4302 0x4102>;
					drive-strength = <0x02>;
				};
			};

			fingerfp_spi_default {
				phandle = <0x73>;

				pins_cmd_dat {
					pinmux = <0x4400 0x4200 0x4300 0x4100>;
					slew-rate = <0x01>;
					output-low;
				};
			};

			fingerprint_irq {
				phandle = <0x3e>;

				pins_cmd_dat {
					pinmux = <0xf00>;
					slew-rate = <0x00>;
					bias-disable;
				};
			};

			fingerprint_reset_high {
				phandle = <0x3f>;

				pins_cmd_dat {
					pinmux = <0x9d00>;
					slew-rate = <0x01>;
					output-high;
				};
			};

			fingerprint_reset_low {
				phandle = <0x40>;

				pins_cmd_dat {
					pinmux = <0x9d00>;
					slew-rate = <0x01>;
					output-low;
				};
			};
		};
	};

	fragment@25 {
		target = <0xffffffff>;

		__overlay__ {
			status = "okay";
			mediatek,pad-select = <0x00 0x01>;
			tee-only;

			goodix_tee@0 {
				compatible = "mediatek,finger-goodix";
				reg = <0x00>;
				spi-max-frequency = <0x7a1200>;
				netlink-event = <0x1e>;
				status = "okay";
			};

			chipone_tee@1 {
				status = "okay";
				compatible = "mediatek,finger-chipone";
				reg = <0x01>;
				spi-max-frequency = <0x989680>;
				netlink-event = <0x1e>;
			};
		};
	};

	fragment@26 {
		target = <0xffffffff>;

		__overlay__ {

			fingerprint_int {
				compatible = "mediatek,fingerprint-goodix";
				fp_vdd-supply = <0xffffffff>;
				interrupt-parent = <0xffffffff>;
				goodix_rst = <0xffffffff 0x9d 0x00>;
				gf,gpio_irq = <0xffffffff 0x0f 0x00>;
				interrupts = <0x0f 0x01 0x0f 0x00>;
				pinctrl-names = "fingerprint_irq\0fingerprint_reset_high\0fingerprint_reset_low";
				pinctrl-0 = <0x3e>;
				pinctrl-1 = <0x3f>;
				pinctrl-2 = <0x40>;
				status = "okay";
				phandle = <0x74>;
			};

			chipone_int {
				compatible = "mediatek,chipone-fingerprint";
				chipone,enable-wakeup;
				fp_vdd-supply = <0xffffffff>;
				interrupt-parent = <0xffffffff>;
				interrupts = <0x0f 0x01 0x0f 0x00>;
				pinctrl-names = "fingerprint_reset_low\0fingerprint_reset_high\0fingerprint_irq";
				pinctrl-0 = <0x40>;
				pinctrl-1 = <0x3f>;
				pinctrl-2 = <0x3e>;
				chipone,irq = <0xffffffff 0x0f 0x00>;
				status = "okay";
				phandle = <0x75>;
			};
		};
	};

	fragment@27 {
		target = <0xffffffff>;

		__overlay__ {
			compatible = "mediatek,memory-ssmr-features";
			svp-region-based-size = <0x00 0x4000000>;
			svp-page-based-size = <0x00 0x19000000>;
			tui-size = <0x00 0x00>;
			wfd-region-based-size = <0x00 0x00>;
			wfd-page-based-size = <0x00 0x00>;
			prot-region-based-size = <0x00 0x00>;
			prot-page-based-size = <0x00 0x00>;
			sapu-data-shm-size = <0x00 0x00>;
		};
	};

	fragment@28 {
		target = <0xffffffff>;

		__overlay__ {
			bootargs_ext = "initcall_debug=0";
		};
	};

	fragment@29 {
		target = <0xffffffff>;

		__overlay__ {
			mediatek,xo-bbck4 = <0x01>;
		};
	};

	fragment@30 {
		target = <0xffffffff>;

		__overlay__ {

			sec-nfc@27 {
				compatible = "sec-nfc";
				reg = <0x27>;
				sec-nfc,ven-gpio = <0xffffffff 0xa1 0x00>;
				sec-nfc,firm-gpio = <0xffffffff 0x01 0x00>;
				sec-nfc,irq-gpio = <0xffffffff 0x02 0x00>;
				sec-nfc,clk_req-gpio = <0xffffffff 0xa0 0x00>;
				status = "okay";
			};

			nfc_pn5xx@28 {
				compatible = "qcom,sn-nci";
				reg = <0x28>;
				interrupt-parent = <0xffffffff>;
				interrupts = <0x02 0x04 0x01 0x00>;
				qcom,sn-irq = <0xffffffff 0x02 0x00>;
				qcom,sn-ven = <0xffffffff 0xa1 0x00>;
				status = "okay";
				phandle = <0x76>;
			};
		};
	};

	fragment@31 {
		target = <0xffffffff>;

		__overlay__ {
			pinctrl-names = "lcm_rst_out1_gpio\0lcm_rst_out0_gpio\0mode_te_te";
			pinctrl-0 = <0x03>;
			pinctrl-1 = <0x04>;
			pinctrl-2 = <0x05>;
			status = "okay";
		};
	};

	fragment@32 {
		target = <0xffffffff>;

		__overlay__ {

			p61@0 {
				compatible = "nxp,p61";
				reg = <0x00>;
				spi-max-frequency = <0x1312d00>;
				nxp,nfcc = "3-0028";
				pinctrl-names = "pinctrl_state_mode_spi\0pinctrl_state_mode_idle";
				pinctrl-0 = <0x41>;
				pinctrl-1 = <0x42>;
				status = "okay";
				phandle = <0x77>;
			};
		};
	};

	fragment@33 {
		target = <0xffffffff>;

		__overlay__ {

			pinctrl_state_mode_spi {
				phandle = <0x41>;

				pins_cmd_dat {
					pinmux = <0x4d01 0x4e01 0x4f01 0x5001>;
					drive-strength = <0x02>;
				};
			};

			pinctrl_state_mode_idle {
				phandle = <0x42>;

				pins_cmd_dat {
					pinmux = <0x4e00>;
					slew-rate = <0x01>;
					output-high;
				};
			};
		};
	};

	fragment@34 {
		target = <0xffffffff>;

		__overlay__ {

			MTEE {
				compatible = "mediatek,mtk_svp_on_mtee_support";
				phandle = <0x78>;
			};

			SecureVideoPath {
				compatible = "mediatek,mtk_sec_video_path_support";
				phandle = <0x79>;
			};
		};
	};

	fragment@35 {
		target = <0xffffffff>;

		__overlay__ {
			min-volt = <0x2dc6c0>;
			max-volt = <0x3567e0>;
			status = "ok";
		};
	};

	fragment@36 {
		target = <0xffffffff>;

		__overlay__ {

			gps_default {
				phandle = <0x43>;
			};

			gps_l1_lna@0 {
				phandle = <0x44>;

				pins_cmd_dat {
					pinmux = <0x8500>;
					output-low;
				};
			};

			gps_l1_lna@1 {
				phandle = <0x45>;

				pins_cmd_dat {
					pinmux = <0x8503>;
				};
			};

			gps_l1_lna@2 {
				phandle = <0x46>;

				pins_cmd_dat {
					pinmux = <0x8500>;
					output-high;
				};
			};

			gps_l5_lna@0 {
				phandle = <0x47>;

				pins_cmd_dat {
					pinmux = <0x8600>;
					output-low;
				};
			};

			gps_l5_lna@1 {
				phandle = <0x48>;

				pins_cmd_dat {
					pinmux = <0x8603>;
				};
			};

			gps_l5_lna@2 {
				phandle = <0x49>;

				pins_cmd_dat {
					pinmux = <0x8600>;
					output-high;
				};
			};
		};
	};

	fragment@37 {
		target = <0xffffffff>;

		__overlay__ {
			pinctrl-names = "default\0gps_l1_lna_disable\0gps_l1_lna_dsp_ctrl\0gps_l1_lna_enable\0gps_l5_lna_disable\0gps_l5_lna_dsp_ctrl\0gps_l5_lna_enable";
			pinctrl-0 = <0x43>;
			pinctrl-1 = <0x44>;
			pinctrl-2 = <0x45>;
			pinctrl-3 = <0x46>;
			pinctrl-4 = <0x47>;
			pinctrl-5 = <0x48>;
			pinctrl-6 = <0x49>;
			status = "okay";
		};
	};

	fragment@38 {
		target = <0xffffffff>;

		__overlay__ {

			lm3644@63 {
				compatible = "mediatek,lm3644";
				reg = <0x63>;
				#cooling-cells = <0x02>;
				pinctrl-names = "default\0hwen_high\0hwen_low";
				pinctrl-0 = <0x4a>;
				pinctrl-1 = <0x4b>;
				pinctrl-2 = <0x4c>;
				status = "okay";
				phandle = <0x7a>;

				flash@0 {
					reg = <0x00>;
					type = <0x00>;
					ct = <0x00>;
					part = <0x00>;

					port@0 {

						endpoint {
							remote-endpoint = <0x4d>;
							phandle = <0x4f>;
						};
					};
				};

				flash@1 {
					reg = <0x01>;
					type = <0x00>;
					ct = <0x01>;
					part = <0x00>;

					port@1 {

						endpoint {
							remote-endpoint = <0x4e>;
							phandle = <0x50>;
						};
					};
				};
			};
		};
	};

	fragment@39 {
		target = <0xffffffff>;

		__overlay__ {

			default {
				phandle = <0x4a>;
			};

			hwen_high {
				phandle = <0x4b>;

				pins_cmd_dat {
					pinmux = <0x400>;
					slew-rate = <0x01>;
					output-high;
				};
			};

			hwen_low {
				phandle = <0x4c>;

				pins_cmd_dat {
					pinmux = <0x400>;
					slew-rate = <0x01>;
					output-low;
				};
			};
		};
	};

	fragment@40 {
		target = <0xffffffff>;

		__overlay__ {

			port@0 {

				endpoint {
					remote-endpoint = <0x4f>;
					phandle = <0x4d>;
				};
			};

			port@1 {

				endpoint {
					remote-endpoint = <0x50>;
					phandle = <0x4e>;
				};
			};
		};
	};

	fragment@41 {
		target = <0xffffffff>;

		__overlay__ {
		};
	};

	fragment@42 {
		target = <0xffffffff>;

		__overlay__ {

			camera_main_three_af@0c {
				compatible = "mediatek,camera_main_three_af";
				reg = <0x0c>;
				status = "okay";
				phandle = <0x7b>;
			};
		};
	};

	fragment@43 {
		target = <0xffffffff>;

		__overlay__ {
			camaf_m1_pmic-supply = <0xffffffff>;
			camaf_m2_pmic-supply = <0xffffffff>;
			camaf_m3_pmic-supply = <0xffffffff>;
			status = "okay";
		};
	};

	fragment@44 {
		target = <0xffffffff>;

		__overlay__ {
			mediatek,spk-i2s = <0x03 0x00>;

			mediatek,speaker-codec {
				sound-dai = <0x51>;
			};
		};
	};

	fragment@45 {
		target = <0xffffffff>;

		__overlay__ {
			pinctrl-0 = <0x52>;
			pinctrl-1 = <0x53>;
			cd-gpios = <0xffffffff 0x0e 0x00>;
			vmmc-supply = <0xffffffff>;
		};
	};

	fragment@46 {
		target = <0xffffffff>;

		__overlay__ {

			mmc1default {
				phandle = <0x52>;

				pins_clk {
					pinmux = <0x5201>;
					drive-strength = <0x07>;
					bias-pull-down = <0x66>;
				};
			};

			mmc1@0 {
				phandle = <0x53>;

				pins_clk {
					pinmux = <0x5201>;
					drive-strength = <0x07>;
					bias-pull-down = <0x66>;
				};
			};
		};
	};

	fragment@47 {
		target = <0xffffffff>;

		__overlay__ {
			status = "okay";
			#address-cells = <0x01>;
			#size-cells = <0x00>;
			mediatek,pad-select = <0x00 0x01 0x02>;
			pinctrl-names = "default\0ft8725_spi_mode";
			pinctrl-0 = <0x54>;
			pinctrl-1 = <0x55>;

			novatek@0 {
				compatible = "novatek,NVT-ts-spi";
				reg = <0x00>;
				status = "ok";
				spi-max-frequency = <0x927c00>;
				novatek,reset-gpio = <0xffffffff 0x03 0x00>;
				novatek,irq-gpio = <0xffffffff 0x16 0x2001>;
				novatek,usb_charger;
				novatek,report_gesture_key;
				novatek,supported_gesture_type = <0x06>;
				novatek,psy-name = "battery";
				novatek,swrst-n8-addr = <0x3f0fe>;
				novatek,spi-rd-fast-addr = <0x3f310>;
			};

			ilitek@1 {
				compatible = "tchip,ilitek";
				reg = <0x01>;
				status = "ok";
				touch,reset-gpio = <0xffffffff 0x03 0x00>;
				touch,irq-gpio = <0xffffffff 0x16 0x00>;
				touch,psy-name = "battery";
				ilitek,report_gesture_key;
				ilitek,supported_gesture_type = <0x06>;
			};

			focaltech@2 {
				compatible = "focaltech,fts";
				reg = <0x02>;
				status = "ok";
				spi-max-frequency = <0x5b8d80>;
				focaltech,reset-gpio = <0xffffffff 0x03 0x00>;
				focaltech,irq-gpio = <0xffffffff 0x16 0x00>;
				focaltech,max-touch-number = <0x0a>;
				focaltech,display-coords = <0x00 0x00 0x438 0x960>;
				focaltech,report_gesture_key = <0x3b>;
				focaltech,supported_gesture_type = <0x06>;
				focaltech,panel-supplier = "csot_ft8725";
				focaltech,touch-charger-detect-psy-name = "battery";
				focaltech,touch-charger-detect-psp = "POWER_SUPPLY_PROP_STATUS";
			};
		};
	};

	fragment@48 {
		target = <0xffffffff>;

		__overlay__ {

			pins_default {
				phandle = <0x54>;
			};

			spimode_default {
				phandle = <0x55>;

				pins_cmd_dat {
					pinmux = <0x4902 0x4a02 0x4b02 0x4c02>;
					drive-strength = <0x02>;
				};
			};
		};
	};

	fragment@49 {
		target = <0xffffffff>;

		__overlay__ {
			regulator-name = "mt6369_vio28";
			regulator-min-microvolt = <0x325aa0>;
			regulator-max-microvolt = <0x325aa0>;
			regulator-enable-ramp-delay = <0x780>;
		};
	};

	fragment@50 {
		target = <0xffffffff>;

		__overlay__ {
			mediatek,eye-vrt = <0x07>;
			mediatek,eye-term = <0x03>;
			mediatek,rev6 = <0x03>;
			mediatek,discth = <0x0f>;
		};
	};

	fragment@51 {
		target = <0xffffffff>;

		__overlay__ {

			pmic@4 {
				compatible = "mediatek,mt6363";
				reg = <0x04 0x00>;
				interrupts = <0x04>;
				#address-cells = <0x01>;
				#size-cells = <0x00>;
				interrupt-controller;
				#interrupt-cells = <0x02>;
				phandle = <0x7c>;

				mtk-spmi-pmic-debug {
					compatible = "mediatek,spmi-pmic-debug";
				};

				mt6363-auxadc {
					compatible = "mediatek,mt6363-auxadc";
					#io-channel-cells = <0x01>;
					phandle = <0x56>;

					vin2_100k {
						channel = <0x14>;
						pures = <0x00>;
					};

					vin3_100k {
						channel = <0x15>;
						pures = <0x00>;
					};

					vin4_100k {
						channel = <0x16>;
						pures = <0x00>;
					};

					vin5_100k {
						channel = <0x17>;
						pures = <0x00>;
					};
				};
			};
		};
	};

	fragment@52 {
		target = <0xffffffff>;

		__overlay__ {
			compatible = "mediatek,mt6855-board-ntc";
			status = "okay";
			#thermal-sensor-cells = <0x00>;
			reg = <0x00 0x1c8050d4 0x00 0x04>;
			temperature-lookup-table = <0xffff63c0 0x43183f 0xffff67a8 0x3e73c9 0xffff6b90 0x3a2985 0xffff6f78 0x363204 0xffff7360 0x328683 0xffff7748 0x2f20d6 0xffff7b30 0x2bfb5b 0xffff7f18 0x2910ed 0xffff8300 0x265cd9 0xffff86e8 0x23dad1 0xffff8ad0 0x2186e9 0xffff8eb8 0x1f5d85 0xffff92a0 0x1d5b5b 0xffff9688 0x1b7d65 0xffff9a70 0x19c0dd 0xffff9e58 0x182338 0xffffa240 0x16a15b 0xffffa628 0x153a09 0xffffaa10 0x13eb44 0xffffadf8 0x12b33a 0xffffb1e0 0x11903c 0xffffb5c8 0x1080bf 0xffffb9b0 0xf8355 0xffffbd98 0xe96af 0xffffc180 0xdb998 0xffffc568 0xceaf2 0xffffc950 0xc29b7 0xffffcd38 0xb74f2 0xffffd120 0xacbc3 0xffffd508 0xa2d5c 0xffffd8f0 0x998fc 0xffffdcd8 0x90dbe 0xffffe0c0 0x88b3a 0xffffe4a8 0x810d9 0xffffe890 0x79e0c 0xffffec78 0x73250 0xfffff060 0x6cd4b 0xfffff448 0x66e67 0xfffff830 0x6153c 0xfffffc18 0x5c168 0x00 0x57293 0x3e8 0x52855 0x7d0 0x4e279 0xbb8 0x4a0b6 0xfa0 0x462c9 0x1388 0x42873 0x1770 0x3f17a 0x1b58 0x3bda8 0x1f40 0x38cc9 0x2328 0x35eaf 0x2710 0x3332e 0x2af8 0x30a1c 0x2ee0 0x2e354 0x32c8 0x2beb2 0x36b0 0x29c13 0x3a98 0x27b5b 0x3e80 0x25c66 0x4268 0x23f20 0x4650 0x2236e 0x4a38 0x20938 0x4e20 0x1f068 0x5208 0x1d8ea 0x55f0 0x1c2a8 0x59d8 0x1ad92 0x5dc0 0x19994 0x61a8 0x186a0 0x6590 0x174a6 0x6978 0x16398 0x6d60 0x15369 0x7148 0x1440c 0x7530 0x13576 0x7918 0x1279b 0x7d00 0x11a72 0x80e8 0x10df0 0x84d0 0x1020d 0x88b8 0xf6bf 0x8ca0 0xebff 0x9088 0xe1c5 0x9470 0xd80a 0x9858 0xcec6 0x9c40 0xc5f5 0xa028 0xbd90 0xa410 0xb592 0xa7f8 0xadf5 0xabe0 0xa6b3 0xafc8 0x9fc8 0xb3b0 0x992d 0xb798 0x92e1 0xbb80 0x8cdf 0xbf68 0x8723 0xc350 0x81ab 0xc738 0x7c73 0xcb20 0x7778 0xcf08 0x72b6 0xd2f0 0x6e2b 0xd6d8 0x69d3 0xdac0 0x65ac 0xdea8 0x61b5 0xe290 0x5dea 0xe678 0x5a49 0xea60 0x56d0 0xee48 0x537e 0xf230 0x5050 0xf618 0x4d46 0xfa00 0x4a5c 0xfde8 0x4792 0x101d0 0x44e8 0x105b8 0x425a 0x109a0 0x3fe8 0x10d88 0x3d8f 0x11170 0x3b50 0x11558 0x3927 0x11940 0x3714 0x11d28 0x3517 0x12110 0x332f 0x124f8 0x315b 0x128e0 0x2f9b 0x12cc8 0x2dec 0x130b0 0x2c4f 0x13498 0x2ac2 0x13880 0x2945 0x13c68 0x27d7 0x14050 0x2677 0x14438 0x2525 0x14820 0x23e0 0x14c08 0x22a8 0x14ff0 0x217c 0x153d8 0x205b 0x157c0 0x1f45 0x15ba8 0x1e3a 0x15f90 0x1d39 0x16378 0x1c42 0x16760 0x1b55 0x16b48 0x1a71 0x16f30 0x1994 0x17318 0x18c1 0x17700 0x17f4 0x17ae8 0x172e 0x17ed0 0x1670 0x182b8 0x15b9 0x186a0 0x1508 0x18a88 0x145e 0x18e70 0x13bb 0x19258 0x131d 0x19640 0x1285 0x19a28 0x11f2 0x19e10 0x1165 0x1a1f8 0x10dc 0x1a5e0 0x1058 0x1a9c8 0xfd9 0x1adb0 0xf5e 0x1b198 0xee8 0x1b580 0xe75 0x1b968 0xe07 0x1bd50 0xd9c 0x1c138 0xd34 0x1c520 0xcd1 0x1c908 0xc71 0x1ccf0 0xc15 0x1d0d8 0xbbb 0x1d4c0 0xb64 0x1d8a8 0xb10 0x1dc90 0xabf 0x1e078 0xa70 0x1e460 0xa24 0x1e848 0x9da>;
		};
	};

	fragment@53 {
		target = <0xffffffff>;

		__overlay__ {
			compatible = "mediatek,mt6855-board-ntc";
			status = "okay";
			#thermal-sensor-cells = <0x00>;
			reg = <0x00 0x1c8050d8 0x00 0x04>;
			temperature-lookup-table = <0xffff63c0 0x43183f 0xffff67a8 0x3e73c9 0xffff6b90 0x3a2985 0xffff6f78 0x363204 0xffff7360 0x328683 0xffff7748 0x2f20d6 0xffff7b30 0x2bfb5b 0xffff7f18 0x2910ed 0xffff8300 0x265cd9 0xffff86e8 0x23dad1 0xffff8ad0 0x2186e9 0xffff8eb8 0x1f5d85 0xffff92a0 0x1d5b5b 0xffff9688 0x1b7d65 0xffff9a70 0x19c0dd 0xffff9e58 0x182338 0xffffa240 0x16a15b 0xffffa628 0x153a09 0xffffaa10 0x13eb44 0xffffadf8 0x12b33a 0xffffb1e0 0x11903c 0xffffb5c8 0x1080bf 0xffffb9b0 0xf8355 0xffffbd98 0xe96af 0xffffc180 0xdb998 0xffffc568 0xceaf2 0xffffc950 0xc29b7 0xffffcd38 0xb74f2 0xffffd120 0xacbc3 0xffffd508 0xa2d5c 0xffffd8f0 0x998fc 0xffffdcd8 0x90dbe 0xffffe0c0 0x88b3a 0xffffe4a8 0x810d9 0xffffe890 0x79e0c 0xffffec78 0x73250 0xfffff060 0x6cd4b 0xfffff448 0x66e67 0xfffff830 0x6153c 0xfffffc18 0x5c168 0x00 0x57293 0x3e8 0x52855 0x7d0 0x4e279 0xbb8 0x4a0b6 0xfa0 0x462c9 0x1388 0x42873 0x1770 0x3f17a 0x1b58 0x3bda8 0x1f40 0x38cc9 0x2328 0x35eaf 0x2710 0x3332e 0x2af8 0x30a1c 0x2ee0 0x2e354 0x32c8 0x2beb2 0x36b0 0x29c13 0x3a98 0x27b5b 0x3e80 0x25c66 0x4268 0x23f20 0x4650 0x2236e 0x4a38 0x20938 0x4e20 0x1f068 0x5208 0x1d8ea 0x55f0 0x1c2a8 0x59d8 0x1ad92 0x5dc0 0x19994 0x61a8 0x186a0 0x6590 0x174a6 0x6978 0x16398 0x6d60 0x15369 0x7148 0x1440c 0x7530 0x13576 0x7918 0x1279b 0x7d00 0x11a72 0x80e8 0x10df0 0x84d0 0x1020d 0x88b8 0xf6bf 0x8ca0 0xebff 0x9088 0xe1c5 0x9470 0xd80a 0x9858 0xcec6 0x9c40 0xc5f5 0xa028 0xbd90 0xa410 0xb592 0xa7f8 0xadf5 0xabe0 0xa6b3 0xafc8 0x9fc8 0xb3b0 0x992d 0xb798 0x92e1 0xbb80 0x8cdf 0xbf68 0x8723 0xc350 0x81ab 0xc738 0x7c73 0xcb20 0x7778 0xcf08 0x72b6 0xd2f0 0x6e2b 0xd6d8 0x69d3 0xdac0 0x65ac 0xdea8 0x61b5 0xe290 0x5dea 0xe678 0x5a49 0xea60 0x56d0 0xee48 0x537e 0xf230 0x5050 0xf618 0x4d46 0xfa00 0x4a5c 0xfde8 0x4792 0x101d0 0x44e8 0x105b8 0x425a 0x109a0 0x3fe8 0x10d88 0x3d8f 0x11170 0x3b50 0x11558 0x3927 0x11940 0x3714 0x11d28 0x3517 0x12110 0x332f 0x124f8 0x315b 0x128e0 0x2f9b 0x12cc8 0x2dec 0x130b0 0x2c4f 0x13498 0x2ac2 0x13880 0x2945 0x13c68 0x27d7 0x14050 0x2677 0x14438 0x2525 0x14820 0x23e0 0x14c08 0x22a8 0x14ff0 0x217c 0x153d8 0x205b 0x157c0 0x1f45 0x15ba8 0x1e3a 0x15f90 0x1d39 0x16378 0x1c42 0x16760 0x1b55 0x16b48 0x1a71 0x16f30 0x1994 0x17318 0x18c1 0x17700 0x17f4 0x17ae8 0x172e 0x17ed0 0x1670 0x182b8 0x15b9 0x186a0 0x1508 0x18a88 0x145e 0x18e70 0x13bb 0x19258 0x131d 0x19640 0x1285 0x19a28 0x11f2 0x19e10 0x1165 0x1a1f8 0x10dc 0x1a5e0 0x1058 0x1a9c8 0xfd9 0x1adb0 0xf5e 0x1b198 0xee8 0x1b580 0xe75 0x1b968 0xe07 0x1bd50 0xd9c 0x1c138 0xd34 0x1c520 0xcd1 0x1c908 0xc71 0x1ccf0 0xc15 0x1d0d8 0xbbb 0x1d4c0 0xb64 0x1d8a8 0xb10 0x1dc90 0xabf 0x1e078 0xa70 0x1e460 0xa24 0x1e848 0x9da>;
		};
	};

	fragment@54 {
		target = <0xffffffff>;

		__overlay__ {
			compatible = "mediatek,mt6855-board-ntc";
			status = "okay";
			#thermal-sensor-cells = <0x00>;
			reg = <0x00 0x1c8050dc 0x00 0x04>;
			temperature-lookup-table = <0xffff63c0 0x43183f 0xffff67a8 0x3e73c9 0xffff6b90 0x3a2985 0xffff6f78 0x363204 0xffff7360 0x328683 0xffff7748 0x2f20d6 0xffff7b30 0x2bfb5b 0xffff7f18 0x2910ed 0xffff8300 0x265cd9 0xffff86e8 0x23dad1 0xffff8ad0 0x2186e9 0xffff8eb8 0x1f5d85 0xffff92a0 0x1d5b5b 0xffff9688 0x1b7d65 0xffff9a70 0x19c0dd 0xffff9e58 0x182338 0xffffa240 0x16a15b 0xffffa628 0x153a09 0xffffaa10 0x13eb44 0xffffadf8 0x12b33a 0xffffb1e0 0x11903c 0xffffb5c8 0x1080bf 0xffffb9b0 0xf8355 0xffffbd98 0xe96af 0xffffc180 0xdb998 0xffffc568 0xceaf2 0xffffc950 0xc29b7 0xffffcd38 0xb74f2 0xffffd120 0xacbc3 0xffffd508 0xa2d5c 0xffffd8f0 0x998fc 0xffffdcd8 0x90dbe 0xffffe0c0 0x88b3a 0xffffe4a8 0x810d9 0xffffe890 0x79e0c 0xffffec78 0x73250 0xfffff060 0x6cd4b 0xfffff448 0x66e67 0xfffff830 0x6153c 0xfffffc18 0x5c168 0x00 0x57293 0x3e8 0x52855 0x7d0 0x4e279 0xbb8 0x4a0b6 0xfa0 0x462c9 0x1388 0x42873 0x1770 0x3f17a 0x1b58 0x3bda8 0x1f40 0x38cc9 0x2328 0x35eaf 0x2710 0x3332e 0x2af8 0x30a1c 0x2ee0 0x2e354 0x32c8 0x2beb2 0x36b0 0x29c13 0x3a98 0x27b5b 0x3e80 0x25c66 0x4268 0x23f20 0x4650 0x2236e 0x4a38 0x20938 0x4e20 0x1f068 0x5208 0x1d8ea 0x55f0 0x1c2a8 0x59d8 0x1ad92 0x5dc0 0x19994 0x61a8 0x186a0 0x6590 0x174a6 0x6978 0x16398 0x6d60 0x15369 0x7148 0x1440c 0x7530 0x13576 0x7918 0x1279b 0x7d00 0x11a72 0x80e8 0x10df0 0x84d0 0x1020d 0x88b8 0xf6bf 0x8ca0 0xebff 0x9088 0xe1c5 0x9470 0xd80a 0x9858 0xcec6 0x9c40 0xc5f5 0xa028 0xbd90 0xa410 0xb592 0xa7f8 0xadf5 0xabe0 0xa6b3 0xafc8 0x9fc8 0xb3b0 0x992d 0xb798 0x92e1 0xbb80 0x8cdf 0xbf68 0x8723 0xc350 0x81ab 0xc738 0x7c73 0xcb20 0x7778 0xcf08 0x72b6 0xd2f0 0x6e2b 0xd6d8 0x69d3 0xdac0 0x65ac 0xdea8 0x61b5 0xe290 0x5dea 0xe678 0x5a49 0xea60 0x56d0 0xee48 0x537e 0xf230 0x5050 0xf618 0x4d46 0xfa00 0x4a5c 0xfde8 0x4792 0x101d0 0x44e8 0x105b8 0x425a 0x109a0 0x3fe8 0x10d88 0x3d8f 0x11170 0x3b50 0x11558 0x3927 0x11940 0x3714 0x11d28 0x3517 0x12110 0x332f 0x124f8 0x315b 0x128e0 0x2f9b 0x12cc8 0x2dec 0x130b0 0x2c4f 0x13498 0x2ac2 0x13880 0x2945 0x13c68 0x27d7 0x14050 0x2677 0x14438 0x2525 0x14820 0x23e0 0x14c08 0x22a8 0x14ff0 0x217c 0x153d8 0x205b 0x157c0 0x1f45 0x15ba8 0x1e3a 0x15f90 0x1d39 0x16378 0x1c42 0x16760 0x1b55 0x16b48 0x1a71 0x16f30 0x1994 0x17318 0x18c1 0x17700 0x17f4 0x17ae8 0x172e 0x17ed0 0x1670 0x182b8 0x15b9 0x186a0 0x1508 0x18a88 0x145e 0x18e70 0x13bb 0x19258 0x131d 0x19640 0x1285 0x19a28 0x11f2 0x19e10 0x1165 0x1a1f8 0x10dc 0x1a5e0 0x1058 0x1a9c8 0xfd9 0x1adb0 0xf5e 0x1b198 0xee8 0x1b580 0xe75 0x1b968 0xe07 0x1bd50 0xd9c 0x1c138 0xd34 0x1c520 0xcd1 0x1c908 0xc71 0x1ccf0 0xc15 0x1d0d8 0xbbb 0x1d4c0 0xb64 0x1d8a8 0xb10 0x1dc90 0xabf 0x1e078 0xa70 0x1e460 0xa24 0x1e848 0x9da>;
		};
	};

	fragment@55 {
		target = <0xffffffff>;

		__overlay__ {
			compatible = "mediatek,mt6855-board-ntc";
			status = "okay";
			#thermal-sensor-cells = <0x00>;
			io-channels = <0x56 0x14>;
			io-channel-names = "MD_Thermal_NTC";
			temperature-lookup-table = <0xffff63c0 0x43183f 0xffff67a8 0x3e73c9 0xffff6b90 0x3a2985 0xffff6f78 0x363204 0xffff7360 0x328683 0xffff7748 0x2f20d6 0xffff7b30 0x2bfb5b 0xffff7f18 0x2910ed 0xffff8300 0x265cd9 0xffff86e8 0x23dad1 0xffff8ad0 0x2186e9 0xffff8eb8 0x1f5d85 0xffff92a0 0x1d5b5b 0xffff9688 0x1b7d65 0xffff9a70 0x19c0dd 0xffff9e58 0x182338 0xffffa240 0x16a15b 0xffffa628 0x153a09 0xffffaa10 0x13eb44 0xffffadf8 0x12b33a 0xffffb1e0 0x11903c 0xffffb5c8 0x1080bf 0xffffb9b0 0xf8355 0xffffbd98 0xe96af 0xffffc180 0xdb998 0xffffc568 0xceaf2 0xffffc950 0xc29b7 0xffffcd38 0xb74f2 0xffffd120 0xacbc3 0xffffd508 0xa2d5c 0xffffd8f0 0x998fc 0xffffdcd8 0x90dbe 0xffffe0c0 0x88b3a 0xffffe4a8 0x810d9 0xffffe890 0x79e0c 0xffffec78 0x73250 0xfffff060 0x6cd4b 0xfffff448 0x66e67 0xfffff830 0x6153c 0xfffffc18 0x5c168 0x00 0x57293 0x3e8 0x52855 0x7d0 0x4e279 0xbb8 0x4a0b6 0xfa0 0x462c9 0x1388 0x42873 0x1770 0x3f17a 0x1b58 0x3bda8 0x1f40 0x38cc9 0x2328 0x35eaf 0x2710 0x3332e 0x2af8 0x30a1c 0x2ee0 0x2e354 0x32c8 0x2beb2 0x36b0 0x29c13 0x3a98 0x27b5b 0x3e80 0x25c66 0x4268 0x23f20 0x4650 0x2236e 0x4a38 0x20938 0x4e20 0x1f068 0x5208 0x1d8ea 0x55f0 0x1c2a8 0x59d8 0x1ad92 0x5dc0 0x19994 0x61a8 0x186a0 0x6590 0x174a6 0x6978 0x16398 0x6d60 0x15369 0x7148 0x1440c 0x7530 0x13576 0x7918 0x1279b 0x7d00 0x11a72 0x80e8 0x10df0 0x84d0 0x1020d 0x88b8 0xf6bf 0x8ca0 0xebff 0x9088 0xe1c5 0x9470 0xd80a 0x9858 0xcec6 0x9c40 0xc5f5 0xa028 0xbd90 0xa410 0xb592 0xa7f8 0xadf5 0xabe0 0xa6b3 0xafc8 0x9fc8 0xb3b0 0x992d 0xb798 0x92e1 0xbb80 0x8cdf 0xbf68 0x8723 0xc350 0x81ab 0xc738 0x7c73 0xcb20 0x7778 0xcf08 0x72b6 0xd2f0 0x6e2b 0xd6d8 0x69d3 0xdac0 0x65ac 0xdea8 0x61b5 0xe290 0x5dea 0xe678 0x5a49 0xea60 0x56d0 0xee48 0x537e 0xf230 0x5050 0xf618 0x4d46 0xfa00 0x4a5c 0xfde8 0x4792 0x101d0 0x44e8 0x105b8 0x425a 0x109a0 0x3fe8 0x10d88 0x3d8f 0x11170 0x3b50 0x11558 0x3927 0x11940 0x3714 0x11d28 0x3517 0x12110 0x332f 0x124f8 0x315b 0x128e0 0x2f9b 0x12cc8 0x2dec 0x130b0 0x2c4f 0x13498 0x2ac2 0x13880 0x2945 0x13c68 0x27d7 0x14050 0x2677 0x14438 0x2525 0x14820 0x23e0 0x14c08 0x22a8 0x14ff0 0x217c 0x153d8 0x205b 0x157c0 0x1f45 0x15ba8 0x1e3a 0x15f90 0x1d39 0x16378 0x1c42 0x16760 0x1b55 0x16b48 0x1a71 0x16f30 0x1994 0x17318 0x18c1 0x17700 0x17f4 0x17ae8 0x172e 0x17ed0 0x1670 0x182b8 0x15b9 0x186a0 0x1508 0x18a88 0x145e 0x18e70 0x13bb 0x19258 0x131d 0x19640 0x1285 0x19a28 0x11f2 0x19e10 0x1165 0x1a1f8 0x10dc 0x1a5e0 0x1058 0x1a9c8 0xfd9 0x1adb0 0xf5e 0x1b198 0xee8 0x1b580 0xe75 0x1b968 0xe07 0x1bd50 0xd9c 0x1c138 0xd34 0x1c520 0xcd1 0x1c908 0xc71 0x1ccf0 0xc15 0x1d0d8 0xbbb 0x1d4c0 0xb64 0x1d8a8 0xb10 0x1dc90 0xabf 0x1e078 0xa70 0x1e460 0xa24 0x1e848 0x9da>;
		};
	};

	fragment@56 {
		target = <0xffffffff>;

		__overlay__ {
			compatible = "mediatek,mt6855-board-ntc";
			status = "okay";
			#thermal-sensor-cells = <0x00>;
			io-channels = <0x56 0x15>;
			io-channel-names = "Charger_NTC";
			temperature-lookup-table = <0xffff63c0 0x43183f 0xffff67a8 0x3e73c9 0xffff6b90 0x3a2985 0xffff6f78 0x363204 0xffff7360 0x328683 0xffff7748 0x2f20d6 0xffff7b30 0x2bfb5b 0xffff7f18 0x2910ed 0xffff8300 0x265cd9 0xffff86e8 0x23dad1 0xffff8ad0 0x2186e9 0xffff8eb8 0x1f5d85 0xffff92a0 0x1d5b5b 0xffff9688 0x1b7d65 0xffff9a70 0x19c0dd 0xffff9e58 0x182338 0xffffa240 0x16a15b 0xffffa628 0x153a09 0xffffaa10 0x13eb44 0xffffadf8 0x12b33a 0xffffb1e0 0x11903c 0xffffb5c8 0x1080bf 0xffffb9b0 0xf8355 0xffffbd98 0xe96af 0xffffc180 0xdb998 0xffffc568 0xceaf2 0xffffc950 0xc29b7 0xffffcd38 0xb74f2 0xffffd120 0xacbc3 0xffffd508 0xa2d5c 0xffffd8f0 0x998fc 0xffffdcd8 0x90dbe 0xffffe0c0 0x88b3a 0xffffe4a8 0x810d9 0xffffe890 0x79e0c 0xffffec78 0x73250 0xfffff060 0x6cd4b 0xfffff448 0x66e67 0xfffff830 0x6153c 0xfffffc18 0x5c168 0x00 0x57293 0x3e8 0x52855 0x7d0 0x4e279 0xbb8 0x4a0b6 0xfa0 0x462c9 0x1388 0x42873 0x1770 0x3f17a 0x1b58 0x3bda8 0x1f40 0x38cc9 0x2328 0x35eaf 0x2710 0x3332e 0x2af8 0x30a1c 0x2ee0 0x2e354 0x32c8 0x2beb2 0x36b0 0x29c13 0x3a98 0x27b5b 0x3e80 0x25c66 0x4268 0x23f20 0x4650 0x2236e 0x4a38 0x20938 0x4e20 0x1f068 0x5208 0x1d8ea 0x55f0 0x1c2a8 0x59d8 0x1ad92 0x5dc0 0x19994 0x61a8 0x186a0 0x6590 0x174a6 0x6978 0x16398 0x6d60 0x15369 0x7148 0x1440c 0x7530 0x13576 0x7918 0x1279b 0x7d00 0x11a72 0x80e8 0x10df0 0x84d0 0x1020d 0x88b8 0xf6bf 0x8ca0 0xebff 0x9088 0xe1c5 0x9470 0xd80a 0x9858 0xcec6 0x9c40 0xc5f5 0xa028 0xbd90 0xa410 0xb592 0xa7f8 0xadf5 0xabe0 0xa6b3 0xafc8 0x9fc8 0xb3b0 0x992d 0xb798 0x92e1 0xbb80 0x8cdf 0xbf68 0x8723 0xc350 0x81ab 0xc738 0x7c73 0xcb20 0x7778 0xcf08 0x72b6 0xd2f0 0x6e2b 0xd6d8 0x69d3 0xdac0 0x65ac 0xdea8 0x61b5 0xe290 0x5dea 0xe678 0x5a49 0xea60 0x56d0 0xee48 0x537e 0xf230 0x5050 0xf618 0x4d46 0xfa00 0x4a5c 0xfde8 0x4792 0x101d0 0x44e8 0x105b8 0x425a 0x109a0 0x3fe8 0x10d88 0x3d8f 0x11170 0x3b50 0x11558 0x3927 0x11940 0x3714 0x11d28 0x3517 0x12110 0x332f 0x124f8 0x315b 0x128e0 0x2f9b 0x12cc8 0x2dec 0x130b0 0x2c4f 0x13498 0x2ac2 0x13880 0x2945 0x13c68 0x27d7 0x14050 0x2677 0x14438 0x2525 0x14820 0x23e0 0x14c08 0x22a8 0x14ff0 0x217c 0x153d8 0x205b 0x157c0 0x1f45 0x15ba8 0x1e3a 0x15f90 0x1d39 0x16378 0x1c42 0x16760 0x1b55 0x16b48 0x1a71 0x16f30 0x1994 0x17318 0x18c1 0x17700 0x17f4 0x17ae8 0x172e 0x17ed0 0x1670 0x182b8 0x15b9 0x186a0 0x1508 0x18a88 0x145e 0x18e70 0x13bb 0x19258 0x131d 0x19640 0x1285 0x19a28 0x11f2 0x19e10 0x1165 0x1a1f8 0x10dc 0x1a5e0 0x1058 0x1a9c8 0xfd9 0x1adb0 0xf5e 0x1b198 0xee8 0x1b580 0xe75 0x1b968 0xe07 0x1bd50 0xd9c 0x1c138 0xd34 0x1c520 0xcd1 0x1c908 0xc71 0x1ccf0 0xc15 0x1d0d8 0xbbb 0x1d4c0 0xb64 0x1d8a8 0xb10 0x1dc90 0xabf 0x1e078 0xa70 0x1e460 0xa24 0x1e848 0x9da>;
		};
	};

	fragment@57 {
		target = <0xffffffff>;

		__overlay__ {
			compatible = "mediatek,mt6855-board-ntc";
			status = "okay";
			#thermal-sensor-cells = <0x00>;
			io-channels = <0x56 0x16>;
			io-channel-names = "Flash_LED_NTC";
			temperature-lookup-table = <0xffff63c0 0x43183f 0xffff67a8 0x3e73c9 0xffff6b90 0x3a2985 0xffff6f78 0x363204 0xffff7360 0x328683 0xffff7748 0x2f20d6 0xffff7b30 0x2bfb5b 0xffff7f18 0x2910ed 0xffff8300 0x265cd9 0xffff86e8 0x23dad1 0xffff8ad0 0x2186e9 0xffff8eb8 0x1f5d85 0xffff92a0 0x1d5b5b 0xffff9688 0x1b7d65 0xffff9a70 0x19c0dd 0xffff9e58 0x182338 0xffffa240 0x16a15b 0xffffa628 0x153a09 0xffffaa10 0x13eb44 0xffffadf8 0x12b33a 0xffffb1e0 0x11903c 0xffffb5c8 0x1080bf 0xffffb9b0 0xf8355 0xffffbd98 0xe96af 0xffffc180 0xdb998 0xffffc568 0xceaf2 0xffffc950 0xc29b7 0xffffcd38 0xb74f2 0xffffd120 0xacbc3 0xffffd508 0xa2d5c 0xffffd8f0 0x998fc 0xffffdcd8 0x90dbe 0xffffe0c0 0x88b3a 0xffffe4a8 0x810d9 0xffffe890 0x79e0c 0xffffec78 0x73250 0xfffff060 0x6cd4b 0xfffff448 0x66e67 0xfffff830 0x6153c 0xfffffc18 0x5c168 0x00 0x57293 0x3e8 0x52855 0x7d0 0x4e279 0xbb8 0x4a0b6 0xfa0 0x462c9 0x1388 0x42873 0x1770 0x3f17a 0x1b58 0x3bda8 0x1f40 0x38cc9 0x2328 0x35eaf 0x2710 0x3332e 0x2af8 0x30a1c 0x2ee0 0x2e354 0x32c8 0x2beb2 0x36b0 0x29c13 0x3a98 0x27b5b 0x3e80 0x25c66 0x4268 0x23f20 0x4650 0x2236e 0x4a38 0x20938 0x4e20 0x1f068 0x5208 0x1d8ea 0x55f0 0x1c2a8 0x59d8 0x1ad92 0x5dc0 0x19994 0x61a8 0x186a0 0x6590 0x174a6 0x6978 0x16398 0x6d60 0x15369 0x7148 0x1440c 0x7530 0x13576 0x7918 0x1279b 0x7d00 0x11a72 0x80e8 0x10df0 0x84d0 0x1020d 0x88b8 0xf6bf 0x8ca0 0xebff 0x9088 0xe1c5 0x9470 0xd80a 0x9858 0xcec6 0x9c40 0xc5f5 0xa028 0xbd90 0xa410 0xb592 0xa7f8 0xadf5 0xabe0 0xa6b3 0xafc8 0x9fc8 0xb3b0 0x992d 0xb798 0x92e1 0xbb80 0x8cdf 0xbf68 0x8723 0xc350 0x81ab 0xc738 0x7c73 0xcb20 0x7778 0xcf08 0x72b6 0xd2f0 0x6e2b 0xd6d8 0x69d3 0xdac0 0x65ac 0xdea8 0x61b5 0xe290 0x5dea 0xe678 0x5a49 0xea60 0x56d0 0xee48 0x537e 0xf230 0x5050 0xf618 0x4d46 0xfa00 0x4a5c 0xfde8 0x4792 0x101d0 0x44e8 0x105b8 0x425a 0x109a0 0x3fe8 0x10d88 0x3d8f 0x11170 0x3b50 0x11558 0x3927 0x11940 0x3714 0x11d28 0x3517 0x12110 0x332f 0x124f8 0x315b 0x128e0 0x2f9b 0x12cc8 0x2dec 0x130b0 0x2c4f 0x13498 0x2ac2 0x13880 0x2945 0x13c68 0x27d7 0x14050 0x2677 0x14438 0x2525 0x14820 0x23e0 0x14c08 0x22a8 0x14ff0 0x217c 0x153d8 0x205b 0x157c0 0x1f45 0x15ba8 0x1e3a 0x15f90 0x1d39 0x16378 0x1c42 0x16760 0x1b55 0x16b48 0x1a71 0x16f30 0x1994 0x17318 0x18c1 0x17700 0x17f4 0x17ae8 0x172e 0x17ed0 0x1670 0x182b8 0x15b9 0x186a0 0x1508 0x18a88 0x145e 0x18e70 0x13bb 0x19258 0x131d 0x19640 0x1285 0x19a28 0x11f2 0x19e10 0x1165 0x1a1f8 0x10dc 0x1a5e0 0x1058 0x1a9c8 0xfd9 0x1adb0 0xf5e 0x1b198 0xee8 0x1b580 0xe75 0x1b968 0xe07 0x1bd50 0xd9c 0x1c138 0xd34 0x1c520 0xcd1 0x1c908 0xc71 0x1ccf0 0xc15 0x1d0d8 0xbbb 0x1d4c0 0xb64 0x1d8a8 0xb10 0x1dc90 0xabf 0x1e078 0xa70 0x1e460 0xa24 0x1e848 0x9da>;
		};
	};

	fragment@58 {
		target = <0xffffffff>;

		__overlay__ {
			status = "disabled";
		};
	};

	fragment@59 {
		target = <0xffffffff>;

		__overlay__ {
			mmi,temperature-names = "FRONT_TEMP";
		};
	};

	fragment@60 {
		target = <0xffffffff>;

		__overlay__ {

			pa_therm1 {
				polling-delay = <0x00>;
				polling-delay-passive = <0x00>;
				thermal-sensors = <0xffffffff>;
				phandle = <0x7d>;
			};

			nrpa_ntc {
				polling-delay = <0x00>;
				polling-delay-passive = <0x00>;
				thermal-sensors = <0xffffffff>;
				phandle = <0x7e>;
			};

			emmc_therm {
				polling-delay = <0x00>;
				polling-delay-passive = <0x00>;
				thermal-sensors = <0xffffffff>;
			};

			chg_ntc {
				polling-delay = <0x00>;
				polling-delay-passive = <0x00>;
				thermal-sensors = <0xffffffff>;
			};

			mtktsflashlight {
				polling-delay = <0x00>;
				polling-delay-passive = <0x00>;
				thermal-sensors = <0xffffffff>;
			};
		};
	};

	fragment@model {
		target-path = "/";

		__overlay__ {
			mot,model = "cancunf";
			mot,board-id = <0x1044 0xa100>;
		};
	};

	fragment@61 {
		target = <0xffffffff>;

		__overlay__ {
			GPIO_FDD_BAND_SUPPORT_DETECT_3RD_PIN = <0xffffffff 0x05 0x00>;
			GPIO_SIM1_HOT_PLUG = <0xffffffff 0x33 0x00>;
			GPIO_SIM2_HOT_PLUG = <0xffffffff 0x34 0x00>;
			GPIO_SIM1_SCLK = <0xffffffff 0x58 0x00>;
			GPIO_SIM1_SRST = <0xffffffff 0x59 0x00>;
			GPIO_SIM1_SIO = <0xffffffff 0x5a 0x00>;
			GPIO_SIM2_SCLK = <0xffffffff 0x5b 0x00>;
			GPIO_SIM2_SRST = <0xffffffff 0x5c 0x00>;
			GPIO_SIM2_SIO = <0xffffffff 0x5d 0x00>;
			GPIO_FDD_BAND_SUPPORT_DETECT_1ST_PIN = <0xffffffff 0xb7 0x00>;
		};
	};

	fragment@62 {
		target = <0xffffffff>;

		__overlay__ {
			gpio_init_default = <0x00 0x00 0x00 0x00 0x01 0x01 0x01 0x01 0x00 0x01 0x00 0x01 0x00 0x01 0x02 0x00 0x00 0x00 0x01 0x00 0x01 0x03 0x00 0x01 0x01 0x00 0x00 0x01 0x04 0x00 0x01 0x00 0x01 0x00 0x01 0x05 0x00 0x00 0x00 0x00 0x00 0x01 0x06 0x01 0x01 0x00 0x00 0x00 0x00 0x07 0x00 0x00 0x00 0x01 0x01 0x01 0x08 0x06 0x00 0x00 0x01 0x00 0x01 0x09 0x01 0x01 0x00 0x00 0x00 0x00 0x0a 0x01 0x01 0x00 0x00 0x00 0x00 0x0b 0x01 0x01 0x00 0x00 0x00 0x00 0x0c 0x01 0x01 0x00 0x00 0x00 0x00 0x0d 0x00 0x00 0x00 0x01 0x01 0x01 0x0e 0x00 0x00 0x00 0x01 0x01 0x01 0x0f 0x00 0x00 0x00 0x01 0x00 0x01 0x10 0x00 0x00 0x00 0x01 0x00 0x01 0x11 0x00 0x00 0x00 0x01 0x01 0x01 0x12 0x00 0x00 0x00 0x01 0x00 0x01 0x13 0x00 0x00 0x00 0x01 0x01 0x01 0x14 0x01 0x01 0x00 0x00 0x00 0x00 0x15 0x00 0x01 0x00 0x01 0x00 0x01 0x16 0x00 0x00 0x00 0x01 0x00 0x01 0x17 0x00 0x01 0x00 0x01 0x00 0x01 0x18 0x00 0x01 0x00 0x01 0x00 0x00 0x19 0x01 0x01 0x00 0x00 0x00 0x00 0x1a 0x01 0x00 0x00 0x00 0x00 0x00 0x1b 0x00 0x00 0x00 0x01 0x00 0x01 0x1c 0x00 0x00 0x00 0x01 0x00 0x01 0x1d 0x01 0x01 0x00 0x00 0x00 0x00 0x1e 0x00 0x01 0x00 0x01 0x00 0x01 0x1f 0x01 0x01 0x00 0x00 0x00 0x00 0x20 0x01 0x01 0x00 0x00 0x00 0x00 0x21 0x00 0x00 0x00 0x01 0x00 0x01 0x22 0x00 0x00 0x00 0x01 0x00 0x01 0x23 0x03 0x00 0x00 0x01 0x01 0x01 0x24 0x03 0x00 0x00 0x00 0x00 0x01 0x25 0x03 0x00 0x00 0x00 0x00 0x01 0x26 0x00 0x01 0x00 0x01 0x00 0x01 0x27 0x00 0x00 0x00 0x01 0x01 0x01 0x28 0x00 0x00 0x00 0x01 0x01 0x01 0x29 0x00 0x00 0x00 0x01 0x01 0x01 0x2a 0x01 0x00 0x00 0x00 0x00 0x01 0x2b 0x01 0x01 0x00 0x00 0x00 0x01 0x2c 0x01 0x01 0x00 0x00 0x00 0x01 0x2d 0x00 0x00 0x00 0x01 0x01 0x01 0x2e 0x00 0x00 0x00 0x01 0x01 0x01 0x2f 0x01 0x00 0x00 0x00 0x00 0x01 0x30 0x01 0x00 0x00 0x00 0x00 0x01 0x31 0x01 0x00 0x00 0x00 0x00 0x01 0x32 0x03 0x00 0x00 0x01 0x00 0x01 0x33 0x01 0x00 0x00 0x01 0x01 0x01 0x34 0x01 0x00 0x00 0x01 0x01 0x01 0x35 0x01 0x00 0x00 0x00 0x00 0x01 0x36 0x01 0x00 0x00 0x01 0x01 0x01 0x37 0x01 0x00 0x00 0x00 0x00 0x01 0x38 0x01 0x00 0x00 0x01 0x01 0x01 0x39 0x01 0x00 0x00 0x01 0x00 0x01 0x3a 0x00 0x01 0x00 0x01 0x00 0x01 0x3b 0x01 0x00 0x00 0x01 0x01 0x01 0x3c 0x07 0x00 0x00 0x01 0x00 0x01 0x3d 0x07 0x00 0x00 0x01 0x00 0x01 0x3e 0x07 0x00 0x00 0x01 0x00 0x01 0x3f 0x07 0x00 0x00 0x00 0x00 0x01 0x40 0x07 0x00 0x00 0x01 0x00 0x01 0x41 0x02 0x00 0x00 0x00 0x00 0x01 0x42 0x02 0x00 0x00 0x01 0x01 0x01 0x43 0x02 0x00 0x00 0x00 0x00 0x01 0x44 0x02 0x00 0x00 0x01 0x00 0x01 0x45 0x01 0x00 0x00 0x00 0x00 0x01 0x46 0x01 0x00 0x00 0x00 0x00 0x01 0x47 0x01 0x00 0x00 0x00 0x00 0x01 0x48 0x01 0x00 0x00 0x01 0x00 0x01 0x49 0x02 0x01 0x00 0x00 0x00 0x01 0x4a 0x02 0x01 0x01 0x00 0x00 0x01 0x4b 0x02 0x01 0x00 0x00 0x00 0x01 0x4c 0x02 0x00 0x00 0x01 0x00 0x01 0x4d 0x01 0x00 0x00 0x00 0x00 0x01 0x4e 0x01 0x00 0x00 0x00 0x00 0x01 0x4f 0x01 0x00 0x00 0x00 0x00 0x01 0x50 0x01 0x00 0x00 0x01 0x00 0x01 0x52 0x01 0x00 0x00 0x00 0x00 0x01 0x53 0x01 0x00 0x00 0x01 0x01 0x01 0x54 0x01 0x00 0x00 0x01 0x01 0x01 0x55 0x01 0x00 0x00 0x01 0x01 0x01 0x56 0x01 0x00 0x00 0x01 0x01 0x01 0x57 0x01 0x00 0x00 0x01 0x01 0x01 0x58 0x01 0x00 0x00 0x00 0x00 0x01 0x59 0x01 0x00 0x00 0x00 0x00 0x01 0x5a 0x01 0x00 0x00 0x01 0x01 0x01 0x5b 0x01 0x00 0x00 0x00 0x00 0x01 0x5c 0x01 0x00 0x00 0x00 0x00 0x01 0x5d 0x01 0x00 0x00 0x01 0x01 0x01 0x5e 0x01 0x00 0x00 0x01 0x00 0x01 0x5f 0x01 0x00 0x00 0x00 0x00 0x01 0x60 0x01 0x00 0x00 0x00 0x00 0x01 0x61 0x01 0x01 0x00 0x00 0x00 0x00 0x62 0x01 0x00 0x00 0x01 0x00 0x01 0x63 0x01 0x01 0x00 0x00 0x00 0x00 0x64 0x01 0x01 0x00 0x00 0x00 0x00 0x65 0x00 0x00 0x00 0x00 0x00 0x01 0x66 0x00 0x00 0x00 0x00 0x00 0x01 0x67 0x01 0x00 0x00 0x01 0x00 0x01 0x68 0x01 0x00 0x00 0x01 0x00 0x01 0x69 0x01 0x00 0x00 0x00 0x00 0x01 0x6a 0x01 0x00 0x00 0x00 0x00 0x01 0x6b 0x01 0x00 0x00 0x00 0x00 0x01 0x6c 0x01 0x00 0x00 0x00 0x00 0x01 0x6d 0x01 0x00 0x00 0x00 0x00 0x01 0x6e 0x01 0x00 0x00 0x00 0x00 0x01 0x6f 0x01 0x00 0x00 0x00 0x00 0x01 0x70 0x01 0x00 0x00 0x00 0x00 0x01 0x71 0x01 0x00 0x00 0x00 0x00 0x01 0x72 0x01 0x00 0x00 0x00 0x00 0x01 0x73 0x01 0x00 0x00 0x00 0x00 0x01 0x74 0x01 0x00 0x00 0x00 0x00 0x01 0x75 0x01 0x00 0x00 0x00 0x00 0x01 0x76 0x01 0x00 0x00 0x00 0x00 0x01 0x77 0x01 0x00 0x00 0x00 0x00 0x01 0x78 0x01 0x00 0x00 0x00 0x00 0x01 0x79 0x01 0x00 0x00 0x00 0x00 0x01 0x7a 0x01 0x00 0x00 0x00 0x00 0x01 0x7b 0x01 0x00 0x00 0x00 0x00 0x01 0x7c 0x01 0x00 0x00 0x00 0x00 0x01 0x7d 0x01 0x00 0x00 0x00 0x00 0x01 0x7e 0x01 0x00 0x00 0x00 0x00 0x01 0x7f 0x01 0x00 0x00 0x00 0x00 0x00 0x80 0x01 0x00 0x00 0x01 0x00 0x00 0x81 0x01 0x00 0x00 0x00 0x00 0x00 0x82 0x01 0x00 0x00 0x01 0x00 0x00 0x83 0x01 0x00 0x00 0x00 0x00 0x00 0x84 0x01 0x00 0x00 0x01 0x00 0x00 0x85 0x03 0x00 0x00 0x01 0x00 0x01 0x86 0x03 0x00 0x00 0x01 0x00 0x01 0x87 0x01 0x00 0x00 0x01 0x00 0x01 0x88 0x01 0x00 0x00 0x01 0x00 0x01 0x89 0x01 0x00 0x00 0x01 0x01 0x01 0x8a 0x01 0x00 0x00 0x01 0x01 0x01 0x8b 0x02 0x00 0x00 0x01 0x01 0x01 0x8c 0x02 0x00 0x00 0x01 0x01 0x01 0x8d 0x01 0x00 0x00 0x01 0x01 0x01 0x8e 0x01 0x00 0x00 0x01 0x01 0x01 0x8f 0x01 0x00 0x00 0x01 0x01 0x01 0x90 0x01 0x00 0x00 0x01 0x01 0x01 0x91 0x01 0x00 0x00 0x01 0x01 0x01 0x92 0x01 0x00 0x00 0x01 0x01 0x01 0x93 0x01 0x00 0x00 0x01 0x01 0x01 0x94 0x01 0x00 0x00 0x01 0x01 0x01 0x95 0x01 0x00 0x00 0x01 0x01 0x01 0x96 0x01 0x00 0x00 0x01 0x01 0x01 0x97 0x01 0x00 0x00 0x01 0x01 0x01 0x98 0x01 0x00 0x00 0x01 0x01 0x01 0x99 0x01 0x00 0x00 0x01 0x01 0x01 0x9a 0x01 0x00 0x00 0x01 0x01 0x01 0x9b 0x01 0x00 0x00 0x01 0x01 0x01 0x9c 0x01 0x00 0x00 0x01 0x01 0x01 0x9d 0x00 0x01 0x00 0x01 0x00 0x01 0x9e 0x00 0x01 0x00 0x01 0x00 0x01 0x9f 0x00 0x01 0x00 0x01 0x00 0x01 0xa0 0x03 0x00 0x00 0x01 0x00 0x01 0xa1 0x00 0x01 0x00 0x01 0x00 0x01 0xa2 0x00 0x01 0x00 0x01 0x00 0x01 0xa3 0x01 0x00 0x00 0x00 0x00 0x01 0xa4 0x01 0x00 0x00 0x00 0x00 0x01 0xa5 0x01 0x00 0x00 0x00 0x00 0x01 0xa6 0x01 0x00 0x00 0x00 0x00 0x01 0xa7 0x01 0x00 0x00 0x00 0x00 0x01 0xa8 0x01 0x00 0x00 0x00 0x00 0x01 0xa9 0x01 0x00 0x00 0x00 0x00 0x01 0xaa 0x01 0x00 0x00 0x01 0x00 0x01 0xab 0x01 0x00 0x00 0x00 0x00 0x01 0xac 0x01 0x00 0x00 0x00 0x00 0x01 0xad 0x01 0x00 0x00 0x00 0x00 0x01 0xae 0x01 0x00 0x00 0x00 0x00 0x01 0xaf 0x01 0x00 0x00 0x00 0x00 0x01 0xb0 0x01 0x00 0x00 0x00 0x00 0x01 0xb1 0x01 0x00 0x00 0x00 0x00 0x01 0xb2 0x01 0x00 0x00 0x00 0x00 0x01 0xb3 0x01 0x00 0x00 0x01 0x00 0x01 0xb4 0x01 0x00 0x00 0x01 0x00 0x01 0xb5 0x01 0x00 0x00 0x01 0x00 0x01 0xb6 0x00 0x01 0x00 0x01 0x00 0x01 0xb7 0x00 0x00 0x00 0x00 0x00 0x01 0xb8 0x00 0x00 0x00 0x01 0x00 0x01 0xb9 0x00 0x00 0x00 0x01 0x00 0x01 0xba 0x00 0x00 0x00 0x01 0x00 0x01 0xbb 0x00 0x00 0x00 0x01 0x00 0x01 0xbc 0x00 0x00 0x00 0x01 0x00 0x01 0xbd 0x00 0x00 0x00 0x01 0x00 0x01 0xbe 0x00 0x00 0x00 0x01 0x00 0x01 0xbf 0x00 0x00 0x00 0x01 0x00 0x01 0xc0 0x00 0x00 0x00 0x01 0x00 0x01 0xc1 0x01 0x00 0x00 0x00 0x00 0x01 0xc2 0x00 0x01 0x00 0x01 0x00 0x01 0xc3 0x00 0x01 0x00 0x01 0x00 0x01 0xc4 0x01 0x00 0x00 0x01 0x01 0x01 0xc5 0x01 0x00 0x00 0x00 0x00 0x01 0xc6 0x01 0x00 0x00 0x01 0x01 0x01 0xc7 0x00 0x01 0x00 0x01 0x00 0x01 0xc8 0x01 0x00 0x00 0x01 0x01 0x01 0xc9 0x01 0x00 0x00 0x01 0x01 0x01 0xca 0x01 0x00 0x00 0x01 0x01 0x01 0xcb 0x00 0x01 0x00 0x01 0x00 0x01 0xcc 0x01 0x00 0x00 0x01 0x01 0x01 0xcd 0x00 0x01 0x00 0x01 0x00 0x01 0xce 0x00 0x00 0x00 0x01 0x00 0x00 0xcf 0x00 0x00 0x00 0x01 0x00 0x00 0xd0 0x00 0x00 0x00 0x01 0x00 0x00 0xd1 0x00 0x00 0x00 0x01 0x00 0x00 0xd2 0x00 0x00 0x00 0x01 0x00 0x00 0xd3 0x00 0x00 0x00 0x01 0x00 0x00 0xd4 0x00 0x00 0x00 0x01 0x00 0x00 0xd5 0x00 0x00 0x00 0x01 0x00 0x00 0xd6 0x00 0x00 0x00 0x01 0x00 0x00 0xd7 0x00 0x00 0x00 0x01 0x00 0x00 0xd8 0x00 0x00 0x00 0x01 0x00 0x00 0xd9 0x00 0x00 0x00 0x01 0x00 0x00 0xda 0x00 0x00 0x00 0x01 0x00 0x00 0xdb 0x00 0x00 0x00 0x01 0x00 0x00 0xdc 0x00 0x00 0x00 0x01 0x00 0x00 0xdd 0x00 0x00 0x00 0x01 0x00 0x00 0xde 0x00 0x00 0x00 0x01 0x00 0x00 0xdf 0x00 0x00 0x00 0x01 0x00 0x00 0xe0 0x00 0x00 0x00 0x01 0x00 0x00 0xe1 0x00 0x00 0x00 0x01 0x00 0x00>;
		};
	};

	fragment@63 {
		target = <0xffffffff>;

		__overlay__ {
			interrupt-parent = <0xffffffff>;
			interrupts = <0x07 0x08>;
			status = "okay";
		};
	};

	fragment@64 {
		target = <0xffffffff>;

		__overlay__ {
			interrupt-parent = <0xffffffff>;
			interrupts = <0x0d 0x08>;
			deb-gpios = <0xffffffff 0x0d 0x00>;
			debounce = <0x7d000>;
			status = "okay";
		};
	};

	fragment@65 {
		target = <0xffffffff>;

		__overlay__ {
			interrupt-parent = <0xffffffff>;
			interrupts = <0x16 0x02>;
			status = "okay";
		};
	};

	fragment@66 {
		target = <0xffffffff>;

		__overlay__ {
			interrupt-parent = <0xffffffff>;
			interrupts = <0x17 0x02>;
			status = "okay";
		};
	};

	fragment@67 {
		target = <0xffffffff>;

		__overlay__ {
			interrupt-parent = <0xffffffff>;
			interrupts = <0x27 0x04>;
			deb-gpios = <0xffffffff 0x27 0x00>;
			debounce = <0x7d000>;
			status = "okay";
		};
	};

	fragment@68 {
		target = <0xffffffff>;

		__overlay__ {
			interrupt-parent = <0xffffffff>;
			interrupts = <0x28 0x04>;
			deb-gpios = <0xffffffff 0x28 0x00>;
			debounce = <0x7d000>;
			status = "okay";
		};
	};

	fragment@69 {
		target = <0xffffffff>;

		__overlay__ {
			interrupt-parent = <0xffffffff>;
			interrupts = <0x29 0x04>;
			deb-gpios = <0xffffffff 0x29 0x00>;
			debounce = <0x7d000>;
			status = "okay";
		};
	};

	fragment@70 {
		target = <0xffffffff>;

		__overlay__ {
			interrupt-parent = <0xffffffff>;
			interrupts = <0x2d 0x04>;
			deb-gpios = <0xffffffff 0x2d 0x00>;
			debounce = <0x7d000>;
			status = "okay";
		};
	};

	fragment@71 {
		target = <0xffffffff>;

		__overlay__ {
			interrupt-parent = <0xffffffff>;
			interrupts = <0x2e 0x08>;
			status = "okay";
		};
	};

	fragment@72 {
		target = <0xffffffff>;

		__overlay__ {
			interrupt-parent = <0xffffffff>;
			interrupts = <0x5e 0x01>;
			status = "okay";
		};
	};

	fragment@73 {
		target = <0xffffffff>;

		__overlay__ {
			compatible = "mediatek,md1_sim1_hot_plug_eint-eint";
			interrupts = <0x00 0x08>;
			debounce = <0x00 0x2710>;
			dedicated = <0x00 0x00>;
			src_pin = <0x00 0x01>;
			sockettype = <0x00 0x00>;
			status = "okay";
		};
	};

	fragment@74 {
		target = <0xffffffff>;

		__overlay__ {
			compatible = "mediatek,md1_sim2_hot_plug_eint-eint";
			interrupts = <0x01 0x08>;
			debounce = <0x01 0x2710>;
			dedicated = <0x01 0x00>;
			src_pin = <0x01 0x02>;
			sockettype = <0x01 0x00>;
			status = "okay";
		};
	};

	fragment@75 {
		target = <0xffffffff>;

		__overlay__ {
			mediatek,key-debounce = <0x400>;
			mediatek,sw-pwrkey = <0x74>;
			mediatek,hw-pwrkey = <0x08>;
			mediatek,sw-rstkey = <0x72>;
			mediatek,hw-rstkey = <0x11>;
			mediatek,use-extend-type = <0x00>;
			mediatek,hw-map-num = <0x48>;
			mediatek,hw-init-map = <0x73 0x00 0x00 0x00 0x00 0x00 0x00 0x00 0x00 0x00 0x00 0x00 0x00 0x00 0x00 0x00 0x00 0x00 0x00 0x00 0x00 0x00 0x00 0x00 0x00 0x00 0x00 0x00 0x00 0x00 0x00 0x00 0x00 0x00 0x00 0x00 0x00 0x00 0x00 0x00 0x00 0x00 0x00 0x00 0x00 0x00 0x00 0x00 0x00 0x00 0x00 0x00 0x00 0x00 0x00 0x00 0x00 0x00 0x00 0x00 0x00 0x00 0x00 0x00 0x00 0x00 0x00 0x00 0x00 0x00 0x00 0x00>;
			mediatek,pwrkey-eint-gpio = <0x00>;
			mediatek,pwkey-gpio-din = <0x00>;
			mediatek,hw-dl-key0 = <0x00>;
			mediatek,hw-dl-key1 = <0x11>;
			mediatek,hw-dl-key2 = <0x08>;
			mediatek,hw-recovery-key = <0x00>;
			mediatek,hw-factory-key = <0x11>;
			status = "okay";
		};
	};

	fragment@76 {
		target = <0xffffffff>;

		__overlay__ {
			usb_charger_current = <0x7a120>;
			ac_charger_current = <0x16e360>;
			ac_charger_input_current = <0x16e360>;
			non_std_ac_charger_current = <0xf4240>;
			charging_host_input_current = <0x16e360>;
			charging_host_charger_current = <0xf4240>;
			temp_t4_threshold = <0x3c>;
			boot_battery_voltage = <0x365240>;
		};
	};

	fragment@77 {
		target = <0xffffffff>;

		__overlay__ {
			enable_vbat_mon = <0x00>;
			boot_battery_voltage = <0x365240>;
			battery_cv = <0x44aa20>;
			max_charger_voltage = <0xa7d8c0>;
			disable_aicl;
			enable_dynamic_mivr;
			fast_charging_indicator = <0x16>;
			charger_configuration = <0x03>;
			usb_charger_current_suspend = <0x00>;
			usb_charger_current_unconfigured = <0x11170>;
			usb_charger_current_configured = <0x7a120>;
			usb_charger_current = <0x7a120>;
			ac_charger_current = <0x2dc6c0>;
			ac_charger_input_current = <0x1e8480>;
			non_std_ac_charger_current = <0xf4240>;
			charging_host_charger_current = <0x16e360>;
			apple_1_0a_charger_current = <0x9eb10>;
			apple_2_1a_charger_current = "\0\f5";
			ta_ac_charger_current = <0x1e8480>;
			typec_limit_aicr = <0x2dc6c0>;
			typecotp_charger = <0x01>;
			mmi,iterm-ma = <0xf3>;
			mmi,mmi-temp-zones = <0x00 0x1068 0x3e8 0x00 0x0a 0x109a 0xbb8 0x3e8 0x0a 0x1194 0x3e8 0x3e8 0x0f 0x1194 0xbb8 0xbb8 0x2d 0x10cc 0x170c 0x1450 0x2d 0x1130 0x1518 0xfa0 0x2d 0x11b2 0x1068 0xfa0 0x3c 0x1068 0xfa0 0x00>;
			mmi,mmi-ffc-zones = <0x00 0x1068 0xf3 0x0a 0x1194 0xf3 0x0f 0x1194 0xf3 0x19 0x11b2 0x1fa 0x23 0x11b2 0x230 0x2d 0x11b2 0x3c5 0x3c 0x1068 0xf3>;
			mmi,enable-charging-limit;
			mmi,upper-limit-capacity = <0x4b>;
			mmi,lower-limit-capacity = <0x46>;
			mmi,min-cp-therm-current-ua = <0x186a00>;
		};
	};

	fragment@78 {
		target = <0xffffffff>;

		__overlay__ {

			mmi_chrg_manager {
				compatible = "mmi,chrg-manager";
				mmi,pps-volt-steps = <0x4e20>;
				mmi,pps-curr-steps = <0x9c40>;
				mmi,pd-volt-max = <0xb71b00>;
				mmi,pd-curr-max = <0x2dc6c0>;
				mmi,batt-curr-boost = <0x493e0>;
				mmi,batt-ovp-lmt = <0x456d70>;
				mmi,pl-chrg-vbatt-min = <0x2dc6c0>;
				mmi,typec-middle-current = "\0\f5";
				mmi,step-first-current-comp = <0x00>;
				mmi,dont-rerun-aicl;
				mmi,chrg-temp-zones-num = <0x05>;
				mmi,mmi-chrg-temp-zones = <0x00 0x1068 0x3e8 0x00 0x00 0x00 0x00 0x0a 0x109a 0xbb8 0x1194 0x3e8 0x00 0x00 0x0f 0x1194 0xbb8 0x00 0x00 0x00 0x00 0x2d 0x10cc 0x1770 0x1130 0x1450 0x11b2 0xfa0 0x3c 0x1068 0xfa0 0x00 0x00 0x00 0x00>;
				mmi,mmi-ffc-zones = <0x1068 0x124 0x109a 0x124 0x1162 0x124 0x11b2 0x308 0x11b2 0x3b2 0x11b2 0x563 0x1068 0x124>;
				mmi,thermal-min-level = <0x16e360>;
				charger = <0xffffffff>;

				charger_device_0 {
					chrg-name = "pmic-sw";
					psy-name = "mtk-master-charger";
					charging-curr-limited = <0x7a120>;
				};

				charger_device_1 {
					chrg-name = "cp-master";
					psy-name = "cp-standalone";
					charging-curr-min = <0x1b7740>;
				};
			};
		};
	};

	fragment@79 {
		target = <0xffffffff>;

		__overlay__ {
			io-channels = <0xffffffff 0x01 0xffffffff 0x03 0xffffffff 0x04 0xffffffff 0x05 0xffffffff 0x06 0xffffffff 0x08 0xffffffff 0x02 0xffffffff 0x07 0xffffffff 0x0f 0xffffffff 0x09 0xffffffff 0x0a>;
			typecotp_chg = <0x01>;
			pinctrl-names = "mos_on\0mos_off";
			pinctrl-0 = <0x57>;
			pinctrl-1 = <0x58>;
			cv = <0x1194>;
			ircmp_r = <0x00>;
			ircmp_v = <0x00>;
		};
	};

	fragment@80 {
		target = <0xffffffff>;

		__overlay__ {
			vbus-current = <0x10c8e0>;
		};
	};

	fragment@81 {
		target = <0xffffffff>;

		__overlay__ {

			mos_on {
				phandle = <0x57>;

				pins_cmd_dat {
					pinmux = <0x2600>;
					slew-rate = <0x01>;
					output-high;
				};
			};

			mos_off {
				phandle = <0x58>;

				pins_cmd_dat {
					pinmux = <0x2600>;
					slew-rate = <0x01>;
					output-low;
				};
			};
		};
	};

	fragment@82 {
		target = <0xffffffff>;

		__overlay__ {
			sc_input_current = <0x2dc6c0>;
		};
	};

	fragment@83 {
		target = <0xffffffff>;

		__overlay__ {
			sc_input_current = <0x2dc6c0>;
		};
	};

	fragment@84 {
		target = <0xffffffff>;

		__overlay__ {
			typecotp_tcpc = <0x01>;

			pd-data {
				pd,source-cap-ext = [cf 29 75 63 00 00 00 00 00 00 00 00 00 00 00 00 00 00 00 00 00 00 01 04 00];
				pd,sink-cap-ext = <0xcf297563 0x00 0x100 0x00 0x10b010a 0xf000000>;
				pd,source-pdo-data = <0x1905a>;
				pd,sink-pdo-size = <0x01>;
				pd,sink-pdo-data = <0x1912c>;
			};
		};
	};

	fragment@85 {
		target = <0xffffffff>;

		__overlay__ {
			ita_min = <0x3e8>;
		};
	};

	fragment@86 {
		target = <0xffffffff>;

		__overlay__ {
			compatible = "mediatek,charger,pe5";
			gauge = <0xffffffff>;
			polling_interval = <0x2710>;
			ta_cv_ss_repeat_tmin = <0x19>;
			vbat_cv = <0x11b2>;
			start_soc_min = <0x00>;
			start_soc_max = <0x50>;
			start_vbat_max = <0x1162>;
			idvchg_term = <0x1f4>;
			idvchg_step = <0x32>;
			ita_level = <0xbb8 0x9c4 0x7d0 0x5dc>;
			rcable_level = <0x15e 0x190 0x1f4 0x258>;
			ita_level_dual = <0x1388 0xe74 0xd48 0xbb8>;
			rcable_level_dual = <0xe6 0x15e 0x1c2 0x226>;
			idvchg_ss_init = <0x3e8>;
			idvchg_ss_step = <0xfa>;
			idvchg_ss_step1 = <0x64>;
			idvchg_ss_step2 = <0x32>;
			idvchg_ss_step1_vbat = <0xfa0>;
			idvchg_ss_step2_vbat = <0x1068>;
			ta_blanking = <0x190>;
			swchg_aicr = <0x00>;
			swchg_ichg = <0x4b0>;
			swchg_aicr_ss_init = <0x190>;
			swchg_aicr_ss_step = <0xc8>;
			swchg_off_vbat = <0x109a>;
			force_ta_cv_vbat = <0x109a>;
			chg_time_max = <0x2a30>;
			tta_level_def = <0x00 0x00 0x00 0x00 0x19 0x32 0x3c 0x46 0x50>;
			tta_curlmt = <0x00 0x00 0x00 0x00 0x00 0x00 0x00 0x00 0x00>;
			tta_recovery_area = <0x03>;
			tbat_level_def = <0x00 0x00 0x00 0x05 0x19 0x28 0x2b 0x2e 0x32>;
			tbat_curlmt = <0x00 0x00 0x00 0x00 0x00 0x00 0x00 0x00 0x00>;
			tbat_recovery_area = <0x03>;
			tdvchg_level_def = <0x00 0x00 0x00 0x05 0x19 0x37 0x3c 0x41 0x46>;
			tdvchg_curlmt = <0x00 0x00 0x00 0x00 0x00 0x00 0x00 0x00 0x00>;
			tdvchg_recovery_area = <0x03>;
			tswchg_level_def = <0x00 0x00 0x00 0x05 0x19 0x41 0x46 0x4b 0x50>;
			tswchg_curlmt = <0x00 0x00 0x00 0x00 0x00 0x00 0x00 0x00 0x00>;
			tswchg_recovery_area = <0x03>;
			ifod_threshold = <0xc8>;
			rsw_min = <0x14>;
			ircmp_rbat = <0x28>;
			ircmp_vclamp = <0x00>;
			vta_cap_min = <0x1a90>;
			vta_cap_max = <0x2af8>;
			ita_cap_min = <0x3e8>;
			support_ta = "pca_ta_pps\0pd_adapter";
			allow_not_check_ta_status;
			vbat_threshold = <0x1036>;
			mmi_therm_cur_thres = <0x1f4>;
			mmi_therm_vol_thres = <0x50>;
			mmi_therm_step = <0x03>;
			mmi_max_ibat = <0x1770>;
		};
	};

	fragment@87 {
		target = <0xffffffff>;

		__overlay__ {
			DIFFERENCE_FULLOCV_ITH = <0x50>;
			EMBEDDED_SEL = <0x01>;
			VIR_OLDOCV_DIFF_EMB = <0xbb8>;
			VIR_OLDOCV_DIFF_EMB_LT = <0xbb8>;
			CURR_MEASURE_20A = <0x00>;
			UNIT_MULTIPLE = <0x01>;
			g_temperature = <0x32 0x19 0x0a 0x00 0xfffffff6 0xffffffe7 0xffffffe2 0xffffffdd 0xffffffd8 0xffffffd3>;
			g_FG_PSEUDO100 = <0x60 0x60 0x64 0x64 0x60 0x60 0x64 0x64 0x60 0x60 0x64 0x64 0x60 0x60 0x64 0x64 0x60 0x60 0x64 0x64 0x64 0x64 0x64 0x64 0x64 0x64 0x64 0x64 0x64 0x64 0x64 0x64 0x64 0x64 0x64 0x64 0x64 0x64 0x64 0x64>;
			g_Q_MAX = <0x1385 0x136a 0x9ba 0x7ad 0x1388 0x13b3 0x9a4 0x7c0 0x13b6 0x13a1 0x906 0x79a 0x1380 0x12c3 0x742 0x751 0x1341 0x120c 0x733 0x73b 0x8a3 0x674 0x5fd 0x605 0x899 0x66a 0x5f3 0x5fb 0x88f 0x660 0x5e9 0x5f1 0x885 0x656 0x5df 0x5e7 0x87b 0x64c 0x5d5 0x5dd>;
			g_Q_MAX_H_CURRENT = <0x1351 0x12ae 0x88e 0x681 0x1383 0x1309 0x878 0x694 0x1386 0x1306 0x7da 0x66e 0x133f 0x1312 0x616 0x625 0x12e3 0x1313 0x607 0x60f 0x8a2 0x672 0x5fd 0x605 0x898 0x668 0x5f3 0x5fb 0x88e 0x65e 0x5e9 0x5f1 0x884 0x654 0x5df 0x5e7 0x87a 0x64a 0x5d5 0x5dd>;
			g_PMIC_MIN_VOL_row = <0x04>;
			g_PMIC_MIN_VOL_col = <0x0a>;
			g_PMIC_MIN_VOL = <0x7d00 0x7d00 0x82dc 0x82dc 0x7d00 0x7d00 0x80e8 0x80e8 0x80e8 0x82dc 0x80e8 0x80e8 0x7dc8 0x8340 0x7dc8 0x7dc8 0x7a80 0x82dc 0x7a80 0x7a80 0x7918 0x7918 0x7918 0x7918 0x7918 0x7918 0x7918 0x7918 0x7918 0x7918 0x7918 0x7918 0x7918 0x7918 0x7918 0x7918 0x7918 0x7918 0x7918 0x79e0>;
			g_QMAX_SYS_VOL_row = <0x04>;
			g_QMAX_SYS_VOL_col = <0x0a>;
			g_QMAX_SYS_VOL = <0x7ef4 0x7ef4 0x8886 0x8886 0x7ef4 0x7ef4 0x8886 0x8886 0x85ca 0x82dc 0x85ca 0x85ca 0x85ca 0x8340 0x85ca 0x85ca 0x85ca 0x82dc 0x85ca 0x85ca 0x85ca 0x85ca 0x85ca 0x85ca 0x8020 0x8020 0x8020 0x8020 0x8020 0x8020 0x8020 0x8020 0x8020 0x8020 0x8020 0x8020 0x8020 0x8020 0x8020 0x8020>;
			SHUTDOWN_1_TIME = <0x1e>;
			ACTIVE_TABLE = <0x05>;
			R_FG_VALUE = <0x05>;
			NO_BAT_TEMP_COMPENSATE = <0x01>;
			df-serialnum = "SB18D94521";
			serialnum_1 = "SB18D94522";
			battery1_profile_t0_num = <0x64>;
			battery1_profile_t0_col = <0x04>;
			battery1_profile_t0 = <0x00 0xad89 0x2ff 0x266 0x203 0xad0f 0x2ff 0x266 0x406 0xaca5 0x30a 0x26e 0x609 0xac3b 0x30f 0x272 0x80d 0xabd3 0x30f 0x272 0xa10 0xab6d 0x30f 0x272 0xc13 0xab02 0x310 0x273 0xe16 0xaa98 0x316 0x278 0x1019 0xaa2e 0x316 0x278 0x121c 0xa9bf 0x316 0x278 0x1420 0xa94d 0x316 0x278 0x1623 0xa8da 0x316 0x278 0x1826 0xa864 0x317 0x279 0x1a29 0xa7ed 0x318 0x27a 0x1c2c 0xa772 0x316 0x278 0x1e2f 0xa6f7 0x323 0x282 0x2032 0xa67b 0x321 0x281 0x2236 0xa5ff 0x324 0x283 0x2439 0xa580 0x323 0x282 0x263c 0xa500 0x320 0x280 0x283f 0xa481 0x325 0x284 0x2a42 0xa405 0x328 0x286 0x2c45 0xa388 0x32e 0x28b 0x2e48 0xa30d 0x333 0x28f 0x304c 0xa293 0x335 0x291 0x324f 0xa219 0x337 0x292 0x3452 0xa19f 0x339 0x294 0x3655 0xa128 0x33e 0x298 0x3858 0xa0b0 0x33e 0x298 0x3a5b 0xa03e 0x344 0x29d 0x3c5f 0x9fcb 0x344 0x29d 0x3e62 0x9f5b 0x349 0x2a1 0x4065 0x9eee 0x357 0x2ac 0x4268 0x9e84 0x366 0x2b8 0x446b 0x9e1a 0x36d 0x2be 0x466e 0x9db2 0x37a 0x2c8 0x4871 0x9d4a 0x380 0x2cd 0x4a75 0x9ce8 0x399 0x2e1 0x4c78 0x9c84 0x3af 0x2f2 0x4e7b 0x9c20 0x3c6 0x305 0x507e 0x9bb8 0x3db 0x316 0x5281 0x9b41 0x3d6 0x312 0x5484 0x9ab1 0x398 0x2e0 0x5688 0x9a15 0x34b 0x2a2 0x588b 0x9995 0x31c 0x27d 0x5a8e 0x992c 0x30e 0x272 0x5c91 0x98d3 0x30f 0x272 0x5e94 0x9882 0x30c 0x270 0x6097 0x9836 0x306 0x26b 0x629a 0x97ef 0x300 0x266 0x649e 0x97ac 0x306 0x26b 0x66a1 0x976c 0x307 0x26c 0x68a4 0x972e 0x307 0x26c 0x6aa7 0x96f2 0x30a 0x26e 0x6caa 0x96b8 0x30a 0x26e 0x6ead 0x967f 0x302 0x268 0x70b0 0x964c 0x30e 0x272 0x72b4 0x9619 0x30e 0x272 0x74b7 0x95e7 0x30f 0x272 0x76ba 0x95b8 0x314 0x276 0x78bd 0x958b 0x31b 0x27c 0x7ac0 0x955e 0x31e 0x27e 0x7cc3 0x9532 0x320 0x280 0x7ec7 0x950d 0x32f 0x28c 0x80ca 0x94e5 0x33a 0x295 0x82cd 0x94bf 0x343 0x29c 0x84d0 0x949a 0x348 0x2a0 0x86d3 0x9473 0x352 0x2a8 0x88d6 0x9447 0x35a 0x2ae 0x8ad9 0x940d 0x34c 0x2a3 0x8cdd 0x93b8 0x316 0x278 0x8ee0 0x9368 0x303 0x269 0x90e3 0x932d 0x30c 0x270 0x92e6 0x92fa 0x314 0x276 0x94e9 0x92c9 0x319 0x27a 0x96ec 0x9295 0x31b 0x27c 0x98f0 0x9261 0x316 0x278 0x9af3 0x9231 0x316 0x278 0x9cf6 0x9206 0x31c 0x27d 0x9ef9 0x91dc 0x32f 0x28c 0xa0fc 0x91a9 0x337 0x292 0xa2ff 0x916a 0x32c 0x28a 0xa502 0x9126 0x31e 0x27e 0xa706 0x90e4 0x323 0x282 0xa909 0x90a4 0x334 0x290 0xab0c 0x9052 0x31a 0x27b 0xad0f 0x9011 0x2f0 0x25a 0xaf12 0x8ff6 0x2fb 0x262 0xb115 0x8fea 0x31c 0x27d 0xb318 0x8fdc 0x347 0x29f 0xb51c 0x8fcd 0x38f 0x2d9 0xb71f 0x8fb2 0x3de 0x318 0xb922 0x8f5a 0x3ed 0x324 0xbb25 0x8e32 0x386 0x2d2 0xbd28 0x8c6a 0x36f 0x2bf 0xbf2b 0x8a02 0x39a 0x2e2 0xc12f 0x86b1 0x3f6 0x32b 0xc332 0x814e 0x845 0x69e 0xc535 0x76d9 0x1ebc 0x1896 0xc738 0x76d9 0x1ebc 0x1896>;
			battery1_profile_t1_num = <0x64>;
			battery1_profile_t1_col = <0x04>;
			battery1_profile_t1 = <0x00 0xae2e 0x48b 0x417 0x203 0xad96 0x48b 0x417 0x406 0xad22 0x4a2 0x42b 0x609 0xacb8 0x4a5 0x42e 0x80d 0xac53 0x49e 0x428 0xa10 0xabef 0x495 0x420 0xc13 0xab8b 0x48c 0x418 0xe16 0xab29 0x492 0x41d 0x1019 0xaabe 0x48b 0x417 0x121c 0xaa56 0x48b 0x417 0x1420 0xa9eb 0x48b 0x417 0x1623 0xa97a 0x48b 0x417 0x1826 0xa908 0x48b 0x417 0x1a29 0xa895 0x48b 0x417 0x1c2c 0xa81d 0x48a 0x416 0x1e2f 0xa7a2 0x484 0x410 0x2032 0xa728 0x489 0x415 0x2236 0xa6aa 0x486 0x412 0x2439 0xa62c 0x479 0x407 0x263c 0xa5ae 0x46c 0x3fb 0x283f 0xa530 0x46c 0x3fb 0x2a42 0xa4b1 0x46a 0x3f9 0x2c45 0xa434 0x473 0x401 0x2e48 0xa3b7 0x47a 0x407 0x304c 0xa33a 0x47c 0x409 0x324f 0xa2be 0x482 0x40f 0x3452 0xa245 0x48b 0x417 0x3655 0xa1cd 0x48e 0x419 0x3858 0xa155 0x49c 0x426 0x3a5b 0xa0e0 0x4a0 0x42a 0x3c5f 0xa06d 0x4ae 0x436 0x3e62 0x9ffd 0x4bc 0x443 0x4065 0x9f8b 0x4c5 0x44b 0x4268 0x9f1b 0x4d1 0x456 0x446b 0x9eaf 0x4e5 0x468 0x466e 0x9e47 0x4fe 0x47e 0x4871 0x9ddc 0x504 0x484 0x4a75 0x9d74 0x524 0x4a0 0x4c78 0x9d0f 0x54b 0x4c4 0x4e7b 0x9ca8 0x564 0x4da 0x507e 0x9c3f 0x571 0x4e6 0x5281 0x9bd1 0x574 0x4e8 0x5484 0x9b55 0x557 0x4ce 0x5688 0x9acb 0x50e 0x48d 0x588b 0x9a37 0x4b2 0x43a 0x5a8e 0x99b1 0x468 0x3f7 0x5c91 0x9941 0x43d 0x3d1 0x5e94 0x98e2 0x42a 0x3bf 0x6097 0x988c 0x422 0x3b8 0x629a 0x983f 0x41d 0x3b4 0x649e 0x97f8 0x426 0x3bc 0x66a1 0x97b5 0x427 0x3bd 0x68a4 0x9774 0x427 0x3bd 0x6aa7 0x9736 0x425 0x3bb 0x6caa 0x96fb 0x424 0x3ba 0x6ead 0x96c6 0x428 0x3be 0x70b0 0x968e 0x434 0x3c8 0x72b4 0x9659 0x425 0x3bb 0x74b7 0x9629 0x426 0x3bc 0x76ba 0x95f9 0x427 0x3bd 0x78bd 0x95cb 0x42a 0x3bf 0x7ac0 0x959e 0x434 0x3c8 0x7cc3 0x9574 0x440 0x3d3 0x7ec7 0x954d 0x44c 0x3de 0x80ca 0x9524 0x44c 0x3de 0x82cd 0x94ff 0x458 0x3e9 0x84d0 0x94dc 0x46c 0x3fb 0x86d3 0x94b8 0x473 0x401 0x88d6 0x9494 0x478 0x406 0x8ad9 0x946f 0x47d 0x40a 0x8cdd 0x9444 0x469 0x3f8 0x8ee0 0x941a 0x465 0x3f5 0x90e3 0x93e8 0x451 0x3e3 0x92e6 0x93b5 0x442 0x3d5 0x94e9 0x9384 0x439 0x3cd 0x96ec 0x9353 0x436 0x3ca 0x98f0 0x9320 0x437 0x3cb 0x9af3 0x92ee 0x43d 0x3d1 0x9cf6 0x92bf 0x43d 0x3d1 0x9ef9 0x9299 0x449 0x3db 0xa0fc 0x926f 0x44e 0x3e0 0xa2ff 0x9240 0x453 0x3e4 0xa502 0x9205 0x44f 0x3e1 0xa706 0x91c4 0x446 0x3d9 0xa909 0x9188 0x44f 0x3e1 0xab0c 0x914d 0x464 0x3f4 0xad0f 0x9101 0x46b 0x3fa 0xaf12 0x90af 0x462 0x3f2 0xb115 0x9082 0x466 0x3f5 0xb318 0x906f 0x476 0x404 0xb51c 0x9062 0x489 0x415 0xb71f 0x9053 0x4a0 0x42a 0xb922 0x903b 0x4c9 0x44f 0xbb25 0x900e 0x51e 0x49b 0xbd28 0x8f57 0x506 0x485 0xbf2b 0x8dd2 0x4e1 0x464 0xc12f 0x8b9a 0x4ee 0x470 0xc332 0x8893 0x540 0x4ba 0xc535 0x83d9 0x6a5 0x5fb 0xc738 0x7b22 0xca8 0xb64>;
			battery1_profile_t2_num = <0x64>;
			battery1_profile_t2_col = <0x04>;
			battery1_profile_t2 = <0x00 0xada8 0xb3b 0xb3b 0x203 0xad23 0xb3b 0xb3b 0x406 0xacb6 0xb40 0xb40 0x609 0xac52 0xb3e 0xb3e 0x80d 0xabf0 0xb2b 0xb2b 0xa10 0xab8d 0xb0e 0xb0e 0xc13 0xab2b 0xaf6 0xaf6 0xe16 0xaac9 0xacf 0xacf 0x1019 0xaa61 0xab5 0xab5 0x121c 0xa9f9 0xa9f 0xa9f 0x1420 0xa98e 0xa8b 0xa8b 0x1623 0xa91e 0xa70 0xa70 0x1826 0xa8ab 0xa5a 0xa5a 0x1a29 0xa838 0xa5a 0xa5a 0x1c2c 0xa7c0 0xa5c 0xa5c 0x1e2f 0xa748 0xa4d 0xa4d 0x2032 0xa6cc 0xa40 0xa40 0x2236 0xa64d 0xa2a 0xa2a 0x2439 0xa5d0 0xa21 0xa21 0x263c 0xa555 0xa20 0xa20 0x283f 0xa4d7 0xa10 0xa10 0x2a42 0xa457 0x9fe 0x9fe 0x2c45 0xa3dd 0xa04 0xa04 0x2e48 0xa35e 0x9ff 0x9ff 0x304c 0xa2e2 0x9f9 0x9f9 0x324f 0xa267 0x9f6 0x9f6 0x3452 0xa1ef 0x9fb 0x9fb 0x3655 0xa179 0xa04 0xa04 0x3858 0xa102 0x9fe 0x9fe 0x3a5b 0xa08c 0xa04 0xa04 0x3c5f 0xa017 0xa05 0xa05 0x3e62 0x9fa6 0xa14 0xa14 0x4065 0x9f35 0xa22 0xa22 0x4268 0x9ec3 0xa25 0xa25 0x446b 0x9e51 0xa26 0xa26 0x466e 0x9de4 0xa35 0xa35 0x4871 0x9d74 0xa35 0xa35 0x4a75 0x9d05 0xa2f 0xa2f 0x4c78 0x9c8f 0xa19 0xa19 0x4e7b 0x9c16 0x9fa 0x9fa 0x507e 0x9b9a 0x9d4 0x9d4 0x5281 0x9b1c 0x9a1 0x9a1 0x5484 0x9a9a 0x95e 0x95e 0x5688 0x9a1f 0x922 0x922 0x588b 0x99ae 0x8f2 0x8f2 0x5a8e 0x9944 0x8ce 0x8ce 0x5c91 0x98e4 0x8b5 0x8b5 0x5e94 0x988c 0x8a4 0x8a4 0x6097 0x9839 0x89b 0x89b 0x629a 0x97ed 0x89b 0x89b 0x649e 0x97aa 0x89f 0x89f 0x66a1 0x9765 0x89c 0x89c 0x68a4 0x9726 0x8a3 0x8a3 0x6aa7 0x96ea 0x8b0 0x8b0 0x6caa 0x96ae 0x8b9 0x8b9 0x6ead 0x9673 0x8bc 0x8bc 0x70b0 0x963e 0x8c9 0x8c9 0x72b4 0x960c 0x8d6 0x8d6 0x74b7 0x95d9 0x8e4 0x8e4 0x76ba 0x95a8 0x8eb 0x8eb 0x78bd 0x957a 0x8f9 0x8f9 0x7ac0 0x954f 0x90d 0x90d 0x7cc3 0x9525 0x91d 0x91d 0x7ec7 0x94f6 0x91f 0x91f 0x80ca 0x94d1 0x934 0x934 0x82cd 0x94ae 0x946 0x946 0x84d0 0x9487 0x946 0x946 0x86d3 0x9465 0x95d 0x95d 0x88d6 0x9442 0x973 0x973 0x8ad9 0x941d 0x972 0x972 0x8cdd 0x93fb 0x973 0x973 0x8ee0 0x93d9 0x982 0x982 0x90e3 0x93b6 0x993 0x993 0x92e6 0x9395 0x999 0x999 0x94e9 0x9371 0x99d 0x99d 0x96ec 0x9347 0x9a1 0x9a1 0x98f0 0x931d 0x9a3 0x9a3 0x9af3 0x92f3 0x9ab 0x9ab 0x9cf6 0x92c8 0x9be 0x9be 0x9ef9 0x929f 0x9e4 0x9e4 0xa0fc 0x926f 0xa07 0xa07 0xa2ff 0x923b 0xa36 0xa36 0xa502 0x91ff 0xa5f 0xa5f 0xa706 0x91bc 0xa80 0xa80 0xa909 0x9177 0xab1 0xab1 0xab0c 0x9135 0xafa 0xafa 0xad0f 0x90e1 0xb3f 0xb3f 0xaf12 0x9090 0xb82 0xb82 0xb115 0x905b 0xbe5 0xbe5 0xb318 0x903c 0xc6b 0xc6b 0xb51c 0x9023 0xd16 0xd16 0xb71f 0x9006 0xdf6 0xdf6 0xb922 0x8fdc 0xf1c 0xf1c 0xbb25 0x8f8b 0x10b8 0x10b8 0xbd28 0x8ebb 0x129f 0x129f 0xbf2b 0x8d20 0x1578 0x1578 0xc12f 0x8ab2 0x1bf9 0x1bf9 0xc332 0x8742 0x3324 0x3324 0xc535 0x8362 0x5ee2 0x5ee2 0xc738 0x8362 0x5ee2 0x5ee2>;
			battery1_profile_t3_num = <0x64>;
			battery1_profile_t3_col = <0x04>;
			battery1_profile_t3 = <0x00 0xae34 0x160b 0x160b 0x203 0xad77 0x160b 0x160b 0x406 0xace2 0x167f 0x167f 0x609 0xac61 0x16c8 0x16c8 0x80d 0xabeb 0x16e0 0x16e0 0xa10 0xab7b 0x16e3 0x16e3 0xc13 0xab0c 0x16de 0x16de 0xe16 0xaa9d 0x16cb 0x16cb 0x1019 0xaa2a 0x16aa 0x16aa 0x121c 0xa9bd 0x1695 0x1695 0x1420 0xa94b 0x1673 0x1673 0x1623 0xa8d8 0x164e 0x164e 0x1826 0xa864 0x1631 0x1631 0x1a29 0xa7f0 0x1619 0x1619 0x1c2c 0xa778 0x15f0 0x15f0 0x1e2f 0xa6fc 0x15b6 0x15b6 0x2032 0xa681 0x1585 0x1585 0x2236 0xa606 0x1556 0x1556 0x2439 0xa58b 0x152f 0x152f 0x263c 0xa510 0x1509 0x1509 0x283f 0xa493 0x14db 0x14db 0x2a42 0xa419 0x14b3 0x14b3 0x2c45 0xa39c 0x148c 0x148c 0x2e48 0xa323 0x1474 0x1474 0x304c 0xa2a8 0x144d 0x144d 0x324f 0xa22f 0x1431 0x1431 0x3452 0xa1b8 0x1422 0x1422 0x3655 0xa13e 0x140d 0x140d 0x3858 0xa0c9 0x13fa 0x13fa 0x3a5b 0xa04e 0x13de 0x13de 0x3c5f 0x9fd9 0x13d7 0x13d7 0x3e62 0x9f62 0x13b4 0x13b4 0x4065 0x9eef 0x139f 0x139f 0x4268 0x9e7c 0x1395 0x1395 0x446b 0x9e05 0x137c 0x137c 0x466e 0x9d92 0x1365 0x1365 0x4871 0x9d1b 0x133f 0x133f 0x4a75 0x9ca6 0x1323 0x1323 0x4c78 0x9c2e 0x12f4 0x12f4 0x4e7b 0x9bb7 0x12c2 0x12c2 0x507e 0x9b3f 0x1297 0x1297 0x5281 0x9ac9 0x126d 0x126d 0x5484 0x9a56 0x1240 0x1240 0x5688 0x99e1 0x1215 0x1215 0x588b 0x9973 0x11e9 0x11e9 0x5a8e 0x990f 0x11d3 0x11d3 0x5c91 0x98ae 0x11c3 0x11c3 0x5e94 0x9852 0x11b4 0x11b4 0x6097 0x97ff 0x11b1 0x11b1 0x629a 0x97af 0x11b7 0x11b7 0x649e 0x9767 0x11be 0x11be 0x66a1 0x971f 0x11ca 0x11ca 0x68a4 0x96de 0x11d7 0x11d7 0x6aa7 0x969e 0x11e4 0x11e4 0x6caa 0x9660 0x11f3 0x11f3 0x6ead 0x9626 0x1205 0x1205 0x70b0 0x95ef 0x1215 0x1215 0x72b4 0x95b9 0x122f 0x122f 0x74b7 0x9587 0x1249 0x1249 0x76ba 0x9556 0x1264 0x1264 0x78bd 0x9526 0x1287 0x1287 0x7ac0 0x94f9 0x12ac 0x12ac 0x7cc3 0x94ce 0x12cb 0x12cb 0x7ec7 0x94a4 0x12e6 0x12e6 0x80ca 0x947f 0x130e 0x130e 0x82cd 0x9458 0x133d 0x133d 0x84d0 0x9435 0x1366 0x1366 0x86d3 0x9417 0x138a 0x138a 0x88d6 0x93fa 0x13b4 0x13b4 0x8ad9 0x93df 0x13e8 0x13e8 0x8cdd 0x93c2 0x1417 0x1417 0x8ee0 0x93aa 0x1460 0x1460 0x90e3 0x938b 0x14aa 0x14aa 0x92e6 0x936c 0x1507 0x1507 0x94e9 0x934c 0x156b 0x156b 0x96ec 0x932a 0x15cf 0x15cf 0x98f0 0x9303 0x163e 0x163e 0x9af3 0x92d8 0x16d2 0x16d2 0x9cf6 0x92a8 0x1764 0x1764 0x9ef9 0x9276 0x1802 0x1802 0xa0fc 0x923d 0x18c4 0x18c4 0xa2ff 0x9201 0x19ac 0x19ac 0xa502 0x91c1 0x1aa7 0x1aa7 0xa706 0x917d 0x1ba4 0x1ba4 0xa909 0x9132 0x1cb4 0x1cb4 0xab0c 0x90e5 0x1dff 0x1dff 0xad0f 0x9095 0x1f6b 0x1f6b 0xaf12 0x9053 0x214e 0x214e 0xb115 0x901a 0x23b5 0x23b5 0xb318 0x8fe2 0x26d2 0x26d2 0xb51c 0x8fab 0x2b1a 0x2b1a 0xb71f 0x8f75 0x3143 0x3143 0xb922 0x8f37 0x3a8f 0x3a8f 0xbb25 0x8ee3 0x48b4 0x48b4 0xbd28 0x8ed0 0x4bf5 0x4bf5 0xbf2b 0x8ed0 0x4bf5 0x4bf5 0xc12f 0x8ed0 0x4bf5 0x4bf5 0xc332 0x8ed0 0x4bf5 0x4bf5 0xc535 0x8ed0 0x4bf5 0x4bf5 0xc738 0x8ed0 0x4bf5 0x4bf5>;
			battery1_profile_t4_num = <0x64>;
			battery1_profile_t4_col = <0x04>;
			battery1_profile_t4 = <0x00 0xadfc 0x2e68 0x2e68 0x203 0xad2c 0x2e68 0x2e68 0x406 0xac78 0x2f06 0x2f06 0x609 0xabd3 0x2f82 0x2f82 0x80d 0xab36 0x2fa9 0x2fa9 0xa10 0xaa9d 0x2f93 0x2f93 0xc13 0xaa08 0x2f68 0x2f68 0xe16 0xa976 0x2f34 0x2f34 0x1019 0xa8e9 0x2ee9 0x2ee9 0x121c 0xa85e 0x2e7d 0x2e7d 0x1420 0xa7d4 0x2e11 0x2e11 0x1623 0xa74c 0x2db5 0x2db5 0x1826 0xa6c8 0x2d61 0x2d61 0x1a29 0xa645 0x2d00 0x2d00 0x1c2c 0xa5c0 0x2c97 0x2c97 0x1e2f 0xa543 0x2c39 0x2c39 0x2032 0xa4c6 0x2bd1 0x2bd1 0x2236 0xa449 0x2b74 0x2b74 0x2439 0xa3cc 0x2b24 0x2b24 0x263c 0xa34e 0x2adb 0x2adb 0x283f 0xa2d2 0x2a94 0x2a94 0x2a42 0xa258 0x2a58 0x2a58 0x2c45 0xa1da 0x2a16 0x2a16 0x2e48 0xa164 0x29cd 0x29cd 0x304c 0xa0eb 0x2989 0x2989 0x324f 0xa071 0x2940 0x2940 0x3452 0x9ff9 0x28ea 0x28ea 0x3655 0x9f83 0x2896 0x2896 0x3858 0x9f0e 0x2868 0x2868 0x3a5b 0x9e96 0x2826 0x2826 0x3c5f 0x9e1f 0x27f4 0x27f4 0x3e62 0x9da9 0x27ca 0x27ca 0x4065 0x9d35 0x27a6 0x27a6 0x4268 0x9cc2 0x277e 0x277e 0x446b 0x9c4e 0x274b 0x274b 0x466e 0x9bde 0x271b 0x271b 0x4871 0x9b73 0x26fa 0x26fa 0x4a75 0x9b09 0x26de 0x26de 0x4c78 0x9aa3 0x26d3 0x26d3 0x4e7b 0x9a3c 0x26be 0x26be 0x507e 0x99d8 0x2694 0x2694 0x5281 0x9977 0x2666 0x2666 0x5484 0x9918 0x2654 0x2654 0x5688 0x98bd 0x2677 0x2677 0x588b 0x9868 0x2693 0x2693 0x5a8e 0x9810 0x26a9 0x26a9 0x5c91 0x97bd 0x26b8 0x26b8 0x5e94 0x9770 0x26c9 0x26c9 0x6097 0x9726 0x26d4 0x26d4 0x629a 0x96db 0x26c2 0x26c2 0x649e 0x9699 0x26d5 0x26d5 0x66a1 0x9656 0x26ea 0x26ea 0x68a4 0x9616 0x26f3 0x26f3 0x6aa7 0x95d9 0x26fd 0x26fd 0x6caa 0x959f 0x270e 0x270e 0x6ead 0x956a 0x2727 0x2727 0x70b0 0x953a 0x2750 0x2750 0x72b4 0x950a 0x2780 0x2780 0x74b7 0x94df 0x27af 0x27af 0x76ba 0x94b9 0x27e8 0x27e8 0x78bd 0x9493 0x283f 0x283f 0x7ac0 0x9470 0x289a 0x289a 0x7cc3 0x9450 0x28ee 0x28ee 0x7ec7 0x9431 0x295c 0x295c 0x80ca 0x9414 0x29a5 0x29a5 0x82cd 0x93f3 0x2a12 0x2a12 0x84d0 0x93d5 0x2aa3 0x2aa3 0x86d3 0x93b7 0x2b7a 0x2b7a 0x88d6 0x9396 0x2c6b 0x2c6b 0x8ad9 0x9374 0x2d4d 0x2d4d 0x8cdd 0x9354 0x2e32 0x2e32 0x8ee0 0x932e 0x2f27 0x2f27 0x90e3 0x9309 0x3030 0x3030 0x92e6 0x92e6 0x313c 0x313c 0x94e9 0x92be 0x324a 0x324a 0x96ec 0x9296 0x3347 0x3347 0x98f0 0x926e 0x3427 0x3427 0x9af3 0x923e 0x3501 0x3501 0x9cf6 0x9211 0x3654 0x3654 0x9ef9 0x91e1 0x37b4 0x37b4 0xa0fc 0x91ac 0x3920 0x3920 0xa2ff 0x9177 0x3aab 0x3aab 0xa502 0x9140 0x3c4a 0x3c4a 0xa706 0x9104 0x3e00 0x3e00 0xa909 0x90c8 0x3ff0 0x3ff0 0xab0c 0x9090 0x423a 0x423a 0xad0f 0x9053 0x451d 0x451d 0xaf12 0x901a 0x48fe 0x48fe 0xb115 0x8fe5 0x4f41 0x4f41 0xb318 0x8fb3 0x5d1c 0x5d1c 0xb51c 0x8f90 0x6b44 0x6b44 0xb71f 0x8f90 0x6b44 0x6b44 0xb922 0x8f90 0x6b44 0x6b44 0xbb25 0x8f90 0x6b44 0x6b44 0xbd28 0x8f90 0x6b44 0x6b44 0xbf2b 0x8f90 0x6b44 0x6b44 0xc12f 0x8f90 0x6b44 0x6b44 0xc332 0x8f90 0x6b44 0x6b44 0xc535 0x8f90 0x6b44 0x6b44 0xc738 0x8f90 0x6b44 0x6b44>;
			serialnum_0 = "SB18D94521";
			battery0_profile_t0_num = <0x64>;
			battery0_profile_t0_col = <0x04>;
			battery0_profile_t0 = <0x00 0xae3d 0x2d5 0x2c7 0x201 0xad4c 0x2d5 0x2c7 0x401 0xac92 0x2dc 0x2cd 0x602 0xabf7 0x2de 0x2cf 0x803 0xab6e 0x2e4 0x2d5 0xa04 0xaaef 0x2ea 0x2db 0xc04 0xaa77 0x2e8 0x2d9 0xe05 0xaa06 0x2eb 0x2dc 0x1006 0xa992 0x2eb 0x2dc 0x1207 0xa91d 0x2eb 0x2dc 0x1407 0xa8a8 0x2f1 0x2e2 0x1608 0xa831 0x2f6 0x2e7 0x1809 0xa7b8 0x2f5 0x2e6 0x1a09 0xa73f 0x2f7 0x2e8 0x1c0a 0xa6c3 0x2fa 0x2eb 0x1e0b 0xa648 0x301 0x2f2 0x200c 0xa5cc 0x303 0x2f4 0x220c 0xa54e 0x303 0x2f4 0x240d 0xa4d1 0x303 0x2f4 0x260e 0xa454 0x303 0x2f4 0x280e 0xa3d7 0x303 0x2f4 0x2a0f 0xa35c 0x300 0x2f1 0x2c10 0xa2e0 0x2fe 0x2ef 0x2e11 0xa268 0x305 0x2f6 0x3011 0xa1f1 0x308 0x2f8 0x3212 0xa17b 0x306 0x2f7 0x3413 0xa106 0x306 0x2f7 0x3614 0xa092 0x306 0x2f7 0x3814 0xa021 0x30c 0x2fc 0x3a15 0x9fb3 0x313 0x303 0x3c16 0x9f45 0x316 0x306 0x3e16 0x9ed9 0x317 0x307 0x4017 0x9e6f 0x31a 0x30a 0x4218 0x9e07 0x31d 0x30d 0x4419 0x9da3 0x325 0x315 0x4619 0x9d3f 0x327 0x317 0x481a 0x9cde 0x32e 0x31e 0x4a1b 0x9c81 0x33a 0x329 0x4c1c 0x9c25 0x344 0x333 0x4e1c 0x9bca 0x350 0x33f 0x501d 0x9b73 0x365 0x354 0x521e 0x9b1b 0x37d 0x36b 0x541e 0x9ac3 0x39c 0x38a 0x561f 0x9a5e 0x3a9 0x396 0x5820 0x99da 0x37a 0x368 0x5a21 0x9945 0x330 0x320 0x5c21 0x98bf 0x2ff 0x2f0 0x5e22 0x985d 0x2fd 0x2ee 0x6023 0x9809 0x2f7 0x2e8 0x6223 0x97c1 0x2f7 0x2e8 0x6424 0x977e 0x2f7 0x2e8 0x6625 0x973d 0x2f7 0x2e8 0x6826 0x9700 0x2f6 0x2e7 0x6a26 0x96c6 0x2f2 0x2e3 0x6c27 0x968c 0x2eb 0x2dc 0x6e28 0x9659 0x2f3 0x2e4 0x7029 0x9624 0x2ed 0x2de 0x7229 0x95f4 0x2f2 0x2e3 0x742a 0x95c6 0x2f7 0x2e8 0x762b 0x9598 0x2f7 0x2e8 0x782b 0x956b 0x2f7 0x2e8 0x7a2c 0x9541 0x2f7 0x2e8 0x7c2d 0x9517 0x2f7 0x2e8 0x7e2e 0x94f1 0x2fe 0x2ef 0x802e 0x94cd 0x307 0x2f8 0x822f 0x94aa 0x30e 0x2fe 0x8430 0x9487 0x313 0x303 0x8631 0x9468 0x31e 0x30e 0x8831 0x9448 0x32b 0x31b 0x8a32 0x9427 0x33d 0x32c 0x8c33 0x93f9 0x33e 0x32d 0x8e33 0x93b2 0x315 0x305 0x9034 0x9362 0x2f0 0x2e1 0x9235 0x931c 0x2ec 0x2dd 0x9436 0x92e7 0x2f3 0x2e4 0x9636 0x92b9 0x303 0x2f4 0x9837 0x9287 0x301 0x2f2 0x9a38 0x9255 0x2fa 0x2eb 0x9c38 0x9228 0x2fd 0x2ee 0x9e39 0x91fe 0x308 0x2f8 0xa03a 0x91d4 0x315 0x305 0xa23b 0x91a9 0x327 0x317 0xa43b 0x9171 0x322 0x312 0xa63c 0x912d 0x313 0x303 0xa83d 0x90ed 0x317 0x307 0xaa3e 0x90ac 0x322 0x312 0xac3e 0x9062 0x311 0x301 0xae3f 0x9017 0x2df 0x2d0 0xb040 0x8feb 0x2c9 0x2bb 0xb240 0x8fe0 0x2f5 0x2e6 0xb441 0x8fd6 0x348 0x337 0xb642 0x8fc7 0x3a7 0x394 0xb843 0x8fab 0x400 0x3ec 0xba43 0x8f4d 0x404 0x3ef 0xbc44 0x8e5d 0x38e 0x37c 0xbe45 0x8c9e 0x366 0x355 0xc046 0x8a38 0x39a 0x388 0xc246 0x86d7 0x404 0x3ef 0xc447 0x8108 0x5ca 0x5ac 0xc648 0x72d0 0xd9e 0xd58>;
			battery0_profile_t1_num = <0x64>;
			battery0_profile_t1_col = <0x04>;
			battery0_profile_t1 = <0x00 0xae3e 0x41f 0x41f 0x201 0xad50 0x41f 0x41f 0x401 0xaca3 0x42a 0x42a 0x602 0xac16 0x42a 0x42a 0x803 0xab96 0x42a 0x42a 0xa04 0xab1f 0x42a 0x42a 0xc04 0xaaad 0x41f 0x41f 0xe05 0xaa3a 0x41d 0x41d 0x1006 0xa9c9 0x41f 0x41f 0x1207 0xa955 0x41a 0x41a 0x1407 0xa8e0 0x416 0x416 0x1608 0xa869 0x416 0x416 0x1809 0xa7f0 0x417 0x417 0x1a09 0xa775 0x415 0x415 0x1c0a 0xa6f8 0x415 0x415 0x1e0b 0xa67a 0x40b 0x40b 0x200c 0xa5fd 0x40e 0x40e 0x220c 0xa57d 0x40b 0x40b 0x240d 0xa4fd 0x409 0x409 0x260e 0xa47f 0x40c 0x40c 0x280e 0xa3fe 0x407 0x407 0x2a0f 0xa382 0x40f 0x40f 0x2c10 0xa30a 0x414 0x414 0x2e11 0xa28e 0x415 0x415 0x3011 0xa214 0x412 0x412 0x3212 0xa19c 0x415 0x415 0x3413 0xa127 0x41b 0x41b 0x3614 0xa0b1 0x419 0x419 0x3814 0xa041 0x42c 0x42c 0x3a15 0x9fcf 0x42e 0x42e 0x3c16 0x9f5f 0x42e 0x42e 0x3e16 0x9ef3 0x435 0x435 0x4017 0x9e89 0x442 0x442 0x4218 0x9e20 0x44f 0x44f 0x4419 0x9dbc 0x45c 0x45c 0x4619 0x9d57 0x46f 0x46f 0x481a 0x9cf5 0x47f 0x47f 0x4a1b 0x9c97 0x496 0x496 0x4c1c 0x9c3a 0x4ad 0x4ad 0x4e1c 0x9bdd 0x4c1 0x4c1 0x501d 0x9b81 0x4d6 0x4d6 0x521e 0x9b27 0x4ef 0x4ef 0x541e 0x9ac7 0x503 0x503 0x561f 0x9a56 0x4f6 0x4f6 0x5820 0x99ce 0x4af 0x4af 0x5a21 0x9940 0x459 0x459 0x5c21 0x98bf 0x418 0x418 0x5e22 0x9854 0x3f5 0x3f5 0x6023 0x97fd 0x3e8 0x3e8 0x6223 0x97ae 0x3e1 0x3e1 0x6424 0x9767 0x3db 0x3db 0x6625 0x9728 0x3dd 0x3dd 0x6826 0x96ec 0x3dc 0x3dc 0x6a26 0x96b2 0x3d7 0x3d7 0x6c27 0x967b 0x3d7 0x3d7 0x6e28 0x9646 0x3d6 0x3d6 0x7029 0x9614 0x3dd 0x3dd 0x7229 0x95e6 0x3e5 0x3e5 0x742a 0x95b9 0x3e8 0x3e8 0x762b 0x958c 0x3e8 0x3e8 0x782b 0x9561 0x3ec 0x3ec 0x7a2c 0x953c 0x3f7 0x3f7 0x7c2d 0x9514 0x3f7 0x3f7 0x7e2e 0x94f2 0x3fd 0x3fd 0x802e 0x94cf 0x404 0x404 0x822f 0x94af 0x410 0x410 0x8430 0x948f 0x417 0x417 0x8631 0x946f 0x419 0x419 0x8831 0x9452 0x424 0x424 0x8a32 0x9432 0x426 0x426 0x8c33 0x9413 0x433 0x433 0x8e33 0x93ec 0x425 0x425 0x9034 0x93c0 0x412 0x412 0x9235 0x9393 0x402 0x402 0x9436 0x9366 0x3f3 0x3f3 0x9636 0x9334 0x3e7 0x3e7 0x9837 0x9301 0x3e1 0x3e1 0x9a38 0x92d4 0x3e6 0x3e6 0x9c38 0x92a9 0x3e3 0x3e3 0x9e39 0x9282 0x3e3 0x3e3 0xa03a 0x925c 0x3ef 0x3ef 0xa23b 0x9233 0x3ff 0x3ff 0xa43b 0x91fa 0x3fd 0x3fd 0xa63c 0x91b5 0x3f1 0x3f1 0xa83d 0x917a 0x3fb 0x3fb 0xaa3e 0x913c 0x405 0x405 0xac3e 0x90ee 0x3fc 0x3fc 0xae3f 0x90a0 0x3e8 0x3e8 0xb040 0x906d 0x3e1 0x3e1 0xb240 0x9060 0x402 0x402 0xb441 0x9050 0x40c 0x40c 0xb642 0x903f 0x432 0x432 0xb843 0x9028 0x484 0x484 0xba43 0x8fe5 0x4cf 0x4cf 0xbc44 0x8f14 0x4c6 0x4c6 0xbe45 0x8d68 0x478 0x478 0xc046 0x8b11 0x4b0 0x4b0 0xc246 0x87b1 0x51f 0x51f 0xc447 0x81c4 0x69e 0x69e 0xc648 0x73b0 0xfcd 0xfcd>;
			battery0_profile_t2_num = <0x64>;
			battery0_profile_t2_col = <0x04>;
			battery0_profile_t2 = <0x00 0xae64 0x7bf 0x7bf 0x201 0xad69 0x7bf 0x7bf 0x401 0xacb4 0x7ae 0x7ae 0x602 0xac26 0x792 0x792 0x803 0xabac 0x775 0x775 0xa04 0xab3d 0x75b 0x75b 0xc04 0xaad0 0x740 0x740 0xe05 0xaa64 0x721 0x721 0x1006 0xa9f7 0x70c 0x70c 0x1207 0xa98a 0x6fb 0x6fb 0x1407 0xa91b 0x6eb 0x6eb 0x1608 0xa8a8 0x6d5 0x6d5 0x1809 0xa831 0x6bb 0x6bb 0x1a09 0xa7b9 0x6b0 0x6b0 0x1c0a 0xa740 0x69e 0x69e 0x1e0b 0xa6c3 0x689 0x689 0x200c 0xa646 0x67a 0x67a 0x220c 0xa5c9 0x66e 0x66e 0x240d 0xa54c 0x664 0x664 0x260e 0xa4ce 0x65a 0x65a 0x280e 0xa451 0x64f 0x64f 0x2a0f 0xa3d4 0x645 0x645 0x2c10 0xa358 0x63f 0x63f 0x2e11 0xa2df 0x63e 0x63e 0x3011 0xa265 0x63c 0x63c 0x3212 0xa1ec 0x639 0x639 0x3413 0xa177 0x637 0x637 0x3614 0xa102 0x637 0x637 0x3814 0xa08d 0x637 0x637 0x3a15 0xa01b 0x640 0x640 0x3c16 0x9fae 0x64e 0x64e 0x3e16 0x9f40 0x656 0x656 0x4017 0x9ed3 0x65b 0x65b 0x4218 0x9e69 0x66b 0x66b 0x4419 0x9e00 0x678 0x678 0x4619 0x9d9c 0x692 0x692 0x481a 0x9d38 0x6a1 0x6a1 0x4a1b 0x9cd3 0x6ac 0x6ac 0x4c1c 0x9c73 0x6c0 0x6c0 0x4e1c 0x9c15 0x6d7 0x6d7 0x501d 0x9bb6 0x6e3 0x6e3 0x521e 0x9b52 0x6e9 0x6e9 0x541e 0x9aec 0x6e6 0x6e6 0x561f 0x9a7b 0x6cb 0x6cb 0x5820 0x99ff 0x691 0x691 0x5a21 0x997e 0x643 0x643 0x5c21 0x98ff 0x5f7 0x5f7 0x5e22 0x988c 0x5c0 0x5c0 0x6023 0x982a 0x5a1 0x5a1 0x6223 0x97d5 0x58b 0x58b 0x6424 0x978a 0x582 0x582 0x6625 0x9745 0x580 0x580 0x6826 0x9703 0x580 0x580 0x6a26 0x96c6 0x580 0x580 0x6c27 0x968c 0x580 0x580 0x6e28 0x9655 0x580 0x580 0x7029 0x9620 0x582 0x582 0x7229 0x95ec 0x581 0x581 0x742a 0x95bc 0x585 0x585 0x762b 0x958e 0x58c 0x58c 0x782b 0x9562 0x590 0x590 0x7a2c 0x953c 0x5a1 0x5a1 0x7c2d 0x9512 0x5a4 0x5a4 0x7e2e 0x94ea 0x5a9 0x5a9 0x802e 0x94c5 0x5ae 0x5ae 0x822f 0x94a3 0x5b6 0x5b6 0x8430 0x9482 0x5c0 0x5c0 0x8631 0x9461 0x5cb 0x5cb 0x8831 0x9444 0x5d5 0x5d5 0x8a32 0x9426 0x5d5 0x5d5 0x8c33 0x940b 0x5e0 0x5e0 0x8e33 0x93f0 0x5e8 0x5e8 0x9034 0x93d4 0x5e8 0x5e8 0x9235 0x93b8 0x5e6 0x5e6 0x9436 0x939b 0x5e8 0x5e8 0x9636 0x937c 0x5ee 0x5ee 0x9837 0x9353 0x5da 0x5da 0x9a38 0x9326 0x5cd 0x5cd 0x9c38 0x92f8 0x5c9 0x5c9 0x9e39 0x92cc 0x5c9 0x5c9 0xa03a 0x92a3 0x5cf 0x5cf 0xa23b 0x927c 0x5e3 0x5e3 0xa43b 0x924a 0x5ed 0x5ed 0xa63c 0x920c 0x601 0x601 0xa83d 0x91cb 0x60e 0x60e 0xaa3e 0x918a 0x61f 0x61f 0xac3e 0x9148 0x638 0x638 0xae3f 0x90fc 0x652 0x652 0xb040 0x909e 0x65b 0x65b 0xb240 0x906b 0x685 0x685 0xb441 0x904c 0x6ba 0x6ba 0xb642 0x9032 0x6fe 0x6fe 0xb843 0x9017 0x769 0x769 0xba43 0x8ff0 0x80b 0x80b 0xbc44 0x8fa4 0x8f7 0x8f7 0xbe45 0x8efb 0xa66 0xa66 0xc046 0x8d2b 0xd31 0xd31 0xc246 0x8a76 0x17de 0x17de 0xc447 0x86c6 0x3a29 0x3a29 0xc648 0x81bf 0x32f0 0x32f0>;
			battery0_profile_t3_num = <0x64>;
			battery0_profile_t3_col = <0x04>;
			battery0_profile_t3 = <0x00 0xae84 0xe66 0xe66 0x201 0xad6d 0xe66 0xe66 0x401 0xacab 0xe4a 0xe4a 0x602 0xac14 0xe15 0xe15 0x803 0xab94 0xde1 0xde1 0xa04 0xab21 0xdb4 0xdb4 0xc04 0xaab1 0xd80 0xd80 0xe05 0xaa49 0xd51 0xd51 0x1006 0xa9dc 0xd22 0xd22 0x1207 0xa96d 0xce9 0xce9 0x1407 0xa8fe 0xcbc 0xcbc 0x1608 0xa88d 0xc91 0xc91 0x1809 0xa819 0xc5c 0xc5c 0x1a09 0xa7a4 0xc1f 0xc1f 0x1c0a 0xa72b 0xbf6 0xbf6 0x1e0b 0xa6b2 0xbcc 0xbcc 0x200c 0xa636 0xba2 0xba2 0x220c 0xa5b9 0xb79 0xb79 0x240d 0xa53d 0xb53 0xb53 0x260e 0xa4c1 0xb34 0xb34 0x280e 0xa445 0xb18 0xb18 0x2a0f 0xa3c8 0xaf8 0xaf8 0x2c10 0xa34f 0xae0 0xae0 0x2e11 0xa2d3 0xac8 0xac8 0x3011 0xa259 0xab5 0xab5 0x3212 0xa1e1 0xaa7 0xaa7 0x3413 0xa16b 0xa9b 0xa9b 0x3614 0xa0f6 0xa96 0xa96 0x3814 0xa081 0xa91 0xa91 0x3a15 0xa00e 0xa92 0xa92 0x3c16 0x9f9c 0xa8a 0xa8a 0x3e16 0x9f2b 0xa88 0xa88 0x4017 0x9ebe 0xa90 0xa90 0x4218 0x9e51 0xa97 0xa97 0x4419 0x9de6 0xa9c 0xa9c 0x4619 0x9d7a 0xa9c 0xa9c 0x481a 0x9d12 0xaa7 0xaa7 0x4a1b 0x9caa 0xaa6 0xaa6 0x4c1c 0x9c41 0xaa1 0xaa1 0x4e1c 0x9bd8 0xa9b 0xa9b 0x501d 0x9b6e 0xa8b 0xa8b 0x521e 0x9afb 0xa66 0xa66 0x541e 0x9a84 0xa38 0xa38 0x561f 0x9a08 0x9f4 0x9f4 0x5820 0x998f 0x9b5 0x9b5 0x5a21 0x991b 0x980 0x980 0x5c21 0x98b0 0x955 0x955 0x5e22 0x984d 0x935 0x935 0x6023 0x97f3 0x911 0x911 0x6223 0x97a1 0x907 0x907 0x6424 0x9757 0x907 0x907 0x6625 0x9713 0x902 0x902 0x6826 0x96d2 0x900 0x900 0x6a26 0x9692 0x904 0x904 0x6c27 0x9655 0x8fd 0x8fd 0x6e28 0x961f 0x908 0x908 0x7029 0x95e9 0x909 0x909 0x7229 0x95b6 0x918 0x918 0x742a 0x9586 0x927 0x927 0x762b 0x9558 0x931 0x931 0x782b 0x952b 0x93d 0x93d 0x7a2c 0x9501 0x94f 0x94f 0x7c2d 0x94d7 0x95c 0x95c 0x7e2e 0x94b1 0x967 0x967 0x802e 0x948f 0x979 0x979 0x822f 0x946c 0x986 0x986 0x8430 0x944a 0x992 0x992 0x8631 0x942b 0x9a9 0x9a9 0x8831 0x940e 0x9b4 0x9b4 0x8a32 0x93f5 0x9c9 0x9c9 0x8c33 0x93dc 0x9de 0x9de 0x8e33 0x93c6 0x9f6 0x9f6 0x9034 0x93af 0xa10 0xa10 0x9235 0x9396 0xa2c 0xa2c 0x9436 0x937c 0xa4b 0xa4b 0x9636 0x935f 0xa6b 0xa6b 0x9837 0x9339 0xa8a 0xa8a 0x9a38 0x9310 0xaa5 0xaa5 0x9c38 0x92e4 0xac6 0xac6 0x9e39 0x92b6 0xaf6 0xaf6 0xa03a 0x9287 0xb3b 0xb3b 0xa23b 0x9253 0xb8e 0xb8e 0xa43b 0x9215 0xbe2 0xbe2 0xa63c 0x91ce 0xc49 0xc49 0xa83d 0x9187 0xcc9 0xcc9 0xaa3e 0x9140 0xd70 0xd70 0xac3e 0x90f1 0xe37 0xe37 0xae3f 0x9095 0xf21 0xf21 0xb040 0x903e 0x1054 0x1054 0xb240 0x9003 0x1213 0x1213 0xb441 0x8fd3 0x14ce 0x14ce 0xb642 0x8f9b 0x1910 0x1910 0xb843 0x8f55 0x213b 0x213b 0xba43 0x8ee6 0x34ab 0x34ab 0xbc44 0x8e2e 0x4fcf 0x4fcf 0xbe45 0x8c7d 0x4dca 0x4dca 0xc046 0x89cc 0x4718 0x4718 0xc246 0x867d 0x3ed3 0x3ed3 0xc447 0x8435 0x391e 0x391e 0xc648 0x8435 0x391e 0x391e>;
			battery0_profile_t4_num = <0x64>;
			battery0_profile_t4_col = <0x04>;
			battery0_profile_t4 = <0x00 0xaee1 0x1e76 0x1e76 0x201 0xad96 0x1e76 0x1e76 0x401 0xacaa 0x1e5b 0x1e5b 0x602 0xabf2 0x1e1a 0x1e1a 0x803 0xab56 0x1dcd 0x1dcd 0xa04 0xaacb 0x1d7a 0x1d7a 0xc04 0xaa47 0x1d13 0x1d13 0xe05 0xa9c8 0x1cc4 0x1cc4 0x1006 0xa94b 0x1c60 0x1c60 0x1207 0xa8d1 0x1c03 0x1c03 0x1407 0xa859 0x1baf 0x1baf 0x1608 0xa7e1 0x1b60 0x1b60 0x1809 0xa76a 0x1b0d 0x1b0d 0x1a09 0xa6f0 0x1ab1 0x1ab1 0x1c0a 0xa679 0x1a64 0x1a64 0x1e0b 0xa5ff 0x1a45 0x1a13 0x200c 0xa58a 0x19ff 0x19cd 0x220c 0xa513 0x19c1 0x198f 0x240d 0xa49c 0x1980 0x194e 0x260e 0xa425 0x1937 0x1905 0x280e 0xa3ae 0x18f2 0x18c0 0x2a0f 0xa339 0x18cb 0x1899 0x2c10 0xa2c4 0x1895 0x1863 0x2e11 0xa250 0x1866 0x1834 0x3011 0xa1da 0x1834 0x1802 0x3212 0xa165 0x1804 0x17d2 0x3413 0xa0f4 0x17dd 0x17ab 0x3614 0xa084 0x17bd 0x178b 0x3814 0xa010 0x1796 0x1764 0x3a15 0x9fa0 0x1774 0x1742 0x3c16 0x9f30 0x1752 0x1720 0x3e16 0x9ec1 0x1731 0x16ff 0x4017 0x9e52 0x1713 0x16e1 0x4218 0x9de4 0x16f8 0x16c6 0x4419 0x9d77 0x16d6 0x16a4 0x4619 0x9d04 0x16ba 0x1688 0x481a 0x9c92 0x1689 0x1657 0x4a1b 0x9c21 0x165e 0x162c 0x4c1c 0x9bad 0x1632 0x1600 0x4e1c 0x9b39 0x1601 0x15cf 0x501d 0x9ac4 0x15cd 0x159b 0x521e 0x9a4f 0x1596 0x1564 0x541e 0x99e0 0x1569 0x1537 0x561f 0x9971 0x1534 0x1502 0x5820 0x9907 0x1513 0x14e1 0x5a21 0x98a4 0x14f8 0x14c6 0x5c21 0x9847 0x14e1 0x14af 0x5e22 0x97ee 0x14d6 0x14a4 0x6023 0x9799 0x14d0 0x149e 0x6223 0x974c 0x14d0 0x149e 0x6424 0x9704 0x14d5 0x14a3 0x6625 0x96be 0x14dd 0x14ab 0x6826 0x967c 0x14ea 0x14b8 0x6a26 0x963e 0x14fe 0x14cc 0x6c27 0x9604 0x151a 0x14e8 0x6e28 0x95ca 0x1536 0x1504 0x7029 0x9598 0x155c 0x152a 0x7229 0x9563 0x157a 0x1548 0x742a 0x9533 0x159d 0x156b 0x762b 0x9508 0x15c7 0x1595 0x782b 0x94dd 0x15f6 0x15c4 0x7a2c 0x94b4 0x1625 0x15f3 0x7c2d 0x948f 0x1654 0x1622 0x7e2e 0x946c 0x168e 0x165c 0x802e 0x9452 0x16d4 0x16a2 0x822f 0x9436 0x1720 0x16ee 0x8430 0x941d 0x177d 0x174b 0x8631 0x9408 0x17e7 0x17b5 0x8831 0x93f0 0x184d 0x181b 0x8a32 0x93d8 0x18cb 0x1899 0x8c33 0x93c0 0x1962 0x1930 0x8e33 0x93a6 0x19f9 0x19c7 0x9034 0x938c 0x1aa6 0x1a74 0x9235 0x936f 0x1b69 0x1b37 0x9436 0x934f 0x1c3e 0x1c0c 0x9636 0x932e 0x1d2d 0x1cfb 0x9837 0x9307 0x1e29 0x1df7 0x9a38 0x92de 0x1f3d 0x1f0b 0x9c38 0x92b1 0x2079 0x2047 0x9e39 0x927e 0x219f 0x219f 0xa03a 0x9248 0x2314 0x2314 0xa23b 0x920f 0x24b3 0x24b3 0xa43b 0x91d4 0x2691 0x2691 0xa63c 0x9193 0x28b0 0x28b0 0xa83d 0x914b 0x2b25 0x2b25 0xaa3e 0x9100 0x2e1c 0x2e1c 0xac3e 0x90b0 0x31ab 0x31ab 0xae3f 0x905f 0x3610 0x3610 0xb040 0x9011 0x3b99 0x3b99 0xb240 0x8fca 0x4291 0x4291 0xb441 0x8f93 0x4c03 0x4c03 0xb642 0x8f66 0x550f 0x550f 0xb843 0x8f30 0x548a 0x548a 0xba43 0x8ed0 0x53a4 0x53a4 0xbc44 0x8df6 0x5179 0x5179 0xbe45 0x8c3f 0x4d5a 0x4d5a 0xc046 0x871b 0x4087 0x4087 0xc246 0x834f 0x36e5 0x36e5 0xc447 0x834f 0x36e5 0x36e5 0xc648 0x834f 0x36e5 0x36e5>;
		};
	};

	fragment@88 {
		target = <0xffffffff>;

		__overlay__ {

			bq25960-standalone@65 {
				compatible = "ti,bq25960-standalone";
				reg = <0x65>;
				interrupt-parent = <0xffffffff>;
				interrupts = <0x00 0x02 0x00 0x00>;
				interrupt-names = "bq25960_irq";
				pinctrl-names = "default";
				pinctrl-0 = <0x59>;
				sc8541-addr = <0x6a>;
			};

			wt6670f@35 {
				status = "okay";
				compatible = "mediatek,wt6670f_qc3p";
				reg = <0x35>;
				wt6670f-reset-gpio = <0xffffffff 0x1e 0x00>;
				wt6670f-int-gpio = <0xffffffff 0x13 0x00>;
				wt6670f-i2c-scl-pin = <0xffffffff 0x9b 0x00>;
				wt6670f-i2c-sda-pin = <0xffffffff 0x9c 0x00>;
				pinctrl-names = "default\0wt6670_i2c_scl_low\0wt6670_i2c_scl_high\0wt6670_i2c_sda_low\0wt6670_i2c_sda_high\0wt6670_i2c";
				pinctrl-0 = <0x5a>;
				pinctrl-1 = <0x5b>;
				pinctrl-2 = <0x5c>;
				pinctrl-3 = <0x5d>;
				pinctrl-4 = <0x5e>;
				pinctrl-5 = <0x5f>;
			};
		};
	};

	fragment@89 {
		target = <0xffffffff>;

		__overlay__ {

			wt6670_default_mode {
				phandle = <0x5a>;
			};

			wt6670_scl_low {
				phandle = <0x5b>;

				pins_cmd_dat {
					pinmux = <0x9b00>;
					slew-rate = <0x01>;
					output-low;
				};
			};

			wt6670_scl_high {
				phandle = <0x5c>;

				pins_cmd_dat {
					pinmux = <0x9b00>;
					slew-rate = <0x01>;
					output-high;
				};
			};

			wt6670_sda_low {
				phandle = <0x5d>;

				pins_cmd_dat {
					pinmux = <0x9c00>;
					slew-rate = <0x01>;
					output-low;
				};
			};

			wt6670_sda_high {
				phandle = <0x5e>;

				pins_cmd_dat {
					pinmux = <0x9c00>;
					slew-rate = <0x01>;
					output-high;
				};
			};

			wt6670_i2c_mode {
				phandle = <0x5f>;

				pins_cmd_dat {
					pinmux = <0x9c01 0x9b01>;
				};
			};

			bq25960_int_default {
				pinmux = <0x00>;
				slew-rate = <0x00>;
				input-enable;
				bias-pull-up;
				phandle = <0x59>;
			};
		};
	};

	fragment@90 {
		target = <0xffffffff>;

		__overlay__ {
			compatible = "gpio-leds";

			charging {
				label = "charging";
				gpios = <0xffffffff 0x17 0x00>;
				default-state = "off";
			};
		};
	};

	fragment@91 {
		target = <0xffffffff>;

		__overlay__ {
			bootmode = <0xffffffff>;
			mmi,thermal-mitigation = <0xffffffff 0x4f5880 0x4c4b40 0x47b760 0x44aa20 0x3d0900 0x33e140 0x2dc6c0 0x2625a0 0x1e8480 0xf4240 0xc3500 0x7a120>;
			mmi,thermal-charger-pump-support;
		};
	};

	fragment@92 {
		target = <0xffffffff>;

		__overlay__ {
			polling-delay = <0x1388>;
			polling-delay-passive = <0xbb8>;
			thermal-sensors = <0xffffffff>;
		};
	};

	fragment@93 {
		target = <0xffffffff>;

		__overlay__ {
			compatible = "mmi,moto-chg-tcmd";
			status = "okay";
			mmi,ntc_table = <0x01>;
			mmi,ntc_v_ref = <0x1b7740>;
			mmi,ntc_r_pull = <0x186a0>;
			mmi,batid_v_ref = <0x1b7740>;
			mmi,batid_r_pull = <0x186a0>;
			mmi,adc-channel-cpu = <0x00>;
			mmi,adc-channel-charger = <0x02>;
			mmi,adc-channel-pa = <0x01>;
			mmi,adc-channel-batid = <0x03>;
			mmi,adc-channel-vbat = <0x64>;
		};
	};

	fragment@94 {
		target = <0xffffffff>;

		__overlay__ {
			led_brightness = <0x3ff>;
		};
	};

	fragment@95 {
		target = <0xffffffff>;

		__overlay__ {
			compatible = "mediatek,mt6855-board-ntc";
			status = "okay";
			#thermal-sensor-cells = <0x00>;
			io-channels = <0x56 0x17>;
			io-channel-names = "Surface_NTC";
			temperature-lookup-table = <0xffff63c0 0x43183f 0xffff67a8 0x3e73c9 0xffff6b90 0x3a2985 0xffff6f78 0x363204 0xffff7360 0x328683 0xffff7748 0x2f20d6 0xffff7b30 0x2bfb5b 0xffff7f18 0x2910ed 0xffff8300 0x265cd9 0xffff86e8 0x23dad1 0xffff8ad0 0x2186e9 0xffff8eb8 0x1f5d85 0xffff92a0 0x1d5b5b 0xffff9688 0x1b7d65 0xffff9a70 0x19c0dd 0xffff9e58 0x182338 0xffffa240 0x16a15b 0xffffa628 0x153a09 0xffffaa10 0x13eb44 0xffffadf8 0x12b33a 0xffffb1e0 0x11903c 0xffffb5c8 0x1080bf 0xffffb9b0 0xf8355 0xffffbd98 0xe96af 0xffffc180 0xdb998 0xffffc568 0xceaf2 0xffffc950 0xc29b7 0xffffcd38 0xb74f2 0xffffd120 0xacbc3 0xffffd508 0xa2d5c 0xffffd8f0 0x998fc 0xffffdcd8 0x90dbe 0xffffe0c0 0x88b3a 0xffffe4a8 0x810d9 0xffffe890 0x79e0c 0xffffec78 0x73250 0xfffff060 0x6cd4b 0xfffff448 0x66e67 0xfffff830 0x6153c 0xfffffc18 0x5c168 0x00 0x57293 0x3e8 0x52855 0x7d0 0x4e279 0xbb8 0x4a0b6 0xfa0 0x462c9 0x1388 0x42873 0x1770 0x3f17a 0x1b58 0x3bda8 0x1f40 0x38cc9 0x2328 0x35eaf 0x2710 0x3332e 0x2af8 0x30a1c 0x2ee0 0x2e354 0x32c8 0x2beb2 0x36b0 0x29c13 0x3a98 0x27b5b 0x3e80 0x25c66 0x4268 0x23f20 0x4650 0x2236e 0x4a38 0x20938 0x4e20 0x1f068 0x5208 0x1d8ea 0x55f0 0x1c2a8 0x59d8 0x1ad92 0x5dc0 0x19994 0x61a8 0x186a0 0x6590 0x174a6 0x6978 0x16398 0x6d60 0x15369 0x7148 0x1440c 0x7530 0x13576 0x7918 0x1279b 0x7d00 0x11a72 0x80e8 0x10df0 0x84d0 0x1020d 0x88b8 0xf6bf 0x8ca0 0xebff 0x9088 0xe1c5 0x9470 0xd80a 0x9858 0xcec6 0x9c40 0xc5f5 0xa028 0xbd90 0xa410 0xb592 0xa7f8 0xadf5 0xabe0 0xa6b3 0xafc8 0x9fc8 0xb3b0 0x992d 0xb798 0x92e1 0xbb80 0x8cdf 0xbf68 0x8723 0xc350 0x81ab 0xc738 0x7c73 0xcb20 0x7778 0xcf08 0x72b6 0xd2f0 0x6e2b 0xd6d8 0x69d3 0xdac0 0x65ac 0xdea8 0x61b5 0xe290 0x5dea 0xe678 0x5a49 0xea60 0x56d0 0xee48 0x537e 0xf230 0x5050 0xf618 0x4d46 0xfa00 0x4a5c 0xfde8 0x4792 0x101d0 0x44e8 0x105b8 0x425a 0x109a0 0x3fe8 0x10d88 0x3d8f 0x11170 0x3b50 0x11558 0x3927 0x11940 0x3714 0x11d28 0x3517 0x12110 0x332f 0x124f8 0x315b 0x128e0 0x2f9b 0x12cc8 0x2dec 0x130b0 0x2c4f 0x13498 0x2ac2 0x13880 0x2945 0x13c68 0x27d7 0x14050 0x2677 0x14438 0x2525 0x14820 0x23e0 0x14c08 0x22a8 0x14ff0 0x217c 0x153d8 0x205b 0x157c0 0x1f45 0x15ba8 0x1e3a 0x15f90 0x1d39 0x16378 0x1c42 0x16760 0x1b55 0x16b48 0x1a71 0x16f30 0x1994 0x17318 0x18c1 0x17700 0x17f4 0x17ae8 0x172e 0x17ed0 0x1670 0x182b8 0x15b9 0x186a0 0x1508 0x18a88 0x145e 0x18e70 0x13bb 0x19258 0x131d 0x19640 0x1285 0x19a28 0x11f2 0x19e10 0x1165 0x1a1f8 0x10dc 0x1a5e0 0x1058 0x1a9c8 0xfd9 0x1adb0 0xf5e 0x1b198 0xee8 0x1b580 0xe75 0x1b968 0xe07 0x1bd50 0xd9c 0x1c138 0xd34 0x1c520 0xcd1 0x1c908 0xc71 0x1ccf0 0xc15 0x1d0d8 0xbbb 0x1d4c0 0xb64 0x1d8a8 0xb10 0x1dc90 0xabf 0x1e078 0xa70 0x1e460 0xa24 0x1e848 0x9da>;
		};
	};

	fragment@96 {
		target = <0xffffffff>;

		__overlay__ {
			compatible = "mediatek,mt6855-board-ntc";
			#thermal-sensor-cells = <0x00>;
			io-channels = <0xffffffff 0x0a>;
			io-channel-names = "USB_CONN_NTC";
			temperature-lookup-table = <0xffff63c0 0x317cc 0xffff67a8 0x2ebda 0xffff6b90 0x2c2a4 0xffff6f78 0x29c02 0xffff7360 0x277b8 0xffff7748 0x255a8 0xffff7b30 0x235aa 0xffff7f18 0x217a0 0xffff8300 0x1fb58 0xffff86e8 0x1e0be 0xffff8ad0 0x1c7be 0xffff8eb8 0x1b03a 0xffff92a0 0x19a14 0xffff9688 0x18533 0xffff9a70 0x17187 0xffff9e58 0x15ef9 0xffffa240 0x14d78 0xffffa628 0x13cf4 0xffffaa10 0x12d5b 0xffffadf8 0x11ea1 0xffffb1e0 0x110b6 0xffffb5c8 0x10397 0xffffb9b0 0xf72d 0xffffbd98 0xeb6f 0xffffc180 0xe052 0xffffc568 0xd5cd 0xffffc950 0xcbd6 0xffffcd38 0xc265 0xffffd120 0xb973 0xffffd508 0xb0f8 0xffffd8f0 0xa8ed 0xffffdcd8 0xa142 0xffffe0c0 0x99fd 0xffffe4a8 0x9318 0xffffe890 0x8c8b 0xffffec78 0x8654 0xfffff060 0x806d 0xfffff448 0x7ad1 0xfffff830 0x757c 0xfffffc18 0x706b 0x00 0x6b99 0x3e8 0x6707 0x7d0 0x62ae 0xbb8 0x5e89 0xfa0 0x5a97 0x1388 0x56d5 0x1770 0x5340 0x1b58 0x4fd6 0x1f40 0x4c94 0x2328 0x4979 0x2710 0x4682 0x2af8 0x43ae 0x2ee0 0x40fa 0x32c8 0x3e65 0x36b0 0x3bef 0x3a98 0x3995 0x3e80 0x3755 0x4268 0x3530 0x4650 0x3322 0x4a38 0x312c 0x4e20 0x2f4c 0x5208 0x2d81 0x55f0 0x2bca 0x59d8 0x2a25 0x5dc0 0x2892 0x61a8 0x2710 0x6590 0x259e 0x6978 0x243c 0x6d60 0x22ec 0x7148 0x21a9 0x7530 0x2074 0x7918 0x1f4c 0x7d00 0x1e2f 0x80e8 0x1d1f 0x84d0 0x1c19 0x88b8 0x1b1e 0x8ca0 0x1a2d 0x9088 0x1946 0x9470 0x1868 0x9858 0x1792 0x9c40 0x16c5 0xa028 0x15ff 0xa410 0x1541 0xa7f8 0x148a 0xabe0 0x13da 0xafc8 0x1331 0xb3b0 0x128e 0xb798 0x11f1 0xbb80 0x115b 0xbf68 0x10c9 0xc350 0x103f 0xc738 0xfb7 0xcb20 0xf35 0xcf08 0xeb8 0xd2f0 0xe40 0xd6d8 0xdcb 0xdac0 0xd5b 0xdea8 0xcf0 0xe290 0xc88 0xe678 0xc23 0xea60 0xbc3 0xee48 0xb67 0xf230 0xb0e 0xf618 0xab8 0xfa00 0xa66 0xfde8 0xa16 0x101d0 0x9c9 0x105b8 0x97f 0x109a0 0x938 0x10d88 0x8f2 0x11170 0x8b0 0x11558 0x86f 0x11940 0x830 0x11d28 0x7f4 0x12110 0x7b9 0x124f8 0x781 0x128e0 0x74a 0x12cc8 0x715 0x130b0 0x6e2 0x13498 0x6b1 0x13880 0x681 0x13c68 0x653 0x14050 0x626 0x14438 0x5fb 0x14820 0x5d1 0x14c08 0x5a9 0x14ff0 0x581 0x153d8 0x55b 0x157c0 0x537 0x15ba8 0x513 0x15f90 0x4f1 0x16378 0x4cf 0x16760 0x4ae 0x16b48 0x48f 0x16f30 0x470 0x17318 0x452 0x17700 0x436 0x17ae8 0x41a 0x17ed0 0x3ff 0x182b8 0x3e4 0x186a0 0x3cb 0x18a88 0x3b2 0x18e70 0x39b 0x19258 0x383 0x19640 0x36d 0x19a28 0x357 0x19e10 0x342 0x1a1f8 0x32e 0x1a5e0 0x31a 0x1a9c8 0x306 0x1adb0 0x2f3 0x1b198 0x2e1 0x1b580 0x2cf 0x1b968 0x2be 0x1bd50 0x2ad 0x1c138 0x29d 0x1c520 0x28d 0x1c908 0x27e 0x1ccf0 0x26f 0x1d0d8 0x260 0x1d4c0 0x252 0x1d8a8 0x244 0x1dc90 0x237 0x1e078 0x22a 0x1e460 0x21d 0x1e848 0x211>;
		};
	};

	fragment@97 {
		target = <0xffffffff>;

		__overlay__ {
			usb_conn_ntc_pull_up_r = <0xa8c>;
		};
	};

	fragment@98 {
		target = <0xffffffff>;

		__overlay__ {

			surface_ntc {
				polling-delay = <0x00>;
				polling-delay-passive = <0x00>;
				thermal-sensors = <0xffffffff>;
				phandle = <0x7f>;
			};

			usb_conn_ntc {
				polling-delay = <0x00>;
				polling-delay-passive = <0x00>;
				thermal-sensors = <0xffffffff>;
				phandle = <0x80>;
			};
		};
	};

	__symbols__ {
		i2c_lcd_bias_mtk = "/fragment@3/__overlay__/i2c_lcd_bias@3e";
		aw99703_backlight = "/fragment@3/__overlay__/sprd_backlight@36";
		mtkfb_pins_lcd_bias_enp0 = "/fragment@5/__overlay__/lcd_bias_enp0_gpio";
		mtkfb_pins_lcd_bias_enn0 = "/fragment@5/__overlay__/lcd_bias_enn0_gpio";
		mtkfb_pins_lcm_rst_out1_gpio = "/fragment@5/__overlay__/lcm_rst_out1_gpio";
		mtkfb_pins_lcm_rst_out0_gpio = "/fragment@5/__overlay__/lcm_rst_out0_gpio";
		mtkfb_pins_lcm_dsi_te = "/fragment@5/__overlay__/lcm_dsi_te";
		panel_in1 = "/fragment@7/__overlay__/panel1@0/port/endpoint";
		panel_in2 = "/fragment@7/__overlay__/panel2@0/port/endpoint";
		panel_in3 = "/fragment@7/__overlay__/panel3@0/port/endpoint";
		panel_in4 = "/fragment@7/__overlay__/panel4@0/port/endpoint";
		panel_in5 = "/fragment@7/__overlay__/panel5@0/port/endpoint";
		dsi_out = "/fragment@7/__overlay__/ports/port/endpoint";
		camera_pins_cam0_rst_0 = "/fragment@8/__overlay__/cam0@0";
		camera_pins_cam0_rst_1 = "/fragment@8/__overlay__/cam0@1";
		camera_pins_cam1_rst_0 = "/fragment@8/__overlay__/cam1@0";
		camera_pins_cam1_rst_1 = "/fragment@8/__overlay__/cam1@1";
		camera_pins_cam2_rst_0 = "/fragment@8/__overlay__/cam2@0";
		camera_pins_cam2_rst_1 = "/fragment@8/__overlay__/cam2@1";
		camera_pins_cam0_vcamd_0 = "/fragment@8/__overlay__/cam0@vcam0";
		camera_pins_cam0_vcamd_1 = "/fragment@8/__overlay__/cam0@vcam1";
		camera_pins_cam0_vcama_0 = "/fragment@8/__overlay__/cam0@vcam2";
		camera_pins_cam0_vcama_1 = "/fragment@8/__overlay__/cam0@vcam3";
		camera_pins_cam0_vcamio_0 = "/fragment@8/__overlay__/cam0@vcam4";
		camera_pins_cam0_vcamio_1 = "/fragment@8/__overlay__/cam0@vcam5";
		camera_pins_cam0_vcamd1_0 = "/fragment@8/__overlay__/cam0@vcam6";
		camera_pins_cam0_vcamd1_1 = "/fragment@8/__overlay__/cam0@vcam7";
		camera_pins_cam0_vcamaf_0 = "/fragment@8/__overlay__/cam2@vcam8";
		camera_pins_cam0_vcamaf_1 = "/fragment@8/__overlay__/cam2@vcam9";
		camera_pins_cam1_vcamd_0 = "/fragment@8/__overlay__/cam1@vcam0";
		camera_pins_cam1_vcamd_1 = "/fragment@8/__overlay__/cam1@vcam1";
		camera_pins_cam1_vcama_0 = "/fragment@8/__overlay__/cam1@vcam2";
		camera_pins_cam1_vcama_1 = "/fragment@8/__overlay__/cam1@vcam3";
		camera_pins_cam1_vcamio_0 = "/fragment@8/__overlay__/cam1@vcam4";
		camera_pins_cam1_vcamio_1 = "/fragment@8/__overlay__/cam1@vcam5";
		camera_pins_cam2_vcamd_0 = "/fragment@8/__overlay__/cam2@vcam0";
		camera_pins_cam2_vcamd_1 = "/fragment@8/__overlay__/cam2@vcam1";
		camera_pins_cam2_vcama_0 = "/fragment@8/__overlay__/cam2@vcam2";
		camera_pins_cam2_vcama_1 = "/fragment@8/__overlay__/cam2@vcam3";
		camera_pins_cam2_vcamio_0 = "/fragment@8/__overlay__/cam2@vcam4";
		camera_pins_cam2_vcamio_1 = "/fragment@8/__overlay__/cam2@vcam5";
		camera_pins_cam0_mclk_off = "/fragment@8/__overlay__/camera_pins_cam0_mclk_off";
		camera_pins_cam0_mclk_2ma = "/fragment@8/__overlay__/camera_pins_cam0_mclk_2ma";
		camera_pins_cam0_mclk_4ma = "/fragment@8/__overlay__/camera_pins_cam0_mclk_4ma";
		camera_pins_cam0_mclk_6ma = "/fragment@8/__overlay__/camera_pins_cam0_mclk_6ma";
		camera_pins_cam0_mclk_8ma = "/fragment@8/__overlay__/camera_pins_cam0_mclk_8ma";
		camera_pins_cam1_mclk_off = "/fragment@8/__overlay__/camera_pins_cam1_mclk_off";
		camera_pins_cam1_mclk_2ma = "/fragment@8/__overlay__/camera_pins_cam1_mclk_2ma";
		camera_pins_cam1_mclk_4ma = "/fragment@8/__overlay__/camera_pins_cam1_mclk_4ma";
		camera_pins_cam1_mclk_6ma = "/fragment@8/__overlay__/camera_pins_cam1_mclk_6ma";
		camera_pins_cam1_mclk_8ma = "/fragment@8/__overlay__/camera_pins_cam1_mclk_8ma";
		camera_pins_cam2_mclk_off = "/fragment@8/__overlay__/camera_pins_cam2_mclk_off";
		camera_pins_cam2_mclk_2ma = "/fragment@8/__overlay__/camera_pins_cam2_mclk_2ma";
		camera_pins_cam2_mclk_4ma = "/fragment@8/__overlay__/camera_pins_cam2_mclk_4ma";
		camera_pins_cam2_mclk_6ma = "/fragment@8/__overlay__/camera_pins_cam2_mclk_6ma";
		camera_pins_cam2_mclk_8ma = "/fragment@8/__overlay__/camera_pins_cam2_mclk_8ma";
		camera_pins_default = "/fragment@8/__overlay__/camdefault";
		flashlight_gpio_high = "/fragment@8/__overlay__/flashlight@0";
		flashlight_gpio_low = "/fragment@8/__overlay__/flashlight@1";
		flashlight_pwm_high = "/fragment@8/__overlay__/flashlight@2";
		flashlight_pwm_low = "/fragment@8/__overlay__/flashlight@3";
		flashlight_pwm_en = "/fragment@8/__overlay__/flashlight@4";
		flash_default = "/fragment@8/__overlay__/flashlightdefault";
		mtk_camera_eeprom0 = "/fragment@10/__overlay__/camera_eeprom0@50";
		camera_main_mtk = "/fragment@10/__overlay__/camera_main@1a";
		mtk_camera_eeprom1 = "/fragment@11/__overlay__/camera_eeprom1@51";
		camera_sub_mtk = "/fragment@11/__overlay__/camera_sub@1a";
		mtk_camera_eeprom2 = "/fragment@12/__overlay__/camera_eeprom2@50";
		camera_main_two_mtk = "/fragment@12/__overlay__/camera_main_two@10";
		camera_main_af_mtk = "/fragment@14/__overlay__/camera_main_af@72";
		camera_main_two_af_mtk2 = "/fragment@15/__overlay__/camera_main_two_af@0c";
		sar_int_default = "/fragment@16/__overlay__/sar_int_default";
		sar_int_sleep = "/fragment@16/__overlay__/sar_int_sleep";
		sx937x = "/fragment@18/__overlay__/sx937x@2c";
		spk = "/fragment@19/__overlay__/speaker_amp@5c";
		aud_pins_hacamp_high = "/fragment@21/__overlay__/aud_pins_hacamp_high";
		aud_pins_hacamp_low = "/fragment@21/__overlay__/aud_pins_hacamp_low";
		fingerfp_rst_high = "/fragment@24/__overlay__/fingerfp_rst_high";
		fingerfp_rst_low = "/fragment@24/__overlay__/fingerfp_rst_low";
		fingerfp_irq_active = "/fragment@24/__overlay__/fingerfp_irq_active";
		fingerfp_spi_active = "/fragment@24/__overlay__/fingerfp_spi_active";
		fingerfp_spi_default = "/fragment@24/__overlay__/fingerfp_spi_default";
		fingerprint_irq = "/fragment@24/__overlay__/fingerprint_irq";
		fingerprint_reset_high = "/fragment@24/__overlay__/fingerprint_reset_high";
		fingerprint_reset_low = "/fragment@24/__overlay__/fingerprint_reset_low";
		fingerprint_int = "/fragment@26/__overlay__/fingerprint_int";
		chipone_int = "/fragment@26/__overlay__/chipone_int";
		nfc_pn5xx = "/fragment@30/__overlay__/nfc_pn5xx@28";
		p61 = "/fragment@32/__overlay__/p61@0";
		pinctrl_state_mode_spi = "/fragment@33/__overlay__/pinctrl_state_mode_spi";
		pinctrl_state_mode_idle = "/fragment@33/__overlay__/pinctrl_state_mode_idle";
		mtee = "/fragment@34/__overlay__/MTEE";
		svp = "/fragment@34/__overlay__/SecureVideoPath";
		gps_pins_default = "/fragment@36/__overlay__/gps_default";
		gps_l1_lna_pins_ol = "/fragment@36/__overlay__/gps_l1_lna@0";
		gps_l1_lna_pins_dsp_ctrl = "/fragment@36/__overlay__/gps_l1_lna@1";
		gps_l1_lna_pins_oh = "/fragment@36/__overlay__/gps_l1_lna@2";
		gps_l5_lna_pins_ol = "/fragment@36/__overlay__/gps_l5_lna@0";
		gps_l5_lna_pins_dsp_ctrl = "/fragment@36/__overlay__/gps_l5_lna@1";
		gps_l5_lna_pins_oh = "/fragment@36/__overlay__/gps_l5_lna@2";
		lm3644 = "/fragment@38/__overlay__/lm3644@63";
		fl_core_0 = "/fragment@38/__overlay__/lm3644@63/flash@0/port@0/endpoint";
		fl_core_1 = "/fragment@38/__overlay__/lm3644@63/flash@1/port@1/endpoint";
		lm3644_pins_default = "/fragment@39/__overlay__/default";
		lm3644_pins_hwen_high = "/fragment@39/__overlay__/hwen_high";
		lm3644_pins_hwen_low = "/fragment@39/__overlay__/hwen_low";
		flashlight_0 = "/fragment@40/__overlay__/port@0/endpoint";
		flashlight_1 = "/fragment@40/__overlay__/port@1/endpoint";
		camera_main_three_af_mtk = "/fragment@42/__overlay__/camera_main_three_af@0c";
		mmc1_pins_default = "/fragment@46/__overlay__/mmc1default";
		mmc1_pins_uhs = "/fragment@46/__overlay__/mmc1@0";
		ctp_ft8725_pins_default = "/fragment@48/__overlay__/pins_default";
		ctp_ft8725_spi_mode = "/fragment@48/__overlay__/spimode_default";
		main_pmic = "/fragment@51/__overlay__/pmic@4";
		pmic_adc = "/fragment@51/__overlay__/pmic@4/mt6363-auxadc";
		pa_therm1 = "/fragment@60/__overlay__/pa_therm1";
		nrpa_ntc = "/fragment@60/__overlay__/nrpa_ntc";
		mos_on = "/fragment@81/__overlay__/mos_on";
		mos_off = "/fragment@81/__overlay__/mos_off";
		wt6670_pins_default = "/fragment@89/__overlay__/wt6670_default_mode";
		wt6670_pins_scl_low = "/fragment@89/__overlay__/wt6670_scl_low";
		wt6670_pins_scl_high = "/fragment@89/__overlay__/wt6670_scl_high";
		wt6670_pins_sda_low = "/fragment@89/__overlay__/wt6670_sda_low";
		wt6670_pins_sda_high = "/fragment@89/__overlay__/wt6670_sda_high";
		wt6670_pins_i2c = "/fragment@89/__overlay__/wt6670_i2c_mode";
		bq25960_int_default = "/fragment@89/__overlay__/bq25960_int_default";
		surface_ntc = "/fragment@98/__overlay__/surface_ntc";
		usb_conn_ntc = "/fragment@98/__overlay__/usb_conn_ntc";
	};

	__fixups__ {
		utags = "/fragment@0:target:0";
		hw = "/fragment@1:target:0";
		dispsys_config = "/fragment@2:target:0\0/fragment@31:target:0";
		i2c6 = "/fragment@3:target:0\0/fragment@19:target:0\0/fragment@38:target:0";
		pio = "/fragment@3/__overlay__/i2c_lcd_bias@3e:sm,lcd-bias-enn-gpio:0\0/fragment@3/__overlay__/i2c_lcd_bias@3e:sm,lcd-bias-enp-gpio:0\0/fragment@3/__overlay__/sprd_backlight@36:hwen-gpio:0\0/fragment@3/__overlay__/sprd_backlight@36:aw99703,hwen-gpio:0\0/fragment@5:target:0\0/fragment@7/__overlay__/panel2@0:reset-gpios:0\0/fragment@7/__overlay__/panel2@0:bias_n-gpios:0\0/fragment@7/__overlay__/panel2@0:bias_p-gpios:0\0/fragment@7/__overlay__/panel3@0:reset-gpios:0\0/fragment@7/__overlay__/panel3@0:bias_n-gpios:0\0/fragment@7/__overlay__/panel3@0:bias_p-gpios:0\0/fragment@7/__overlay__/panel4@0:reset-gpios:0\0/fragment@7/__overlay__/panel4@0:bias_n-gpios:0\0/fragment@7/__overlay__/panel4@0:bias_p-gpios:0\0/fragment@7/__overlay__/panel5@0:reset-gpios:0\0/fragment@7/__overlay__/panel5@0:bias_n-gpios:0\0/fragment@7/__overlay__/panel5@0:bias_p-gpios:0\0/fragment@8:target:0\0/fragment@16:target:0\0/fragment@18/__overlay__/sx937x@2c:interrupt-parent:0\0/fragment@18/__overlay__/sx937x@2c:Semtech,nirq-gpio:0\0/fragment@21:target:0\0/fragment@24:target:0\0/fragment@26/__overlay__/fingerprint_int:interrupt-parent:0\0/fragment@26/__overlay__/fingerprint_int:goodix_rst:0\0/fragment@26/__overlay__/fingerprint_int:gf,gpio_irq:0\0/fragment@26/__overlay__/chipone_int:interrupt-parent:0\0/fragment@26/__overlay__/chipone_int:chipone,irq:0\0/fragment@30/__overlay__/sec-nfc@27:sec-nfc,ven-gpio:0\0/fragment@30/__overlay__/sec-nfc@27:sec-nfc,firm-gpio:0\0/fragment@30/__overlay__/sec-nfc@27:sec-nfc,irq-gpio:0\0/fragment@30/__overlay__/sec-nfc@27:sec-nfc,clk_req-gpio:0\0/fragment@30/__overlay__/nfc_pn5xx@28:interrupt-parent:0\0/fragment@30/__overlay__/nfc_pn5xx@28:qcom,sn-irq:0\0/fragment@30/__overlay__/nfc_pn5xx@28:qcom,sn-ven:0\0/fragment@33:target:0\0/fragment@36:target:0\0/fragment@39:target:0\0/fragment@45/__overlay__:cd-gpios:0\0/fragment@46:target:0\0/fragment@47/__overlay__/novatek@0:novatek,reset-gpio:0\0/fragment@47/__overlay__/novatek@0:novatek,irq-gpio:0\0/fragment@47/__overlay__/ilitek@1:touch,reset-gpio:0\0/fragment@47/__overlay__/ilitek@1:touch,irq-gpio:0\0/fragment@47/__overlay__/focaltech@2:focaltech,reset-gpio:0\0/fragment@47/__overlay__/focaltech@2:focaltech,irq-gpio:0\0/fragment@48:target:0\0/fragment@61/__overlay__:GPIO_FDD_BAND_SUPPORT_DETECT_3RD_PIN:0\0/fragment@61/__overlay__:GPIO_SIM1_HOT_PLUG:0\0/fragment@61/__overlay__:GPIO_SIM2_HOT_PLUG:0\0/fragment@61/__overlay__:GPIO_SIM1_SCLK:0\0/fragment@61/__overlay__:GPIO_SIM1_SRST:0\0/fragment@61/__overlay__:GPIO_SIM1_SIO:0\0/fragment@61/__overlay__:GPIO_SIM2_SCLK:0\0/fragment@61/__overlay__:GPIO_SIM2_SRST:0\0/fragment@61/__overlay__:GPIO_SIM2_SIO:0\0/fragment@61/__overlay__:GPIO_FDD_BAND_SUPPORT_DETECT_1ST_PIN:0\0/fragment@63/__overlay__:interrupt-parent:0\0/fragment@64/__overlay__:interrupt-parent:0\0/fragment@64/__overlay__:deb-gpios:0\0/fragment@65/__overlay__:interrupt-parent:0\0/fragment@66/__overlay__:interrupt-parent:0\0/fragment@67/__overlay__:interrupt-parent:0\0/fragment@67/__overlay__:deb-gpios:0\0/fragment@68/__overlay__:interrupt-parent:0\0/fragment@68/__overlay__:deb-gpios:0\0/fragment@69/__overlay__:interrupt-parent:0\0/fragment@69/__overlay__:deb-gpios:0\0/fragment@70/__overlay__:interrupt-parent:0\0/fragment@70/__overlay__:deb-gpios:0\0/fragment@71/__overlay__:interrupt-parent:0\0/fragment@72/__overlay__:interrupt-parent:0\0/fragment@81:target:0\0/fragment@88/__overlay__/bq25960-standalone@65:interrupt-parent:0\0/fragment@88/__overlay__/wt6670f@35:wt6670f-reset-gpio:0\0/fragment@88/__overlay__/wt6670f@35:wt6670f-int-gpio:0\0/fragment@88/__overlay__/wt6670f@35:wt6670f-i2c-scl-pin:0\0/fragment@88/__overlay__/wt6670f@35:wt6670f-i2c-sda-pin:0\0/fragment@89:target:0\0/fragment@90/__overlay__/charging:gpios:0";
		mtk_leds = "/fragment@4:target:0";
		mtkfb = "/fragment@6:target:0";
		dsi0 = "/fragment@7:target:0";
		kd_camera_hw1 = "/fragment@9:target:0";
		mt6369_vtp = "/fragment@9/__overlay__:cam2_vcamaf-supply:0";
		i2c2 = "/fragment@10:target:0\0/fragment@14:target:0\0/fragment@42:target:0";
		i2c4 = "/fragment@11:target:0";
		i2c8 = "/fragment@12:target:0\0/fragment@15:target:0";
		flashlights_cancunf = "/fragment@13:target:0";
		pericfg_ao_clk = "/fragment@13/__overlay__:srcclk:0";
		mt6363_vio18 = "/fragment@17:target:0\0/fragment@18/__overlay__/sx937x@2c:cap_vdd-supply:0";
		i2c0 = "/fragment@18:target:0";
		i2c7 = "/fragment@20:target:0\0/fragment@41:target:0";
		afe = "/fragment@22:target:0";
		aud_clk_mosi_off = "/fragment@22/__overlay__:pinctrl-0:0";
		aud_clk_mosi_on = "/fragment@22/__overlay__:pinctrl-1:0";
		aud_dat_mosi_off = "/fragment@22/__overlay__:pinctrl-2:0";
		aud_dat_mosi_on = "/fragment@22/__overlay__:pinctrl-3:0";
		aud_dat_miso0_off = "/fragment@22/__overlay__:pinctrl-4:0";
		aud_dat_miso0_on = "/fragment@22/__overlay__:pinctrl-5:0";
		aud_dat_miso1_off = "/fragment@22/__overlay__:pinctrl-6:0";
		aud_dat_miso1_on = "/fragment@22/__overlay__:pinctrl-7:0";
		aud_dat_miso2_off = "/fragment@22/__overlay__:pinctrl-8:0";
		aud_dat_miso2_on = "/fragment@22/__overlay__:pinctrl-9:0";
		vow_dat_miso_off = "/fragment@22/__overlay__:pinctrl-10:0";
		vow_dat_miso_on = "/fragment@22/__overlay__:pinctrl-11:0";
		vow_clk_miso_off = "/fragment@22/__overlay__:pinctrl-12:0";
		vow_clk_miso_on = "/fragment@22/__overlay__:pinctrl-13:0";
		aud_gpio_i2s0_off = "/fragment@22/__overlay__:pinctrl-14:0";
		aud_gpio_i2s0_on = "/fragment@22/__overlay__:pinctrl-15:0";
		aud_gpio_i2s3_off = "/fragment@22/__overlay__:pinctrl-16:0";
		aud_gpio_i2s3_on = "/fragment@22/__overlay__:pinctrl-17:0";
		mt6369_vfp = "/fragment@23:target:0\0/fragment@26/__overlay__/fingerprint_int:fp_vdd-supply:0\0/fragment@26/__overlay__/chipone_int:fp_vdd-supply:0";
		spi1 = "/fragment@25:target:0";
		odm = "/fragment@26:target:0\0/fragment@78:target:0";
		memory_ssmr_features = "/fragment@27:target:0";
		chosen = "/fragment@28:target:0\0/fragment@91/__overlay__:bootmode:0";
		clock_buffer_ctrl = "/fragment@29:target:0";
		i2c3 = "/fragment@30:target:0";
		spi5 = "/fragment@32:target:0";
		mtee_svp = "/fragment@34:target:0";
		regulator_vibrator = "/fragment@35:target:0";
		gps = "/fragment@37:target:0";
		mtk_composite_v4l2_1 = "/fragment@40:target:0";
		camera_af_hw_node = "/fragment@43:target:0";
		rt5133_ldo3 = "/fragment@43/__overlay__:camaf_m1_pmic-supply:0";
		rt5133_ldo2 = "/fragment@43/__overlay__:camaf_m2_pmic-supply:0";
		rt5133_gpio1 = "/fragment@43/__overlay__:camaf_m3_pmic-supply:0";
		sound = "/fragment@44:target:0";
		mmc1 = "/fragment@45:target:0";
		mt6369_vmch_eint_low = "/fragment@45/__overlay__:vmmc-supply:0";
		spi3 = "/fragment@47:target:0";
		mt6369_vio28 = "/fragment@49:target:0";
		u2port0 = "/fragment@50:target:0";
		spmi = "/fragment@51:target:0";
		tboard_thermistor1 = "/fragment@52:target:0\0/fragment@92/__overlay__:thermal-sensors:0\0/fragment@97:target:0";
		tboard_thermistor2 = "/fragment@53:target:0\0/fragment@60/__overlay__/pa_therm1:thermal-sensors:0";
		tboard_thermistor3 = "/fragment@54:target:0\0/fragment@60/__overlay__/nrpa_ntc:thermal-sensors:0";
		tboard_thermistor4 = "/fragment@55:target:0\0/fragment@60/__overlay__/emmc_therm:thermal-sensors:0";
		tboard_thermistor5 = "/fragment@56:target:0\0/fragment@60/__overlay__/chg_ntc:thermal-sensors:0";
		tboard_thermistor6 = "/fragment@57:target:0\0/fragment@60/__overlay__/mtktsflashlight:thermal-sensors:0";
		ltepa_ntc = "/fragment@58:target:0";
		therm_intf = "/fragment@59:target:0";
		thermal_zones = "/fragment@60:target:0\0/fragment@98:target:0";
		gpio_usage_mapping = "/fragment@61:target:0";
		gpio = "/fragment@62:target:0";
		subpmic_pmu_eint = "/fragment@63:target:0";
		mrdump_ext_rst = "/fragment@64:target:0";
		touch = "/fragment@65:target:0";
		rt5133_eint = "/fragment@66:target:0";
		swtp = "/fragment@67:target:0";
		swtp_1 = "/fragment@68:target:0";
		swtp_2 = "/fragment@69:target:0";
		swtp_3 = "/fragment@70:target:0";
		smart_pa = "/fragment@71:target:0";
		dsi_te = "/fragment@72:target:0";
		md1_sim1_hot_plug_eint = "/fragment@73:target:0";
		md1_sim2_hot_plug_eint = "/fragment@74:target:0";
		keypad = "/fragment@75:target:0";
		lk_charger = "/fragment@76:target:0\0/fragment@94:target:0";
		charger = "/fragment@77:target:0";
		mt6375_chg = "/fragment@78/__overlay__/mmi_chrg_manager:charger:0\0/fragment@79:target:0";
		mt6375_adc = "/fragment@79/__overlay__:io-channels:0\0/fragment@79/__overlay__:io-channels:8\0/fragment@79/__overlay__:io-channels:16\0/fragment@79/__overlay__:io-channels:24\0/fragment@79/__overlay__:io-channels:32\0/fragment@79/__overlay__:io-channels:40\0/fragment@79/__overlay__:io-channels:48\0/fragment@79/__overlay__:io-channels:56\0/fragment@79/__overlay__:io-channels:64\0/fragment@79/__overlay__:io-channels:72\0/fragment@79/__overlay__:io-channels:80\0/fragment@96/__overlay__:io-channels:0";
		extcon_usb = "/fragment@80:target:0";
		pdc = "/fragment@82:target:0";
		pe2 = "/fragment@83:target:0";
		mt6375_typec = "/fragment@84:target:0";
		pd_adapter = "/fragment@85:target:0";
		pe5 = "/fragment@86:target:0";
		mtk_gauge = "/fragment@86/__overlay__:gauge:0\0/fragment@87:target:0";
		i2c9 = "/fragment@88:target:0";
		charge_leds = "/fragment@90:target:0";
		charger_cooler = "/fragment@91:target:0";
		ap_ntc = "/fragment@92:target:0";
		moto_chg_tcmd = "/fragment@93:target:0";
		tboard_thermistor7 = "/fragment@95:target:0\0/fragment@98/__overlay__/surface_ntc:thermal-sensors:0";
		tboard_thermistor8 = "/fragment@96:target:0\0/fragment@98/__overlay__/usb_conn_ntc:thermal-sensors:0";
	};

	__local_fixups__ {

		fragment@6 {

			__overlay__ {
				pinctrl-0 = <0x00>;
				pinctrl-1 = <0x00>;
				pinctrl-2 = <0x00>;
				pinctrl-3 = <0x00>;
				pinctrl-4 = <0x00>;
			};
		};

		fragment@7 {

			__overlay__ {

				panel1@0 {

					port {

						endpoint {
							remote-endpoint = <0x00>;
						};
					};
				};

				panel2@0 {

					port {

						endpoint {
							remote-endpoint = <0x00>;
						};
					};
				};

				panel3@0 {

					port {

						endpoint {
							remote-endpoint = <0x00>;
						};
					};
				};

				panel4@0 {

					port {

						endpoint {
							remote-endpoint = <0x00>;
						};
					};
				};

				panel5@0 {

					port {

						endpoint {
							remote-endpoint = <0x00>;
						};
					};
				};

				ports {

					port {

						endpoint {
							remote-endpoint = <0x00>;
						};
					};
				};
			};
		};

		fragment@9 {

			__overlay__ {
				pinctrl-0 = <0x00>;
				pinctrl-1 = <0x00>;
				pinctrl-2 = <0x00>;
				pinctrl-3 = <0x00>;
				pinctrl-4 = <0x00>;
				pinctrl-5 = <0x00>;
				pinctrl-6 = <0x00>;
				pinctrl-7 = <0x00>;
				pinctrl-8 = <0x00>;
				pinctrl-9 = <0x00>;
				pinctrl-10 = <0x00>;
				pinctrl-11 = <0x00>;
				pinctrl-12 = <0x00>;
				pinctrl-13 = <0x00>;
				pinctrl-14 = <0x00>;
				pinctrl-15 = <0x00>;
				pinctrl-16 = <0x00>;
				pinctrl-17 = <0x00>;
				pinctrl-18 = <0x00>;
				pinctrl-19 = <0x00>;
				pinctrl-20 = <0x00>;
				pinctrl-21 = <0x00>;
				pinctrl-22 = <0x00>;
				pinctrl-23 = <0x00>;
				pinctrl-24 = <0x00>;
				pinctrl-25 = <0x00>;
				pinctrl-26 = <0x00>;
				pinctrl-27 = <0x00>;
				pinctrl-28 = <0x00>;
				pinctrl-29 = <0x00>;
				pinctrl-30 = <0x00>;
				pinctrl-31 = <0x00>;
				pinctrl-32 = <0x00>;
				pinctrl-33 = <0x00>;
				pinctrl-34 = <0x00>;
				pinctrl-35 = <0x00>;
				pinctrl-36 = <0x00>;
				pinctrl-37 = <0x00>;
				pinctrl-38 = <0x00>;
				pinctrl-39 = <0x00>;
				pinctrl-40 = <0x00>;
				pinctrl-41 = <0x00>;
				pinctrl-42 = <0x00>;
				pinctrl-43 = <0x00>;
			};
		};

		fragment@13 {

			__overlay__ {
				pinctrl-0 = <0x00>;
				pinctrl-1 = <0x00>;
				pinctrl-2 = <0x00>;
				pinctrl-3 = <0x00>;
				pinctrl-4 = <0x00>;
				pinctrl-5 = <0x00>;
			};
		};

		fragment@18 {

			__overlay__ {

				sx937x@2c {
					pinctrl-0 = <0x00>;
					pinctrl-1 = <0x00>;
				};
			};
		};

		fragment@22 {

			__overlay__ {
				pinctrl-18 = <0x00>;
				pinctrl-19 = <0x00>;
			};
		};

		fragment@26 {

			__overlay__ {

				fingerprint_int {
					pinctrl-0 = <0x00>;
					pinctrl-1 = <0x00>;
					pinctrl-2 = <0x00>;
				};

				chipone_int {
					pinctrl-0 = <0x00>;
					pinctrl-1 = <0x00>;
					pinctrl-2 = <0x00>;
				};
			};
		};

		fragment@31 {

			__overlay__ {
				pinctrl-0 = <0x00>;
				pinctrl-1 = <0x00>;
				pinctrl-2 = <0x00>;
			};
		};

		fragment@32 {

			__overlay__ {

				p61@0 {
					pinctrl-0 = <0x00>;
					pinctrl-1 = <0x00>;
				};
			};
		};

		fragment@37 {

			__overlay__ {
				pinctrl-0 = <0x00>;
				pinctrl-1 = <0x00>;
				pinctrl-2 = <0x00>;
				pinctrl-3 = <0x00>;
				pinctrl-4 = <0x00>;
				pinctrl-5 = <0x00>;
				pinctrl-6 = <0x00>;
			};
		};

		fragment@38 {

			__overlay__ {

				lm3644@63 {
					pinctrl-0 = <0x00>;
					pinctrl-1 = <0x00>;
					pinctrl-2 = <0x00>;

					flash@0 {

						port@0 {

							endpoint {
								remote-endpoint = <0x00>;
							};
						};
					};

					flash@1 {

						port@1 {

							endpoint {
								remote-endpoint = <0x00>;
							};
						};
					};
				};
			};
		};

		fragment@40 {

			__overlay__ {

				port@0 {

					endpoint {
						remote-endpoint = <0x00>;
					};
				};

				port@1 {

					endpoint {
						remote-endpoint = <0x00>;
					};
				};
			};
		};

		fragment@44 {

			__overlay__ {

				mediatek,speaker-codec {
					sound-dai = <0x00>;
				};
			};
		};

		fragment@45 {

			__overlay__ {
				pinctrl-0 = <0x00>;
				pinctrl-1 = <0x00>;
			};
		};

		fragment@47 {

			__overlay__ {
				pinctrl-0 = <0x00>;
				pinctrl-1 = <0x00>;
			};
		};

		fragment@55 {

			__overlay__ {
				io-channels = <0x00>;
			};
		};

		fragment@56 {

			__overlay__ {
				io-channels = <0x00>;
			};
		};

		fragment@57 {

			__overlay__ {
				io-channels = <0x00>;
			};
		};

		fragment@79 {

			__overlay__ {
				pinctrl-0 = <0x00>;
				pinctrl-1 = <0x00>;
			};
		};

		fragment@88 {

			__overlay__ {

				bq25960-standalone@65 {
					pinctrl-0 = <0x00>;
				};

				wt6670f@35 {
					pinctrl-0 = <0x00>;
					pinctrl-1 = <0x00>;
					pinctrl-2 = <0x00>;
					pinctrl-3 = <0x00>;
					pinctrl-4 = <0x00>;
					pinctrl-5 = <0x00>;
				};
			};
		};

		fragment@95 {

			__overlay__ {
				io-channels = <0x00>;
			};
		};
	};
};
