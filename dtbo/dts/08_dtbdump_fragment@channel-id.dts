/dts-v1/;

/ {

	fragment@channel-id {
		target-path = "/";

		__overlay__ {
			channel-id-map = "acg\0amxbr\0amxpr\0amxmx\0amxcl\0amxar\0amxla\0amxpe\0amxco\0tefbr\0tefmx\0tefar\0tefcl\0tefpe\0tefco\0perar\0entcl\0iusmx\0niibr\0niicl\0niimx\0niipe\0oibr\0timbr\0tigco\0retbr\0retar\0retla\0retcl\0tefla\0retla1st\0tefunl\0tigca\0tigca1st\0retmx\0attmx\0womcl\0avaco\0retpe\0openla\0opencl\0openmx\0altmx\0openpe\0openpub\0undefined\0undefined\0undefined\0undefined\0undefined\0undefined\0undefined\0undefined\0undefined\0undefined\0undefined\0undefined\0undefined\0undefined\0undefined\0undefined\0undefined\0undefined\0undefined\0reteu\0retgb\0retfr\0retes\0retie\0retde\0vfgb\0vfde\0vffr\0o2gb\0o2de\0orafr\0bouyfr\0eegb\0tescogb\0yoigo\0oraes\0retapac\0retmea\0vfit\0vfes\0vfeu\03gb\0tescoie\0altfr\03ie\0altpt\0timit\0retma\0windit\0vfhu\0vfro\0telhu\0playpl\0oraeu\0dteu\0teleu\0pluspl\0dtpl\0tefes\0altice\0vipeu\0veoneu\0openeu\0reteu2\0demogb\0retdemo\0rettr\0undefined\0undefined\0undefined\0undefined\0undefined\0undefined\0undefined\0undefined\0undefined\0undefined\0undefined\0undefined\0undefined\0undefined\0undefined\0undefined\0retca\0bwaca\0tkpca\0vzw\0att\0tmo\0sprint\0repw\0attpre\0cricket\0cc\0usc\0tracfone\0retus\0metropcs\0rcica\0wndca\0dmc\0bby\0amz\0acg\0lra\0comcast\0fi\0vzwpre\0boost\0spectrum\0undefined\0undefined\0undefined\0undefined\0undefined\0undefined\0undefined\0undefined\0undefined\0undefined\0undefined\0undefined\0undefined\0undefined\0undefined\0undefined\0undefined\0undefined\0undefined\0undefined\0undefined\0undefined\0undefined\0undefined\0undefined\0undefined\0undefined\0undefined\0undefined\0undefined\0undefined\0undefined\0undefined\0undefined\0undefined\0undefined\0undefined\0retin\0retcn\0telstra\0vfau\0amzin\0jioin\0airin\0retid\0cmcc\0ctcn\0cucn\0retmm\0gt4gtw\0retth\0retru\0trueth\0smarthk\0mobilpk\0retsea\0retjp\0softbank\0optus\0retkr\0retjio\0ymobile\0lguplus\0docomo\0retanz\0cbncn\0kddi\0rakuten\0undefined\0undefined\0undefined\0undefined\0undefined\0undefined\0undefined\0undefined\0undefined\0undefined\0undefined\0undefined\0undefined\0undefined\0undefined\0undefined\0undefined\0undefined\0undefined\0undefined\0undefined\0undefined\0undefined\0undefined\0undefined\0undefined\0undefined\0undefined\0undefined\0undefined\0undefined\0undefined\0undefined";
		};
	};

	fragment@0 {
		target = <0xffffffff>;

		__overlay__ {
			compatible = "mmi,utags";
			mmi,main-utags = "/dev/block/by-name/utags";
			mmi,backup-utags = "/dev/block/by-name/utagsBackup";
		};
	};

	fragment@1 {
		target = <0xffffffff>;

		__overlay__ {
			compatible = "mmi,utags";
			mmi,dir-name = "hw";
			mmi,main-utags = "/dev/block/by-name/hw";
		};
	};

	fragment@2 {
		target = <0xffffffff>;

		__overlay__ {
			force_dyn_mipi_change;
		};
	};

	fragment@3 {
		target = <0xffffffff>;

		__overlay__ {
			id = <0x06>;

			i2c_lcd_bias@3e {
				compatible = "sm,bias_sm5109";
				reg = <0x3e>;
				sm,lcd-bias-enn-gpio = <0xffffffff 0x86 0x00>;
				sm,lcd-bias-enp-gpio = <0xffffffff 0xb6 0x00>;
				biasp_en_pin = <0xb6>;
				biasn_en_pin = <0x86>;
				status = "okay";
				phandle = <0x5e>;
			};

			sprd_backlight@36 {
				compatible = "awinic,aw99703-bl\0sm-sm5350";
				reg = <0x36>;
				id = <0x06>;
				lk_hwen-gpio = <0x08>;
				status = "okay";
				pwm-cfg = <0x0f>;
				hwen-gpio = <0xffffffff 0x08 0x01>;
				boost-ctl = <0x02>;
				ctl-bank-en = <0x02>;
				full-scale-current = <0x19>;
				map-mode = <0x00>;
				current-align-type = <0x01>;
				sm5350,default-brightness = <0x3ff>;
				sm5350,init-seq-enable = <0x01>;
				sm5350,init-seq = <0x1a 0x02 0x1c 0x0f 0x10 0x07 0x16 0x00 0x18 0x19 0x23 0xff 0x24 0x02>;
				aw99703,hwen-gpio = <0xffffffff 0x08 0x01>;
				aw99703,bl-map = <0x03>;
				aw99703,using-lsb;
				aw99703,ovp-level = <0x03>;
				aw99703,ocp-level = <0x02>;
				aw99703,switch-freq = <0x01>;
				aw99703,auto-freq-high = <0x10>;
				aw99703,auto-freq-low = <0x05>;
				aw99703,bl-fscal-led = <0x19>;
				aw99703,bl-channel = <0x03>;
				aw99703,turn-on-ramp = <0x00>;
				aw99703,turn-off-ramp = <0x04>;
				aw99703,pwm-trans-dim = <0x00>;
				aw99703,i2c-trans-dim = <0x01>;
				aw99703,skip-first-trans;
				aw99703,reset-trans-delay;
				aw99703,pwm-mode = <0x01>;
				aw99703,map-type = <0x00>;
				aw99703,current-align-type = <0x01>;
				aw99703,work-mode = <0x01>;
				aw99703,default-brightness = <0x3ff>;
				aw99703,init-seq-enable = <0x01>;
				aw99703,init-seq = <0x02 0x00 0x03 0xcf 0x04 0x2e 0x09 0x00 0x05 0x50 0x06 0x02 0x07 0xe2 0x67 0x1c 0x25 0x61 0x24 0x4c 0x23 0x61 0x02 0x01>;
				phandle = <0x5f>;
			};
		};
	};

	fragment@4 {
		target = <0xffffffff>;

		__overlay__ {
			compatible = "mediatek,i2c-leds";

			backlight {
				label = "lcd-backlight";
				led_mode = <0x06>;
				max-brightness = <0x7ff>;
				max-hw-brightness = <0x7ff>;
				default-brightness = <0x712>;
			};
		};
	};

	fragment@5 {
		target = <0xffffffff>;

		__overlay__ {

			lcd_bias_enp0_gpio {
				phandle = <0x01>;

				pins_cmd_dat {
					pinmux = <0xb600>;
					slew-rate = <0x01>;
					output-high;
				};
			};

			lcd_bias_enn0_gpio {
				phandle = <0x02>;

				pins_cmd_dat {
					pinmux = <0x8600>;
					slew-rate = <0x01>;
					output-low;
				};
			};

			lcm_rst_out1_gpio {
				phandle = <0x03>;

				pins_cmd_dat {
					pinmux = <0x5f00>;
					slew-rate = <0x01>;
					output-high;
				};
			};

			lcm_rst_out0_gpio {
				phandle = <0x04>;

				pins_cmd_dat {
					pinmux = <0x5f00>;
					slew-rate = <0x01>;
					output-low;
				};
			};

			lcm_dsi_te {
				phandle = <0x05>;

				pins_cmd_dat {
					pinmux = <0x5e01>;
				};
			};
		};
	};

	fragment@6 {
		target = <0xffffffff>;

		__overlay__ {
			pinctrl-names = "lcd_bias_enp0_gpio\0lcd_bias_enn0_gpio\0lcm_rst_out1_gpio\0lcm_rst_out0_gpio\0mode_te_te";
			pinctrl-0 = <0x01>;
			pinctrl-1 = <0x02>;
			pinctrl-2 = <0x03>;
			pinctrl-3 = <0x04>;
			pinctrl-4 = <0x05>;
			status = "okay";
		};
	};

	fragment@7 {
		target = <0xffffffff>;

		__overlay__ {
			status = "okay";
			#address-cells = <0x01>;
			#size-cells = <0x00>;

			panel1@0 {
				compatible = "mot,dummy,vdo,60hz";
				reg = <0x00>;
				pinctrl-names = "default";

				port {

					endpoint {
						remote-endpoint = <0x06>;
						phandle = <0x07>;
					};
				};
			};

			panel2@0 {
				compatible = "tm,nt36672c,vdo,120hz";
				reg = <0x01>;
				reset-gpios = <0xffffffff 0x5f 0x00>;
				bias_n-gpios = <0xffffffff 0x86 0x00>;
				bias_p-gpios = <0xffffffff 0xb6 0x00>;
				pinctrl-names = "default";

				port {

					endpoint {
						remote-endpoint = <0x06>;
						phandle = <0x60>;
					};
				};
			};

			panel3@0 {
				compatible = "txd,ili7807s,vdo,120hz";
				reg = <0x02>;
				reset-gpios = <0xffffffff 0x5f 0x00>;
				bias_n-gpios = <0xffffffff 0x86 0x00>;
				bias_p-gpios = <0xffffffff 0xb6 0x00>;
				pinctrl-names = "default";

				port {

					endpoint {
						remote-endpoint = <0x06>;
						phandle = <0x61>;
					};
				};
			};

			panel4@0 {
				compatible = "csot_ft8725,vid,120hz";
				reg = <0x03>;
				reset-gpios = <0xffffffff 0x5f 0x00>;
				bias_n-gpios = <0xffffffff 0x86 0x00>;
				bias_p-gpios = <0xffffffff 0xb6 0x00>;
				pinctrl-names = "default";

				port {

					endpoint {
						remote-endpoint = <0x06>;
						phandle = <0x62>;
					};
				};
			};

			panel5@0 {
				compatible = "csot_ft8725,vid,120hz";
				reg = <0x04>;
				reset-gpios = <0xffffffff 0x5f 0x00>;
				bias_n-gpios = <0xffffffff 0x86 0x00>;
				bias_p-gpios = <0xffffffff 0xb6 0x00>;
				pinctrl-names = "default";

				port {

					endpoint {
						remote-endpoint = <0x06>;
						phandle = <0x63>;
					};
				};
			};

			ports {

				port {

					endpoint {
						remote-endpoint = <0x07>;
						phandle = <0x06>;
					};
				};
			};
		};
	};

	fragment@8 {
		target = <0xffffffff>;

		__overlay__ {

			cam0@0 {
				phandle = <0x09>;

				pins_cmd_dat {
					pinmux = <0x1f00>;
					slew-rate = <0x01>;
					output-low;
				};
			};

			cam0@1 {
				phandle = <0x0a>;

				pins_cmd_dat {
					pinmux = <0x1f00>;
					slew-rate = <0x01>;
					output-high;
				};
			};

			cam1@0 {
				phandle = <0x0b>;

				pins_cmd_dat {
					pinmux = <0x1d00>;
					slew-rate = <0x01>;
					output-low;
				};
			};

			cam1@1 {
				phandle = <0x0c>;

				pins_cmd_dat {
					pinmux = <0x1d00>;
					slew-rate = <0x01>;
					output-high;
				};
			};

			cam2@0 {
				phandle = <0x0d>;

				pins_cmd_dat {
					pinmux = <0x2000>;
					slew-rate = <0x01>;
					output-low;
				};
			};

			cam2@1 {
				phandle = <0x0e>;

				pins_cmd_dat {
					pinmux = <0x2000>;
					slew-rate = <0x01>;
					output-high;
				};
			};

			cam0@vcam0 {
				phandle = <0x0f>;

				pins_cmd_dat {
					pinmux = <0x1900>;
					slew-rate = <0x01>;
					output-low;
				};
			};

			cam0@vcam1 {
				phandle = <0x10>;

				pins_cmd_dat {
					pinmux = <0x1900>;
					slew-rate = <0x01>;
					output-high;
				};
			};

			cam0@vcam2 {
				phandle = <0x11>;

				pins_cmd_dat {
					pinmux = <0x1a00>;
					slew-rate = <0x01>;
					output-low;
				};
			};

			cam0@vcam3 {
				phandle = <0x12>;

				pins_cmd_dat {
					pinmux = <0x1a00>;
					slew-rate = <0x01>;
					output-high;
				};
			};

			cam0@vcam4 {
				phandle = <0x13>;

				pins_cmd_dat {
					pinmux = <0xb00>;
					slew-rate = <0x01>;
					output-low;
				};
			};

			cam0@vcam5 {
				phandle = <0x14>;

				pins_cmd_dat {
					pinmux = <0xb00>;
					slew-rate = <0x01>;
					output-high;
				};
			};

			cam0@vcam6 {
				phandle = <0x32>;

				pins_cmd_dat {
					pinmux = <0x400>;
					slew-rate = <0x01>;
					output-low;
				};
			};

			cam0@vcam7 {
				phandle = <0x33>;

				pins_cmd_dat {
					pinmux = <0x400>;
					slew-rate = <0x01>;
					output-high;
				};
			};

			cam2@vcam8 {
				phandle = <0x21>;

				pins_cmd_dat {
					pinmux = <0x600>;
					slew-rate = <0x01>;
					output-low;
				};
			};

			cam2@vcam9 {
				phandle = <0x22>;

				pins_cmd_dat {
					pinmux = <0x600>;
					slew-rate = <0x01>;
					output-high;
				};
			};

			cam1@vcam0 {
				phandle = <0x15>;

				pins_cmd_dat {
					pinmux = <0xc00>;
					slew-rate = <0x01>;
					output-low;
				};
			};

			cam1@vcam1 {
				phandle = <0x16>;

				pins_cmd_dat {
					pinmux = <0xc00>;
					slew-rate = <0x01>;
					output-high;
				};
			};

			cam1@vcam2 {
				phandle = <0x17>;

				pins_cmd_dat {
					pinmux = <0x900>;
					slew-rate = <0x01>;
					output-low;
				};
			};

			cam1@vcam3 {
				phandle = <0x18>;

				pins_cmd_dat {
					pinmux = <0x900>;
					slew-rate = <0x01>;
					output-high;
				};
			};

			cam1@vcam4 {
				phandle = <0x19>;

				pins_cmd_dat {
					pinmux = <0xb00>;
					slew-rate = <0x01>;
					output-low;
				};
			};

			cam1@vcam5 {
				phandle = <0x1a>;

				pins_cmd_dat {
					pinmux = <0xb00>;
					slew-rate = <0x01>;
					output-high;
				};
			};

			cam2@vcam0 {
				phandle = <0x1b>;

				pins_cmd_dat {
					pinmux = <0x1400>;
					slew-rate = <0x01>;
					output-low;
				};
			};

			cam2@vcam1 {
				phandle = <0x1c>;

				pins_cmd_dat {
					pinmux = <0x1400>;
					slew-rate = <0x01>;
					output-high;
				};
			};

			cam2@vcam2 {
				phandle = <0x1d>;

				pins_cmd_dat {
					pinmux = <0xa00>;
					slew-rate = <0x01>;
					output-low;
				};
			};

			cam2@vcam3 {
				phandle = <0x1e>;

				pins_cmd_dat {
					pinmux = <0xa00>;
					slew-rate = <0x01>;
					output-high;
				};
			};

			cam2@vcam4 {
				phandle = <0x1f>;

				pins_cmd_dat {
					pinmux = <0xb00>;
					slew-rate = <0x01>;
					output-low;
				};
			};

			cam2@vcam5 {
				phandle = <0x20>;

				pins_cmd_dat {
					pinmux = <0xb00>;
					slew-rate = <0x01>;
					output-high;
				};
			};

			camera_pins_cam0_mclk_off {
				phandle = <0x23>;

				pins_cmd_dat {
					pinmux = <0x6400>;
					drive-strength = <0x01>;
				};
			};

			camera_pins_cam0_mclk_2ma {
				phandle = <0x24>;

				pins_cmd_dat {
					pinmux = <0x6401>;
					drive-strength = <0x00>;
				};
			};

			camera_pins_cam0_mclk_4ma {
				phandle = <0x25>;

				pins_cmd_dat {
					pinmux = <0x6401>;
					drive-strength = <0x01>;
				};
			};

			camera_pins_cam0_mclk_6ma {
				phandle = <0x26>;

				pins_cmd_dat {
					pinmux = <0x6401>;
					drive-strength = <0x02>;
				};
			};

			camera_pins_cam0_mclk_8ma {
				phandle = <0x27>;

				pins_cmd_dat {
					pinmux = <0x6401>;
					drive-strength = <0x03>;
				};
			};

			camera_pins_cam1_mclk_off {
				phandle = <0x28>;

				pins_cmd_dat {
					pinmux = <0x6100>;
					drive-strength = <0x01>;
				};
			};

			camera_pins_cam1_mclk_2ma {
				phandle = <0x29>;

				pins_cmd_dat {
					pinmux = <0x6101>;
					drive-strength = <0x00>;
				};
			};

			camera_pins_cam1_mclk_4ma {
				phandle = <0x2a>;

				pins_cmd_dat {
					pinmux = <0x6101>;
					drive-strength = <0x01>;
				};
			};

			camera_pins_cam1_mclk_6ma {
				phandle = <0x2b>;

				pins_cmd_dat {
					pinmux = <0x6101>;
					drive-strength = <0x02>;
				};
			};

			camera_pins_cam1_mclk_8ma {
				phandle = <0x2c>;

				pins_cmd_dat {
					pinmux = <0x6101>;
					drive-strength = <0x03>;
				};
			};

			camera_pins_cam2_mclk_off {
				phandle = <0x2d>;

				pins_cmd_dat {
					pinmux = <0x6300>;
					drive-strength = <0x01>;
				};
			};

			camera_pins_cam2_mclk_2ma {
				phandle = <0x2e>;

				pins_cmd_dat {
					pinmux = <0x6301>;
					drive-strength = <0x00>;
				};
			};

			camera_pins_cam2_mclk_4ma {
				phandle = <0x2f>;

				pins_cmd_dat {
					pinmux = <0x6301>;
					drive-strength = <0x01>;
				};
			};

			camera_pins_cam2_mclk_6ma {
				phandle = <0x30>;

				pins_cmd_dat {
					pinmux = <0x6301>;
					drive-strength = <0x02>;
				};
			};

			camera_pins_cam2_mclk_8ma {
				phandle = <0x31>;

				pins_cmd_dat {
					pinmux = <0x6301>;
					drive-strength = <0x03>;
				};
			};

			camdefault {
				phandle = <0x08>;
			};

			flashlight@0 {
				phandle = <0x35>;

				pins_cmd_dat {
					pinmux = <0x1500>;
					slew-rate = <0x01>;
					output-high;
				};
			};

			flashlight@1 {
				phandle = <0x36>;

				pins_cmd_dat {
					pinmux = <0x1500>;
					slew-rate = <0x01>;
					output-low;
				};
			};

			flashlight@2 {
				phandle = <0x37>;

				pins_cmd_dat {
					pinmux = <0x1800>;
					slew-rate = <0x01>;
					output-high;
				};
			};

			flashlight@3 {
				phandle = <0x38>;

				pins_cmd_dat {
					pinmux = <0x1800>;
					slew-rate = <0x01>;
					output-low;
				};
			};

			flashlight@4 {
				phandle = <0x39>;

				pins_cmd_dat {
					pinmux = <0x1801>;
					slew-rate = <0x01>;
					output-high;
				};
			};

			flashlightdefault {
				phandle = <0x34>;
			};
		};
	};

	fragment@9 {
		target = <0xffffffff>;

		__overlay__ {
			pinctrl-names = "default\0cam0_rst0\0cam0_rst1\0cam1_rst0\0cam1_rst1\0cam2_rst0\0cam2_rst1\0cam0_ldo_vcamd_0\0cam0_ldo_vcamd_1\0cam0_ldo_vcama_0\0cam0_ldo_vcama_1\0cam0_ldo_vcamio_0\0cam0_ldo_vcamio_1\0cam1_ldo_vcamd_0\0cam1_ldo_vcamd_1\0cam1_ldo_vcama_0\0cam1_ldo_vcama_1\0cam1_ldo_vcamio_0\0cam1_ldo_vcamio_1\0cam2_ldo_vcamd_0\0cam2_ldo_vcamd_1\0cam2_ldo_vcama_0\0cam2_ldo_vcama_1\0cam2_ldo_vcamio_0\0cam2_ldo_vcamio_1\0cam0_ldo_vcamaf_0\0cam0_ldo_vcamaf_1\0cam0_mclk_off\0cam0_mclk_2mA\0cam0_mclk_4mA\0cam0_mclk_6mA\0cam0_mclk_8mA\0cam1_mclk_off\0cam1_mclk_2mA\0cam1_mclk_4mA\0cam1_mclk_6mA\0cam1_mclk_8mA\0cam2_mclk_off\0cam2_mclk_2mA\0cam2_mclk_4mA\0cam2_mclk_6mA\0cam2_mclk_8mA\0cam0_ldo_vcamd1_0\0cam0_ldo_vcamd1_1";
			pinctrl-0 = <0x08>;
			pinctrl-1 = <0x09>;
			pinctrl-2 = <0x0a>;
			pinctrl-3 = <0x0b>;
			pinctrl-4 = <0x0c>;
			pinctrl-5 = <0x0d>;
			pinctrl-6 = <0x0e>;
			pinctrl-7 = <0x0f>;
			pinctrl-8 = <0x10>;
			pinctrl-9 = <0x11>;
			pinctrl-10 = <0x12>;
			pinctrl-11 = <0x13>;
			pinctrl-12 = <0x14>;
			pinctrl-13 = <0x15>;
			pinctrl-14 = <0x16>;
			pinctrl-15 = <0x17>;
			pinctrl-16 = <0x18>;
			pinctrl-17 = <0x19>;
			pinctrl-18 = <0x1a>;
			pinctrl-19 = <0x1b>;
			pinctrl-20 = <0x1c>;
			pinctrl-21 = <0x1d>;
			pinctrl-22 = <0x1e>;
			pinctrl-23 = <0x1f>;
			pinctrl-24 = <0x20>;
			pinctrl-25 = <0x21>;
			pinctrl-26 = <0x22>;
			pinctrl-27 = <0x23>;
			pinctrl-28 = <0x24>;
			pinctrl-29 = <0x25>;
			pinctrl-30 = <0x26>;
			pinctrl-31 = <0x27>;
			pinctrl-32 = <0x28>;
			pinctrl-33 = <0x29>;
			pinctrl-34 = <0x2a>;
			pinctrl-35 = <0x2b>;
			pinctrl-36 = <0x2c>;
			pinctrl-37 = <0x2d>;
			pinctrl-38 = <0x2e>;
			pinctrl-39 = <0x2f>;
			pinctrl-40 = <0x30>;
			pinctrl-41 = <0x31>;
			pinctrl-42 = <0x32>;
			pinctrl-43 = <0x33>;
			cam2_vcamaf-supply = <0xffffffff>;
			cam0_pin_mclk = "mclk";
			cam0_pin_rst = "gpio";
			cam0_pin_vcama = "gpio";
			cam0_pin_vcamd = "gpio";
			cam0_pin_vcamio = "gpio";
			cam0_pin_vcamd1 = "gpio";
			cam0_pin_vcamaf = "gpio";
			cam1_pin_mclk = "mclk";
			cam1_pin_rst = "gpio";
			cam1_pin_vcama = "gpio";
			cam1_pin_vcamd = "gpio";
			cam1_pin_vcamio = "gpio";
			cam2_pin_mclk = "mclk";
			cam2_pin_rst = "gpio";
			cam2_pin_vcama = "gpio";
			cam2_pin_vcamd = "gpio";
			cam2_pin_vcamio = "gpio";
			cam2_pin_vcamaf = "regulator";
			cam0_enable_sensor = "mot_cancunf_ov50d_mipi_raw mot_cancunf_s5kjns_mipi_raw mot_cancunf_jns_yova_mipi_raw";
			cam1_enable_sensor = "mot_cancunf_hi1634q_mipi_raw mot_cancunf_s5k3p9sp04_mipi_raw";
			cam2_enable_sensor = "mot_cancunf_s5k4h7_mipi_raw mot_cancunf_sc202_mipi_raw";
			status = "okay";
		};
	};

	fragment@10 {
		target = <0xffffffff>;

		__overlay__ {
			status = "okay";
			clock-frequency = <0xf4240>;
			#address-cells = <0x01>;
			size-cells = <0x00>;

			camera_eeprom0@50 {
				compatible = "mediatek,camera_eeprom";
				reg = <0x50>;
				status = "okay";
				phandle = <0x64>;
			};

			camera_main@1a {
				compatible = "mediatek,camera_main";
				#thermal-sensor-cells = <0x00>;
				reg = <0x1a>;
				status = "okay";
				phandle = <0x65>;
			};
		};
	};

	fragment@11 {
		target = <0xffffffff>;

		__overlay__ {
			status = "okay";
			clock-frequency = <0xf4240>;
			#address-cells = <0x01>;
			#size-cells = <0x00>;

			camera_eeprom1@51 {
				compatible = "mediatek,camera_eeprom";
				reg = <0x51>;
				status = "okay";
				phandle = <0x66>;
			};

			camera_sub@1a {
				compatible = "mediatek,camera_sub";
				#thermal-sensor-cells = <0x00>;
				reg = <0x1a>;
				status = "okay";
				phandle = <0x67>;
			};
		};
	};

	fragment@12 {
		target = <0xffffffff>;

		__overlay__ {
			status = "okay";
			clock-frequency = <0x61a80>;
			#address-cells = <0x01>;
			#size-cells = <0x00>;

			camera_eeprom2@50 {
				compatible = "mediatek,camera_eeprom";
				reg = <0x50>;
				status = "okay";
				phandle = <0x68>;
			};

			camera_main_two@10 {
				compatible = "mediatek,camera_main_two";
				#thermal-sensor-cells = <0x00>;
				reg = <0x10>;
				status = "okay";
				phandle = <0x69>;
			};
		};
	};

	fragment@13 {
		target = <0xffffffff>;

		__overlay__ {
			compatible = "mediatek,flashlights_cancunf_pwm";
			pinctrl-names = "default\0flashlight_gpio_high\0flashlight_gpio_low\0flashlight_pwm_high\0flashlight_pwm_low\0flashlight_pwm_en";
			pinctrl-0 = <0x34>;
			pinctrl-1 = <0x35>;
			pinctrl-2 = <0x36>;
			pinctrl-3 = <0x37>;
			pinctrl-4 = <0x38>;
			pinctrl-5 = <0x39>;
			srcclk = <0xffffffff>;
			decouple = <0x01>;

			channel@1 {
				status = "okay";
				type = <0x00>;
				ct = <0x00>;
				part = <0x00>;
			};
		};
	};

	fragment@14 {
		target = <0xffffffff>;

		__overlay__ {

			camera_main_af@72 {
				compatible = "mediatek,camera_main_af";
				reg = <0x72>;
				status = "okay";
				phandle = <0x6a>;
			};
		};
	};

	fragment@15 {
		target = <0xffffffff>;

		__overlay__ {

			camera_main_two_af@0c {
				compatible = "mediatek,camera_main_two_af";
				reg = <0x0c>;
				status = "okay";
				phandle = <0x6b>;
			};
		};
	};

	fragment@16 {
		target = <0xffffffff>;

		__overlay__ {

			sar_int_default {
				phandle = <0x3a>;

				pins_cmd_dat {
					pinmux = <0x1200>;
					input-enable;
					drive-strength = <0x02>;
					bias-pull-up;
				};
			};

			sar_int_sleep {
				phandle = <0x3b>;

				pins_cmd_dat {
					pinmux = <0x1200>;
					input-enable;
					drive-strength = <0x02>;
					bias-pull-up;
				};
			};
		};
	};

	fragment@17 {
		target = <0xffffffff>;

		__overlay__ {
			regulator-min-microvolt = <0x1b7740>;
			regulator-max-microvolt = <0x200b20>;
		};
	};

	fragment@18 {
		target = <0xffffffff>;

		__overlay__ {
			status = "okay";

			sx937x@2c {
				compatible = "Semtech,sx937x";
				reg = <0x2c>;
				pinctrl-names = "default\0sleep";
				pinctrl-0 = <0x3a>;
				pinctrl-1 = <0x3b>;
				interrupt-parent = <0xffffffff>;
				interrupts = <0x12 0x02>;
				interrupt-names = "sx937x_irq";
				Semtech,nirq-gpio = <0xffffffff 0x12 0x02>;
				cap_vdd-supply = <0xffffffff>;
				Semtech,ref-phases-a = <0x05>;
				Semtech,ref-phases-b = <0x06>;
				Semtech,ref-phases-c = <0xff>;
				Semtech,button-flag = <0x1f>;
				Semtech,reg-num = <0x3d>;
				Semtech,reg-init = <0x8024 0x7f7f 0x4004 0x74 0x4008 0x08 0x8020 0x32 0x8028 0x877 0x8034 0x877 0x8040 0x877 0x804c 0x877 0x8058 0x877 0x8064 0x877 0x8070 0x877 0x807c 0x88e 0x8030 0x924925 0x803c 0xb24924 0x8048 0x925924 0x8054 0x92c924 0x8060 0x964924 0x806c 0x92492c 0x8078 0x924964 0x8084 0xfff9ff 0x8098 0x5035 0x80b8 0x2525 0x80d8 0x593f 0x80f8 0x1414 0x8118 0x2a2a 0x8138 0x8e 0x8158 0x8e 0x8178 0x8e 0x80a0 0x20200001 0x80c0 0x21210002 0x80e0 0x20200002 0x8100 0x9090003 0x8120 0xd0d0004 0x8188 0x8000015 0x818c 0x8000016 0x8190 0x8000015 0x8194 0x8000015 0x8090 0x54b85000 0x80b0 0x50b85000 0x80d0 0x54b85000 0x80f0 0x28d87000 0x8110 0x64a45000 0x8130 0x5300 0x8150 0x5300 0x8170 0x5300 0x8088 0x300000 0x80a8 0x300000 0x80c8 0x300000 0x80e8 0x300000 0x8108 0x300000 0x8128 0x300000 0x8148 0x300000 0x8168 0x300000 0x808c 0x602000c0 0x80ac 0x602000c0 0x80cc 0x602000c0 0x80ec 0x6020000c 0x810c 0x602000c0 0x812c 0x60200030 0x814c 0x60200030 0x816c 0x60200030>;
				status = "okay";
				phandle = <0x6c>;
			};
		};
	};

	fragment@19 {
		target = <0xffffffff>;

		__overlay__ {

			speaker_amp@5c {
				compatible = "richtek,rt5512";
				#sound-dai-cells = <0x00>;
				reg = <0x5c>;
				sound-name-prefix = "Left";
				status = "disable";
				phandle = <0x51>;
			};
		};
	};

	fragment@20 {
		target = <0xffffffff>;

		__overlay__ {

			aw87xxx_pa@58 {
				compatible = "awinic,aw87xxx_pa";
				reg = <0x58>;
				dev_index = <0x00>;
				status = "okay";
			};

			aw87xxx_pa@59 {
				compatible = "awinic,aw87xxx_pa";
				reg = <0x59>;
				dev_index = <0x01>;
				status = "okay";
			};
		};
	};

	fragment@21 {
		target = <0xffffffff>;

		__overlay__ {

			aud_pins_hacamp_high {
				phandle = <0x3c>;

				pins_cmd_dat {
					pinmux = <0x9e00>;
					slew-rate = <0x01>;
					output-high;
				};
			};

			aud_pins_hacamp_low {
				phandle = <0x3d>;

				pins_cmd_dat {
					pinmux = <0x9e00>;
					slew-rate = <0x01>;
					output-low;
				};
			};
		};
	};

	fragment@22 {
		target = <0xffffffff>;

		__overlay__ {
			pinctrl-names = "aud_clk_mosi_off\0aud_clk_mosi_on\0aud_dat_mosi_off\0aud_dat_mosi_on\0aud_dat_miso0_off\0aud_dat_miso0_on\0aud_dat_miso1_off\0aud_dat_miso1_on\0aud_dat_miso2_off\0aud_dat_miso2_on\0vow_dat_miso_off\0vow_dat_miso_on\0vow_clk_miso_off\0vow_clk_miso_on\0aud_gpio_i2s0_off\0aud_gpio_i2s0_on\0aud_gpio_i2s3_off\0aud_gpio_i2s3_on\0hacamp_pullhigh\0hacamp_pulllow";
			pinctrl-0 = <0xffffffff>;
			pinctrl-1 = <0xffffffff>;
			pinctrl-2 = <0xffffffff>;
			pinctrl-3 = <0xffffffff>;
			pinctrl-4 = <0xffffffff>;
			pinctrl-5 = <0xffffffff>;
			pinctrl-6 = <0xffffffff>;
			pinctrl-7 = <0xffffffff>;
			pinctrl-8 = <0xffffffff>;
			pinctrl-9 = <0xffffffff>;
			pinctrl-10 = <0xffffffff>;
			pinctrl-11 = <0xffffffff>;
			pinctrl-12 = <0xffffffff>;
			pinctrl-13 = <0xffffffff>;
			pinctrl-14 = <0xffffffff>;
			pinctrl-15 = <0xffffffff>;
			pinctrl-16 = <0xffffffff>;
			pinctrl-17 = <0xffffffff>;
			pinctrl-18 = <0x3c>;
			pinctrl-19 = <0x3d>;
		};
	};

	fragment@23 {
		target = <0xffffffff>;

		__overlay__ {
			regulator-min-microvolt = <0x325aa0>;
			regulator-max-microvolt = <0x325aa0>;
		};
	};

	fragment@24 {
		target = <0xffffffff>;

		__overlay__ {

			fingerfp_rst_high {
				phandle = <0x6d>;

				pins_cmd_dat {
					pinmux = <0x9d00>;
					slew-rate = <0x01>;
					output-high;
				};
			};

			fingerfp_rst_low {
				phandle = <0x6e>;

				pins_cmd_dat {
					pinmux = <0x9d00>;
					slew-rate = <0x01>;
					output-low;
				};
			};

			fingerfp_irq_active {
				phandle = <0x6f>;

				pins_cmd_dat {
					pinmux = <0xf00>;
					slew-rate = <0x00>;
					bias-disable;
				};
			};

			fingerfp_spi_active {
				phandle = <0x70>;

				pins_cmd_dat {
					pinmux = <0x4402 0x4202 0x4302 0x4102>;
					drive-strength = <0x02>;
				};
			};

			fingerfp_spi_default {
				phandle = <0x71>;

				pins_cmd_dat {
					pinmux = <0x4400 0x4200 0x4300 0x4100>;
					slew-rate = <0x01>;
					output-low;
				};
			};

			fingerprint_irq {
				phandle = <0x3e>;

				pins_cmd_dat {
					pinmux = <0xf00>;
					slew-rate = <0x00>;
					bias-disable;
				};
			};

			fingerprint_reset_high {
				phandle = <0x3f>;

				pins_cmd_dat {
					pinmux = <0x9d00>;
					slew-rate = <0x01>;
					output-high;
				};
			};

			fingerprint_reset_low {
				phandle = <0x40>;

				pins_cmd_dat {
					pinmux = <0x9d00>;
					slew-rate = <0x01>;
					output-low;
				};
			};
		};
	};

	fragment@25 {
		target = <0xffffffff>;

		__overlay__ {
			status = "okay";
			mediatek,pad-select = <0x00 0x01>;
			tee-only;

			goodix_tee@0 {
				compatible = "mediatek,finger-goodix";
				reg = <0x00>;
				spi-max-frequency = <0x7a1200>;
				netlink-event = <0x1e>;
				status = "okay";
			};

			chipone_tee@1 {
				status = "okay";
				compatible = "mediatek,finger-chipone";
				reg = <0x01>;
				spi-max-frequency = <0x989680>;
				netlink-event = <0x1e>;
			};
		};
	};

	fragment@26 {
		target = <0xffffffff>;

		__overlay__ {

			fingerprint_int {
				compatible = "mediatek,fingerprint-goodix";
				fp_vdd-supply = <0xffffffff>;
				interrupt-parent = <0xffffffff>;
				goodix_rst = <0xffffffff 0x9d 0x00>;
				gf,gpio_irq = <0xffffffff 0x0f 0x00>;
				interrupts = <0x0f 0x01 0x0f 0x00>;
				pinctrl-names = "fingerprint_irq\0fingerprint_reset_high\0fingerprint_reset_low";
				pinctrl-0 = <0x3e>;
				pinctrl-1 = <0x3f>;
				pinctrl-2 = <0x40>;
				status = "okay";
				phandle = <0x72>;
			};

			chipone_int {
				compatible = "mediatek,chipone-fingerprint";
				chipone,enable-wakeup;
				fp_vdd-supply = <0xffffffff>;
				interrupt-parent = <0xffffffff>;
				interrupts = <0x0f 0x01 0x0f 0x00>;
				pinctrl-names = "fingerprint_reset_low\0fingerprint_reset_high\0fingerprint_irq";
				pinctrl-0 = <0x40>;
				pinctrl-1 = <0x3f>;
				pinctrl-2 = <0x3e>;
				chipone,irq = <0xffffffff 0x0f 0x00>;
				status = "okay";
				phandle = <0x73>;
			};
		};
	};

	fragment@27 {
		target = <0xffffffff>;

		__overlay__ {
			compatible = "mediatek,memory-ssmr-features";
			svp-region-based-size = <0x00 0x4000000>;
			svp-page-based-size = <0x00 0x19000000>;
			tui-size = <0x00 0x00>;
			wfd-region-based-size = <0x00 0x00>;
			wfd-page-based-size = <0x00 0x00>;
			prot-region-based-size = <0x00 0x00>;
			prot-page-based-size = <0x00 0x00>;
			sapu-data-shm-size = <0x00 0x00>;
		};
	};

	fragment@28 {
		target = <0xffffffff>;

		__overlay__ {
			bootargs_ext = "initcall_debug=0";
		};
	};

	fragment@29 {
		target = <0xffffffff>;

		__overlay__ {
			mediatek,xo-bbck4 = <0x01>;
		};
	};

	fragment@30 {
		target = <0xffffffff>;

		__overlay__ {

			sec-nfc@27 {
				compatible = "sec-nfc";
				reg = <0x27>;
				sec-nfc,ven-gpio = <0xffffffff 0xa1 0x00>;
				sec-nfc,firm-gpio = <0xffffffff 0x01 0x00>;
				sec-nfc,irq-gpio = <0xffffffff 0x02 0x00>;
				sec-nfc,clk_req-gpio = <0xffffffff 0xa0 0x00>;
				status = "okay";
			};

			nfc_pn5xx@28 {
				compatible = "qcom,sn-nci";
				reg = <0x28>;
				interrupt-parent = <0xffffffff>;
				interrupts = <0x02 0x04 0x01 0x00>;
				qcom,sn-irq = <0xffffffff 0x02 0x00>;
				qcom,sn-ven = <0xffffffff 0xa1 0x00>;
				status = "okay";
				phandle = <0x74>;
			};
		};
	};

	fragment@31 {
		target = <0xffffffff>;

		__overlay__ {
			pinctrl-names = "lcm_rst_out1_gpio\0lcm_rst_out0_gpio\0mode_te_te";
			pinctrl-0 = <0x03>;
			pinctrl-1 = <0x04>;
			pinctrl-2 = <0x05>;
			status = "okay";
		};
	};

	fragment@32 {
		target = <0xffffffff>;

		__overlay__ {

			p61@0 {
				compatible = "nxp,p61";
				reg = <0x00>;
				spi-max-frequency = <0x1312d00>;
				nxp,nfcc = "3-0028";
				pinctrl-names = "pinctrl_state_mode_spi\0pinctrl_state_mode_idle";
				pinctrl-0 = <0x41>;
				pinctrl-1 = <0x42>;
				status = "okay";
				phandle = <0x75>;
			};
		};
	};

	fragment@33 {
		target = <0xffffffff>;

		__overlay__ {

			pinctrl_state_mode_spi {
				phandle = <0x41>;

				pins_cmd_dat {
					pinmux = <0x4d01 0x4e01 0x4f01 0x5001>;
					drive-strength = <0x02>;
				};
			};

			pinctrl_state_mode_idle {
				phandle = <0x42>;

				pins_cmd_dat {
					pinmux = <0x4e00>;
					slew-rate = <0x01>;
					output-high;
				};
			};
		};
	};

	fragment@34 {
		target = <0xffffffff>;

		__overlay__ {

			MTEE {
				compatible = "mediatek,mtk_svp_on_mtee_support";
				phandle = <0x76>;
			};

			SecureVideoPath {
				compatible = "mediatek,mtk_sec_video_path_support";
				phandle = <0x77>;
			};
		};
	};

	fragment@35 {
		target = <0xffffffff>;

		__overlay__ {
			min-volt = <0x2dc6c0>;
			max-volt = <0x3567e0>;
			status = "ok";
		};
	};

	fragment@36 {
		target = <0xffffffff>;

		__overlay__ {

			gps_default {
				phandle = <0x43>;
			};

			gps_l1_lna@0 {
				phandle = <0x44>;

				pins_cmd_dat {
					pinmux = <0x8500>;
					output-low;
				};
			};

			gps_l1_lna@1 {
				phandle = <0x45>;

				pins_cmd_dat {
					pinmux = <0x8503>;
				};
			};

			gps_l1_lna@2 {
				phandle = <0x46>;

				pins_cmd_dat {
					pinmux = <0x8500>;
					output-high;
				};
			};

			gps_l5_lna@0 {
				phandle = <0x47>;

				pins_cmd_dat {
					pinmux = <0x8600>;
					output-low;
				};
			};

			gps_l5_lna@1 {
				phandle = <0x48>;

				pins_cmd_dat {
					pinmux = <0x8603>;
				};
			};

			gps_l5_lna@2 {
				phandle = <0x49>;

				pins_cmd_dat {
					pinmux = <0x8600>;
					output-high;
				};
			};
		};
	};

	fragment@37 {
		target = <0xffffffff>;

		__overlay__ {
			pinctrl-names = "default\0gps_l1_lna_disable\0gps_l1_lna_dsp_ctrl\0gps_l1_lna_enable\0gps_l5_lna_disable\0gps_l5_lna_dsp_ctrl\0gps_l5_lna_enable";
			pinctrl-0 = <0x43>;
			pinctrl-1 = <0x44>;
			pinctrl-2 = <0x45>;
			pinctrl-3 = <0x46>;
			pinctrl-4 = <0x47>;
			pinctrl-5 = <0x48>;
			pinctrl-6 = <0x49>;
			status = "okay";
		};
	};

	fragment@38 {
		target = <0xffffffff>;

		__overlay__ {

			lm3644@63 {
				compatible = "mediatek,lm3644";
				reg = <0x63>;
				#cooling-cells = <0x02>;
				pinctrl-names = "default\0hwen_high\0hwen_low";
				pinctrl-0 = <0x4a>;
				pinctrl-1 = <0x4b>;
				pinctrl-2 = <0x4c>;
				status = "okay";
				phandle = <0x78>;

				flash@0 {
					reg = <0x00>;
					type = <0x00>;
					ct = <0x00>;
					part = <0x00>;

					port@0 {

						endpoint {
							remote-endpoint = <0x4d>;
							phandle = <0x4f>;
						};
					};
				};

				flash@1 {
					reg = <0x01>;
					type = <0x00>;
					ct = <0x01>;
					part = <0x00>;

					port@1 {

						endpoint {
							remote-endpoint = <0x4e>;
							phandle = <0x50>;
						};
					};
				};
			};
		};
	};

	fragment@39 {
		target = <0xffffffff>;

		__overlay__ {

			default {
				phandle = <0x4a>;
			};

			hwen_high {
				phandle = <0x4b>;

				pins_cmd_dat {
					pinmux = <0x400>;
					slew-rate = <0x01>;
					output-high;
				};
			};

			hwen_low {
				phandle = <0x4c>;

				pins_cmd_dat {
					pinmux = <0x400>;
					slew-rate = <0x01>;
					output-low;
				};
			};
		};
	};

	fragment@40 {
		target = <0xffffffff>;

		__overlay__ {

			port@0 {

				endpoint {
					remote-endpoint = <0x4f>;
					phandle = <0x4d>;
				};
			};

			port@1 {

				endpoint {
					remote-endpoint = <0x50>;
					phandle = <0x4e>;
				};
			};
		};
	};

	fragment@41 {
		target = <0xffffffff>;

		__overlay__ {
		};
	};

	fragment@42 {
		target = <0xffffffff>;

		__overlay__ {

			camera_main_three_af@0c {
				compatible = "mediatek,camera_main_three_af";
				reg = <0x0c>;
				status = "okay";
				phandle = <0x79>;
			};
		};
	};

	fragment@43 {
		target = <0xffffffff>;

		__overlay__ {
			camaf_m1_pmic-supply = <0xffffffff>;
			camaf_m2_pmic-supply = <0xffffffff>;
			camaf_m3_pmic-supply = <0xffffffff>;
			status = "okay";
		};
	};

	fragment@44 {
		target = <0xffffffff>;

		__overlay__ {
			mediatek,spk-i2s = <0x03 0x00>;

			mediatek,speaker-codec {
				sound-dai = <0x51>;
			};
		};
	};

	fragment@45 {
		target = <0xffffffff>;

		__overlay__ {
			pinctrl-0 = <0x52>;
			pinctrl-1 = <0x53>;
			cd-gpios = <0xffffffff 0x0e 0x00>;
			vmmc-supply = <0xffffffff>;
		};
	};

	fragment@46 {
		target = <0xffffffff>;

		__overlay__ {

			mmc1default {
				phandle = <0x52>;

				pins_clk {
					pinmux = <0x5201>;
					drive-strength = <0x07>;
					bias-pull-down = <0x66>;
				};
			};

			mmc1@0 {
				phandle = <0x53>;

				pins_clk {
					pinmux = <0x5201>;
					drive-strength = <0x07>;
					bias-pull-down = <0x66>;
				};
			};
		};
	};

	fragment@47 {
		target = <0xffffffff>;

		__overlay__ {
			status = "okay";
			#address-cells = <0x01>;
			#size-cells = <0x00>;
			mediatek,pad-select = <0x00 0x01 0x02>;
			pinctrl-names = "default\0ft8725_spi_mode";
			pinctrl-0 = <0x54>;
			pinctrl-1 = <0x55>;

			novatek@0 {
				compatible = "novatek,NVT-ts-spi";
				reg = <0x00>;
				status = "ok";
				spi-max-frequency = <0x927c00>;
				novatek,reset-gpio = <0xffffffff 0x03 0x00>;
				novatek,irq-gpio = <0xffffffff 0x16 0x2001>;
				novatek,usb_charger;
				novatek,report_gesture_key;
				novatek,supported_gesture_type = <0x06>;
				novatek,psy-name = "battery";
				novatek,swrst-n8-addr = <0x3f0fe>;
				novatek,spi-rd-fast-addr = <0x3f310>;
			};

			ilitek@1 {
				compatible = "tchip,ilitek";
				reg = <0x01>;
				status = "ok";
				touch,reset-gpio = <0xffffffff 0x03 0x00>;
				touch,irq-gpio = <0xffffffff 0x16 0x00>;
				touch,psy-name = "battery";
				ilitek,report_gesture_key;
				ilitek,supported_gesture_type = <0x06>;
			};

			focaltech@2 {
				compatible = "focaltech,fts";
				reg = <0x02>;
				status = "ok";
				spi-max-frequency = <0x5b8d80>;
				focaltech,reset-gpio = <0xffffffff 0x03 0x00>;
				focaltech,irq-gpio = <0xffffffff 0x16 0x00>;
				focaltech,max-touch-number = <0x0a>;
				focaltech,display-coords = <0x00 0x00 0x438 0x960>;
				focaltech,report_gesture_key = <0x3b>;
				focaltech,supported_gesture_type = <0x06>;
				focaltech,panel-supplier = "csot_ft8725";
				focaltech,touch-charger-detect-psy-name = "battery";
				focaltech,touch-charger-detect-psp = "POWER_SUPPLY_PROP_STATUS";
			};
		};
	};

	fragment@48 {
		target = <0xffffffff>;

		__overlay__ {

			pins_default {
				phandle = <0x54>;
			};

			spimode_default {
				phandle = <0x55>;

				pins_cmd_dat {
					pinmux = <0x4902 0x4a02 0x4b02 0x4c02>;
					drive-strength = <0x02>;
				};
			};
		};
	};

	fragment@49 {
		target = <0xffffffff>;

		__overlay__ {
			regulator-name = "mt6369_vio28";
			regulator-min-microvolt = <0x325aa0>;
			regulator-max-microvolt = <0x325aa0>;
			regulator-enable-ramp-delay = <0x780>;
		};
	};

	fragment@50 {
		target = <0xffffffff>;

		__overlay__ {
			mediatek,eye-vrt = <0x07>;
			mediatek,eye-term = <0x03>;
			mediatek,rev6 = <0x03>;
			mediatek,discth = <0x0f>;
		};
	};

	fragment@51 {
		target = <0xffffffff>;

		__overlay__ {

			pmic@4 {
				compatible = "mediatek,mt6363";
				reg = <0x04 0x00>;
				interrupts = <0x04>;
				#address-cells = <0x01>;
				#size-cells = <0x00>;
				interrupt-controller;
				#interrupt-cells = <0x02>;
				phandle = <0x7a>;

				mtk-spmi-pmic-debug {
					compatible = "mediatek,spmi-pmic-debug";
				};

				mt6363-auxadc {
					compatible = "mediatek,mt6363-auxadc";
					#io-channel-cells = <0x01>;
					phandle = <0x56>;

					vin2_100k {
						channel = <0x14>;
						pures = <0x00>;
					};

					vin3_100k {
						channel = <0x15>;
						pures = <0x00>;
					};

					vin4_100k {
						channel = <0x16>;
						pures = <0x00>;
					};
				};
			};
		};
	};

	fragment@52 {
		target = <0xffffffff>;

		__overlay__ {
			compatible = "mediatek,mt6855-board-ntc";
			status = "okay";
			#thermal-sensor-cells = <0x00>;
			reg = <0x00 0x1c8050d4 0x00 0x04>;
			temperature-lookup-table = <0xffff63c0 0x43183f 0xffff67a8 0x3e73c9 0xffff6b90 0x3a2985 0xffff6f78 0x363204 0xffff7360 0x328683 0xffff7748 0x2f20d6 0xffff7b30 0x2bfb5b 0xffff7f18 0x2910ed 0xffff8300 0x265cd9 0xffff86e8 0x23dad1 0xffff8ad0 0x2186e9 0xffff8eb8 0x1f5d85 0xffff92a0 0x1d5b5b 0xffff9688 0x1b7d65 0xffff9a70 0x19c0dd 0xffff9e58 0x182338 0xffffa240 0x16a15b 0xffffa628 0x153a09 0xffffaa10 0x13eb44 0xffffadf8 0x12b33a 0xffffb1e0 0x11903c 0xffffb5c8 0x1080bf 0xffffb9b0 0xf8355 0xffffbd98 0xe96af 0xffffc180 0xdb998 0xffffc568 0xceaf2 0xffffc950 0xc29b7 0xffffcd38 0xb74f2 0xffffd120 0xacbc3 0xffffd508 0xa2d5c 0xffffd8f0 0x998fc 0xffffdcd8 0x90dbe 0xffffe0c0 0x88b3a 0xffffe4a8 0x810d9 0xffffe890 0x79e0c 0xffffec78 0x73250 0xfffff060 0x6cd4b 0xfffff448 0x66e67 0xfffff830 0x6153c 0xfffffc18 0x5c168 0x00 0x57293 0x3e8 0x52855 0x7d0 0x4e279 0xbb8 0x4a0b6 0xfa0 0x462c9 0x1388 0x42873 0x1770 0x3f17a 0x1b58 0x3bda8 0x1f40 0x38cc9 0x2328 0x35eaf 0x2710 0x3332e 0x2af8 0x30a1c 0x2ee0 0x2e354 0x32c8 0x2beb2 0x36b0 0x29c13 0x3a98 0x27b5b 0x3e80 0x25c66 0x4268 0x23f20 0x4650 0x2236e 0x4a38 0x20938 0x4e20 0x1f068 0x5208 0x1d8ea 0x55f0 0x1c2a8 0x59d8 0x1ad92 0x5dc0 0x19994 0x61a8 0x186a0 0x6590 0x174a6 0x6978 0x16398 0x6d60 0x15369 0x7148 0x1440c 0x7530 0x13576 0x7918 0x1279b 0x7d00 0x11a72 0x80e8 0x10df0 0x84d0 0x1020d 0x88b8 0xf6bf 0x8ca0 0xebff 0x9088 0xe1c5 0x9470 0xd80a 0x9858 0xcec6 0x9c40 0xc5f5 0xa028 0xbd90 0xa410 0xb592 0xa7f8 0xadf5 0xabe0 0xa6b3 0xafc8 0x9fc8 0xb3b0 0x992d 0xb798 0x92e1 0xbb80 0x8cdf 0xbf68 0x8723 0xc350 0x81ab 0xc738 0x7c73 0xcb20 0x7778 0xcf08 0x72b6 0xd2f0 0x6e2b 0xd6d8 0x69d3 0xdac0 0x65ac 0xdea8 0x61b5 0xe290 0x5dea 0xe678 0x5a49 0xea60 0x56d0 0xee48 0x537e 0xf230 0x5050 0xf618 0x4d46 0xfa00 0x4a5c 0xfde8 0x4792 0x101d0 0x44e8 0x105b8 0x425a 0x109a0 0x3fe8 0x10d88 0x3d8f 0x11170 0x3b50 0x11558 0x3927 0x11940 0x3714 0x11d28 0x3517 0x12110 0x332f 0x124f8 0x315b 0x128e0 0x2f9b 0x12cc8 0x2dec 0x130b0 0x2c4f 0x13498 0x2ac2 0x13880 0x2945 0x13c68 0x27d7 0x14050 0x2677 0x14438 0x2525 0x14820 0x23e0 0x14c08 0x22a8 0x14ff0 0x217c 0x153d8 0x205b 0x157c0 0x1f45 0x15ba8 0x1e3a 0x15f90 0x1d39 0x16378 0x1c42 0x16760 0x1b55 0x16b48 0x1a71 0x16f30 0x1994 0x17318 0x18c1 0x17700 0x17f4 0x17ae8 0x172e 0x17ed0 0x1670 0x182b8 0x15b9 0x186a0 0x1508 0x18a88 0x145e 0x18e70 0x13bb 0x19258 0x131d 0x19640 0x1285 0x19a28 0x11f2 0x19e10 0x1165 0x1a1f8 0x10dc 0x1a5e0 0x1058 0x1a9c8 0xfd9 0x1adb0 0xf5e 0x1b198 0xee8 0x1b580 0xe75 0x1b968 0xe07 0x1bd50 0xd9c 0x1c138 0xd34 0x1c520 0xcd1 0x1c908 0xc71 0x1ccf0 0xc15 0x1d0d8 0xbbb 0x1d4c0 0xb64 0x1d8a8 0xb10 0x1dc90 0xabf 0x1e078 0xa70 0x1e460 0xa24 0x1e848 0x9da>;
		};
	};

	fragment@53 {
		target = <0xffffffff>;

		__overlay__ {
			compatible = "mediatek,mt6855-board-ntc";
			status = "okay";
			#thermal-sensor-cells = <0x00>;
			reg = <0x00 0x1c8050d8 0x00 0x04>;
			temperature-lookup-table = <0xffff63c0 0x43183f 0xffff67a8 0x3e73c9 0xffff6b90 0x3a2985 0xffff6f78 0x363204 0xffff7360 0x328683 0xffff7748 0x2f20d6 0xffff7b30 0x2bfb5b 0xffff7f18 0x2910ed 0xffff8300 0x265cd9 0xffff86e8 0x23dad1 0xffff8ad0 0x2186e9 0xffff8eb8 0x1f5d85 0xffff92a0 0x1d5b5b 0xffff9688 0x1b7d65 0xffff9a70 0x19c0dd 0xffff9e58 0x182338 0xffffa240 0x16a15b 0xffffa628 0x153a09 0xffffaa10 0x13eb44 0xffffadf8 0x12b33a 0xffffb1e0 0x11903c 0xffffb5c8 0x1080bf 0xffffb9b0 0xf8355 0xffffbd98 0xe96af 0xffffc180 0xdb998 0xffffc568 0xceaf2 0xffffc950 0xc29b7 0xffffcd38 0xb74f2 0xffffd120 0xacbc3 0xffffd508 0xa2d5c 0xffffd8f0 0x998fc 0xffffdcd8 0x90dbe 0xffffe0c0 0x88b3a 0xffffe4a8 0x810d9 0xffffe890 0x79e0c 0xffffec78 0x73250 0xfffff060 0x6cd4b 0xfffff448 0x66e67 0xfffff830 0x6153c 0xfffffc18 0x5c168 0x00 0x57293 0x3e8 0x52855 0x7d0 0x4e279 0xbb8 0x4a0b6 0xfa0 0x462c9 0x1388 0x42873 0x1770 0x3f17a 0x1b58 0x3bda8 0x1f40 0x38cc9 0x2328 0x35eaf 0x2710 0x3332e 0x2af8 0x30a1c 0x2ee0 0x2e354 0x32c8 0x2beb2 0x36b0 0x29c13 0x3a98 0x27b5b 0x3e80 0x25c66 0x4268 0x23f20 0x4650 0x2236e 0x4a38 0x20938 0x4e20 0x1f068 0x5208 0x1d8ea 0x55f0 0x1c2a8 0x59d8 0x1ad92 0x5dc0 0x19994 0x61a8 0x186a0 0x6590 0x174a6 0x6978 0x16398 0x6d60 0x15369 0x7148 0x1440c 0x7530 0x13576 0x7918 0x1279b 0x7d00 0x11a72 0x80e8 0x10df0 0x84d0 0x1020d 0x88b8 0xf6bf 0x8ca0 0xebff 0x9088 0xe1c5 0x9470 0xd80a 0x9858 0xcec6 0x9c40 0xc5f5 0xa028 0xbd90 0xa410 0xb592 0xa7f8 0xadf5 0xabe0 0xa6b3 0xafc8 0x9fc8 0xb3b0 0x992d 0xb798 0x92e1 0xbb80 0x8cdf 0xbf68 0x8723 0xc350 0x81ab 0xc738 0x7c73 0xcb20 0x7778 0xcf08 0x72b6 0xd2f0 0x6e2b 0xd6d8 0x69d3 0xdac0 0x65ac 0xdea8 0x61b5 0xe290 0x5dea 0xe678 0x5a49 0xea60 0x56d0 0xee48 0x537e 0xf230 0x5050 0xf618 0x4d46 0xfa00 0x4a5c 0xfde8 0x4792 0x101d0 0x44e8 0x105b8 0x425a 0x109a0 0x3fe8 0x10d88 0x3d8f 0x11170 0x3b50 0x11558 0x3927 0x11940 0x3714 0x11d28 0x3517 0x12110 0x332f 0x124f8 0x315b 0x128e0 0x2f9b 0x12cc8 0x2dec 0x130b0 0x2c4f 0x13498 0x2ac2 0x13880 0x2945 0x13c68 0x27d7 0x14050 0x2677 0x14438 0x2525 0x14820 0x23e0 0x14c08 0x22a8 0x14ff0 0x217c 0x153d8 0x205b 0x157c0 0x1f45 0x15ba8 0x1e3a 0x15f90 0x1d39 0x16378 0x1c42 0x16760 0x1b55 0x16b48 0x1a71 0x16f30 0x1994 0x17318 0x18c1 0x17700 0x17f4 0x17ae8 0x172e 0x17ed0 0x1670 0x182b8 0x15b9 0x186a0 0x1508 0x18a88 0x145e 0x18e70 0x13bb 0x19258 0x131d 0x19640 0x1285 0x19a28 0x11f2 0x19e10 0x1165 0x1a1f8 0x10dc 0x1a5e0 0x1058 0x1a9c8 0xfd9 0x1adb0 0xf5e 0x1b198 0xee8 0x1b580 0xe75 0x1b968 0xe07 0x1bd50 0xd9c 0x1c138 0xd34 0x1c520 0xcd1 0x1c908 0xc71 0x1ccf0 0xc15 0x1d0d8 0xbbb 0x1d4c0 0xb64 0x1d8a8 0xb10 0x1dc90 0xabf 0x1e078 0xa70 0x1e460 0xa24 0x1e848 0x9da>;
		};
	};

	fragment@54 {
		target = <0xffffffff>;

		__overlay__ {
			compatible = "mediatek,mt6855-board-ntc";
			status = "okay";
			#thermal-sensor-cells = <0x00>;
			reg = <0x00 0x1c8050dc 0x00 0x04>;
			temperature-lookup-table = <0xffff63c0 0x43183f 0xffff67a8 0x3e73c9 0xffff6b90 0x3a2985 0xffff6f78 0x363204 0xffff7360 0x328683 0xffff7748 0x2f20d6 0xffff7b30 0x2bfb5b 0xffff7f18 0x2910ed 0xffff8300 0x265cd9 0xffff86e8 0x23dad1 0xffff8ad0 0x2186e9 0xffff8eb8 0x1f5d85 0xffff92a0 0x1d5b5b 0xffff9688 0x1b7d65 0xffff9a70 0x19c0dd 0xffff9e58 0x182338 0xffffa240 0x16a15b 0xffffa628 0x153a09 0xffffaa10 0x13eb44 0xffffadf8 0x12b33a 0xffffb1e0 0x11903c 0xffffb5c8 0x1080bf 0xffffb9b0 0xf8355 0xffffbd98 0xe96af 0xffffc180 0xdb998 0xffffc568 0xceaf2 0xffffc950 0xc29b7 0xffffcd38 0xb74f2 0xffffd120 0xacbc3 0xffffd508 0xa2d5c 0xffffd8f0 0x998fc 0xffffdcd8 0x90dbe 0xffffe0c0 0x88b3a 0xffffe4a8 0x810d9 0xffffe890 0x79e0c 0xffffec78 0x73250 0xfffff060 0x6cd4b 0xfffff448 0x66e67 0xfffff830 0x6153c 0xfffffc18 0x5c168 0x00 0x57293 0x3e8 0x52855 0x7d0 0x4e279 0xbb8 0x4a0b6 0xfa0 0x462c9 0x1388 0x42873 0x1770 0x3f17a 0x1b58 0x3bda8 0x1f40 0x38cc9 0x2328 0x35eaf 0x2710 0x3332e 0x2af8 0x30a1c 0x2ee0 0x2e354 0x32c8 0x2beb2 0x36b0 0x29c13 0x3a98 0x27b5b 0x3e80 0x25c66 0x4268 0x23f20 0x4650 0x2236e 0x4a38 0x20938 0x4e20 0x1f068 0x5208 0x1d8ea 0x55f0 0x1c2a8 0x59d8 0x1ad92 0x5dc0 0x19994 0x61a8 0x186a0 0x6590 0x174a6 0x6978 0x16398 0x6d60 0x15369 0x7148 0x1440c 0x7530 0x13576 0x7918 0x1279b 0x7d00 0x11a72 0x80e8 0x10df0 0x84d0 0x1020d 0x88b8 0xf6bf 0x8ca0 0xebff 0x9088 0xe1c5 0x9470 0xd80a 0x9858 0xcec6 0x9c40 0xc5f5 0xa028 0xbd90 0xa410 0xb592 0xa7f8 0xadf5 0xabe0 0xa6b3 0xafc8 0x9fc8 0xb3b0 0x992d 0xb798 0x92e1 0xbb80 0x8cdf 0xbf68 0x8723 0xc350 0x81ab 0xc738 0x7c73 0xcb20 0x7778 0xcf08 0x72b6 0xd2f0 0x6e2b 0xd6d8 0x69d3 0xdac0 0x65ac 0xdea8 0x61b5 0xe290 0x5dea 0xe678 0x5a49 0xea60 0x56d0 0xee48 0x537e 0xf230 0x5050 0xf618 0x4d46 0xfa00 0x4a5c 0xfde8 0x4792 0x101d0 0x44e8 0x105b8 0x425a 0x109a0 0x3fe8 0x10d88 0x3d8f 0x11170 0x3b50 0x11558 0x3927 0x11940 0x3714 0x11d28 0x3517 0x12110 0x332f 0x124f8 0x315b 0x128e0 0x2f9b 0x12cc8 0x2dec 0x130b0 0x2c4f 0x13498 0x2ac2 0x13880 0x2945 0x13c68 0x27d7 0x14050 0x2677 0x14438 0x2525 0x14820 0x23e0 0x14c08 0x22a8 0x14ff0 0x217c 0x153d8 0x205b 0x157c0 0x1f45 0x15ba8 0x1e3a 0x15f90 0x1d39 0x16378 0x1c42 0x16760 0x1b55 0x16b48 0x1a71 0x16f30 0x1994 0x17318 0x18c1 0x17700 0x17f4 0x17ae8 0x172e 0x17ed0 0x1670 0x182b8 0x15b9 0x186a0 0x1508 0x18a88 0x145e 0x18e70 0x13bb 0x19258 0x131d 0x19640 0x1285 0x19a28 0x11f2 0x19e10 0x1165 0x1a1f8 0x10dc 0x1a5e0 0x1058 0x1a9c8 0xfd9 0x1adb0 0xf5e 0x1b198 0xee8 0x1b580 0xe75 0x1b968 0xe07 0x1bd50 0xd9c 0x1c138 0xd34 0x1c520 0xcd1 0x1c908 0xc71 0x1ccf0 0xc15 0x1d0d8 0xbbb 0x1d4c0 0xb64 0x1d8a8 0xb10 0x1dc90 0xabf 0x1e078 0xa70 0x1e460 0xa24 0x1e848 0x9da>;
		};
	};

	fragment@55 {
		target = <0xffffffff>;

		__overlay__ {
			compatible = "mediatek,mt6855-board-ntc";
			status = "okay";
			#thermal-sensor-cells = <0x00>;
			io-channels = <0x56 0x14>;
			io-channel-names = "MD_Thermal_NTC";
			temperature-lookup-table = <0xffff63c0 0x43183f 0xffff67a8 0x3e73c9 0xffff6b90 0x3a2985 0xffff6f78 0x363204 0xffff7360 0x328683 0xffff7748 0x2f20d6 0xffff7b30 0x2bfb5b 0xffff7f18 0x2910ed 0xffff8300 0x265cd9 0xffff86e8 0x23dad1 0xffff8ad0 0x2186e9 0xffff8eb8 0x1f5d85 0xffff92a0 0x1d5b5b 0xffff9688 0x1b7d65 0xffff9a70 0x19c0dd 0xffff9e58 0x182338 0xffffa240 0x16a15b 0xffffa628 0x153a09 0xffffaa10 0x13eb44 0xffffadf8 0x12b33a 0xffffb1e0 0x11903c 0xffffb5c8 0x1080bf 0xffffb9b0 0xf8355 0xffffbd98 0xe96af 0xffffc180 0xdb998 0xffffc568 0xceaf2 0xffffc950 0xc29b7 0xffffcd38 0xb74f2 0xffffd120 0xacbc3 0xffffd508 0xa2d5c 0xffffd8f0 0x998fc 0xffffdcd8 0x90dbe 0xffffe0c0 0x88b3a 0xffffe4a8 0x810d9 0xffffe890 0x79e0c 0xffffec78 0x73250 0xfffff060 0x6cd4b 0xfffff448 0x66e67 0xfffff830 0x6153c 0xfffffc18 0x5c168 0x00 0x57293 0x3e8 0x52855 0x7d0 0x4e279 0xbb8 0x4a0b6 0xfa0 0x462c9 0x1388 0x42873 0x1770 0x3f17a 0x1b58 0x3bda8 0x1f40 0x38cc9 0x2328 0x35eaf 0x2710 0x3332e 0x2af8 0x30a1c 0x2ee0 0x2e354 0x32c8 0x2beb2 0x36b0 0x29c13 0x3a98 0x27b5b 0x3e80 0x25c66 0x4268 0x23f20 0x4650 0x2236e 0x4a38 0x20938 0x4e20 0x1f068 0x5208 0x1d8ea 0x55f0 0x1c2a8 0x59d8 0x1ad92 0x5dc0 0x19994 0x61a8 0x186a0 0x6590 0x174a6 0x6978 0x16398 0x6d60 0x15369 0x7148 0x1440c 0x7530 0x13576 0x7918 0x1279b 0x7d00 0x11a72 0x80e8 0x10df0 0x84d0 0x1020d 0x88b8 0xf6bf 0x8ca0 0xebff 0x9088 0xe1c5 0x9470 0xd80a 0x9858 0xcec6 0x9c40 0xc5f5 0xa028 0xbd90 0xa410 0xb592 0xa7f8 0xadf5 0xabe0 0xa6b3 0xafc8 0x9fc8 0xb3b0 0x992d 0xb798 0x92e1 0xbb80 0x8cdf 0xbf68 0x8723 0xc350 0x81ab 0xc738 0x7c73 0xcb20 0x7778 0xcf08 0x72b6 0xd2f0 0x6e2b 0xd6d8 0x69d3 0xdac0 0x65ac 0xdea8 0x61b5 0xe290 0x5dea 0xe678 0x5a49 0xea60 0x56d0 0xee48 0x537e 0xf230 0x5050 0xf618 0x4d46 0xfa00 0x4a5c 0xfde8 0x4792 0x101d0 0x44e8 0x105b8 0x425a 0x109a0 0x3fe8 0x10d88 0x3d8f 0x11170 0x3b50 0x11558 0x3927 0x11940 0x3714 0x11d28 0x3517 0x12110 0x332f 0x124f8 0x315b 0x128e0 0x2f9b 0x12cc8 0x2dec 0x130b0 0x2c4f 0x13498 0x2ac2 0x13880 0x2945 0x13c68 0x27d7 0x14050 0x2677 0x14438 0x2525 0x14820 0x23e0 0x14c08 0x22a8 0x14ff0 0x217c 0x153d8 0x205b 0x157c0 0x1f45 0x15ba8 0x1e3a 0x15f90 0x1d39 0x16378 0x1c42 0x16760 0x1b55 0x16b48 0x1a71 0x16f30 0x1994 0x17318 0x18c1 0x17700 0x17f4 0x17ae8 0x172e 0x17ed0 0x1670 0x182b8 0x15b9 0x186a0 0x1508 0x18a88 0x145e 0x18e70 0x13bb 0x19258 0x131d 0x19640 0x1285 0x19a28 0x11f2 0x19e10 0x1165 0x1a1f8 0x10dc 0x1a5e0 0x1058 0x1a9c8 0xfd9 0x1adb0 0xf5e 0x1b198 0xee8 0x1b580 0xe75 0x1b968 0xe07 0x1bd50 0xd9c 0x1c138 0xd34 0x1c520 0xcd1 0x1c908 0xc71 0x1ccf0 0xc15 0x1d0d8 0xbbb 0x1d4c0 0xb64 0x1d8a8 0xb10 0x1dc90 0xabf 0x1e078 0xa70 0x1e460 0xa24 0x1e848 0x9da>;
		};
	};

	fragment@56 {
		target = <0xffffffff>;

		__overlay__ {
			compatible = "mediatek,mt6855-board-ntc";
			status = "okay";
			#thermal-sensor-cells = <0x00>;
			io-channels = <0x56 0x15>;
			io-channel-names = "Charger_NTC";
			temperature-lookup-table = <0xffff63c0 0x43183f 0xffff67a8 0x3e73c9 0xffff6b90 0x3a2985 0xffff6f78 0x363204 0xffff7360 0x328683 0xffff7748 0x2f20d6 0xffff7b30 0x2bfb5b 0xffff7f18 0x2910ed 0xffff8300 0x265cd9 0xffff86e8 0x23dad1 0xffff8ad0 0x2186e9 0xffff8eb8 0x1f5d85 0xffff92a0 0x1d5b5b 0xffff9688 0x1b7d65 0xffff9a70 0x19c0dd 0xffff9e58 0x182338 0xffffa240 0x16a15b 0xffffa628 0x153a09 0xffffaa10 0x13eb44 0xffffadf8 0x12b33a 0xffffb1e0 0x11903c 0xffffb5c8 0x1080bf 0xffffb9b0 0xf8355 0xffffbd98 0xe96af 0xffffc180 0xdb998 0xffffc568 0xceaf2 0xffffc950 0xc29b7 0xffffcd38 0xb74f2 0xffffd120 0xacbc3 0xffffd508 0xa2d5c 0xffffd8f0 0x998fc 0xffffdcd8 0x90dbe 0xffffe0c0 0x88b3a 0xffffe4a8 0x810d9 0xffffe890 0x79e0c 0xffffec78 0x73250 0xfffff060 0x6cd4b 0xfffff448 0x66e67 0xfffff830 0x6153c 0xfffffc18 0x5c168 0x00 0x57293 0x3e8 0x52855 0x7d0 0x4e279 0xbb8 0x4a0b6 0xfa0 0x462c9 0x1388 0x42873 0x1770 0x3f17a 0x1b58 0x3bda8 0x1f40 0x38cc9 0x2328 0x35eaf 0x2710 0x3332e 0x2af8 0x30a1c 0x2ee0 0x2e354 0x32c8 0x2beb2 0x36b0 0x29c13 0x3a98 0x27b5b 0x3e80 0x25c66 0x4268 0x23f20 0x4650 0x2236e 0x4a38 0x20938 0x4e20 0x1f068 0x5208 0x1d8ea 0x55f0 0x1c2a8 0x59d8 0x1ad92 0x5dc0 0x19994 0x61a8 0x186a0 0x6590 0x174a6 0x6978 0x16398 0x6d60 0x15369 0x7148 0x1440c 0x7530 0x13576 0x7918 0x1279b 0x7d00 0x11a72 0x80e8 0x10df0 0x84d0 0x1020d 0x88b8 0xf6bf 0x8ca0 0xebff 0x9088 0xe1c5 0x9470 0xd80a 0x9858 0xcec6 0x9c40 0xc5f5 0xa028 0xbd90 0xa410 0xb592 0xa7f8 0xadf5 0xabe0 0xa6b3 0xafc8 0x9fc8 0xb3b0 0x992d 0xb798 0x92e1 0xbb80 0x8cdf 0xbf68 0x8723 0xc350 0x81ab 0xc738 0x7c73 0xcb20 0x7778 0xcf08 0x72b6 0xd2f0 0x6e2b 0xd6d8 0x69d3 0xdac0 0x65ac 0xdea8 0x61b5 0xe290 0x5dea 0xe678 0x5a49 0xea60 0x56d0 0xee48 0x537e 0xf230 0x5050 0xf618 0x4d46 0xfa00 0x4a5c 0xfde8 0x4792 0x101d0 0x44e8 0x105b8 0x425a 0x109a0 0x3fe8 0x10d88 0x3d8f 0x11170 0x3b50 0x11558 0x3927 0x11940 0x3714 0x11d28 0x3517 0x12110 0x332f 0x124f8 0x315b 0x128e0 0x2f9b 0x12cc8 0x2dec 0x130b0 0x2c4f 0x13498 0x2ac2 0x13880 0x2945 0x13c68 0x27d7 0x14050 0x2677 0x14438 0x2525 0x14820 0x23e0 0x14c08 0x22a8 0x14ff0 0x217c 0x153d8 0x205b 0x157c0 0x1f45 0x15ba8 0x1e3a 0x15f90 0x1d39 0x16378 0x1c42 0x16760 0x1b55 0x16b48 0x1a71 0x16f30 0x1994 0x17318 0x18c1 0x17700 0x17f4 0x17ae8 0x172e 0x17ed0 0x1670 0x182b8 0x15b9 0x186a0 0x1508 0x18a88 0x145e 0x18e70 0x13bb 0x19258 0x131d 0x19640 0x1285 0x19a28 0x11f2 0x19e10 0x1165 0x1a1f8 0x10dc 0x1a5e0 0x1058 0x1a9c8 0xfd9 0x1adb0 0xf5e 0x1b198 0xee8 0x1b580 0xe75 0x1b968 0xe07 0x1bd50 0xd9c 0x1c138 0xd34 0x1c520 0xcd1 0x1c908 0xc71 0x1ccf0 0xc15 0x1d0d8 0xbbb 0x1d4c0 0xb64 0x1d8a8 0xb10 0x1dc90 0xabf 0x1e078 0xa70 0x1e460 0xa24 0x1e848 0x9da>;
		};
	};

	fragment@57 {
		target = <0xffffffff>;

		__overlay__ {
			compatible = "mediatek,mt6855-board-ntc";
			status = "okay";
			#thermal-sensor-cells = <0x00>;
			io-channels = <0x56 0x16>;
			io-channel-names = "Flash_LED_NTC";
			temperature-lookup-table = <0xffff63c0 0x43183f 0xffff67a8 0x3e73c9 0xffff6b90 0x3a2985 0xffff6f78 0x363204 0xffff7360 0x328683 0xffff7748 0x2f20d6 0xffff7b30 0x2bfb5b 0xffff7f18 0x2910ed 0xffff8300 0x265cd9 0xffff86e8 0x23dad1 0xffff8ad0 0x2186e9 0xffff8eb8 0x1f5d85 0xffff92a0 0x1d5b5b 0xffff9688 0x1b7d65 0xffff9a70 0x19c0dd 0xffff9e58 0x182338 0xffffa240 0x16a15b 0xffffa628 0x153a09 0xffffaa10 0x13eb44 0xffffadf8 0x12b33a 0xffffb1e0 0x11903c 0xffffb5c8 0x1080bf 0xffffb9b0 0xf8355 0xffffbd98 0xe96af 0xffffc180 0xdb998 0xffffc568 0xceaf2 0xffffc950 0xc29b7 0xffffcd38 0xb74f2 0xffffd120 0xacbc3 0xffffd508 0xa2d5c 0xffffd8f0 0x998fc 0xffffdcd8 0x90dbe 0xffffe0c0 0x88b3a 0xffffe4a8 0x810d9 0xffffe890 0x79e0c 0xffffec78 0x73250 0xfffff060 0x6cd4b 0xfffff448 0x66e67 0xfffff830 0x6153c 0xfffffc18 0x5c168 0x00 0x57293 0x3e8 0x52855 0x7d0 0x4e279 0xbb8 0x4a0b6 0xfa0 0x462c9 0x1388 0x42873 0x1770 0x3f17a 0x1b58 0x3bda8 0x1f40 0x38cc9 0x2328 0x35eaf 0x2710 0x3332e 0x2af8 0x30a1c 0x2ee0 0x2e354 0x32c8 0x2beb2 0x36b0 0x29c13 0x3a98 0x27b5b 0x3e80 0x25c66 0x4268 0x23f20 0x4650 0x2236e 0x4a38 0x20938 0x4e20 0x1f068 0x5208 0x1d8ea 0x55f0 0x1c2a8 0x59d8 0x1ad92 0x5dc0 0x19994 0x61a8 0x186a0 0x6590 0x174a6 0x6978 0x16398 0x6d60 0x15369 0x7148 0x1440c 0x7530 0x13576 0x7918 0x1279b 0x7d00 0x11a72 0x80e8 0x10df0 0x84d0 0x1020d 0x88b8 0xf6bf 0x8ca0 0xebff 0x9088 0xe1c5 0x9470 0xd80a 0x9858 0xcec6 0x9c40 0xc5f5 0xa028 0xbd90 0xa410 0xb592 0xa7f8 0xadf5 0xabe0 0xa6b3 0xafc8 0x9fc8 0xb3b0 0x992d 0xb798 0x92e1 0xbb80 0x8cdf 0xbf68 0x8723 0xc350 0x81ab 0xc738 0x7c73 0xcb20 0x7778 0xcf08 0x72b6 0xd2f0 0x6e2b 0xd6d8 0x69d3 0xdac0 0x65ac 0xdea8 0x61b5 0xe290 0x5dea 0xe678 0x5a49 0xea60 0x56d0 0xee48 0x537e 0xf230 0x5050 0xf618 0x4d46 0xfa00 0x4a5c 0xfde8 0x4792 0x101d0 0x44e8 0x105b8 0x425a 0x109a0 0x3fe8 0x10d88 0x3d8f 0x11170 0x3b50 0x11558 0x3927 0x11940 0x3714 0x11d28 0x3517 0x12110 0x332f 0x124f8 0x315b 0x128e0 0x2f9b 0x12cc8 0x2dec 0x130b0 0x2c4f 0x13498 0x2ac2 0x13880 0x2945 0x13c68 0x27d7 0x14050 0x2677 0x14438 0x2525 0x14820 0x23e0 0x14c08 0x22a8 0x14ff0 0x217c 0x153d8 0x205b 0x157c0 0x1f45 0x15ba8 0x1e3a 0x15f90 0x1d39 0x16378 0x1c42 0x16760 0x1b55 0x16b48 0x1a71 0x16f30 0x1994 0x17318 0x18c1 0x17700 0x17f4 0x17ae8 0x172e 0x17ed0 0x1670 0x182b8 0x15b9 0x186a0 0x1508 0x18a88 0x145e 0x18e70 0x13bb 0x19258 0x131d 0x19640 0x1285 0x19a28 0x11f2 0x19e10 0x1165 0x1a1f8 0x10dc 0x1a5e0 0x1058 0x1a9c8 0xfd9 0x1adb0 0xf5e 0x1b198 0xee8 0x1b580 0xe75 0x1b968 0xe07 0x1bd50 0xd9c 0x1c138 0xd34 0x1c520 0xcd1 0x1c908 0xc71 0x1ccf0 0xc15 0x1d0d8 0xbbb 0x1d4c0 0xb64 0x1d8a8 0xb10 0x1dc90 0xabf 0x1e078 0xa70 0x1e460 0xa24 0x1e848 0x9da>;
		};
	};

	fragment@58 {
		target = <0xffffffff>;

		__overlay__ {
			status = "disabled";
		};
	};

	fragment@59 {
		target = <0xffffffff>;

		__overlay__ {
			mmi,temperature-names = "FRONT_TEMP";
		};
	};

	fragment@60 {
		target = <0xffffffff>;

		__overlay__ {

			pa_therm1 {
				polling-delay = <0x00>;
				polling-delay-passive = <0x00>;
				thermal-sensors = <0xffffffff>;
				phandle = <0x7b>;
			};

			nrpa_ntc {
				polling-delay = <0x00>;
				polling-delay-passive = <0x00>;
				thermal-sensors = <0xffffffff>;
				phandle = <0x7c>;
			};

			emmc_therm {
				polling-delay = <0x00>;
				polling-delay-passive = <0x00>;
				thermal-sensors = <0xffffffff>;
			};

			chg_ntc {
				polling-delay = <0x00>;
				polling-delay-passive = <0x00>;
				thermal-sensors = <0xffffffff>;
			};

			mtktsflashlight {
				polling-delay = <0x00>;
				polling-delay-passive = <0x00>;
				thermal-sensors = <0xffffffff>;
			};
		};
	};

	fragment@model {
		target-path = "/";

		__overlay__ {
			mot,model = "cancunf";
			mot,board-id = <0xd44 0xa100>;
		};
	};

	fragment@61 {
		target = <0xffffffff>;

		__overlay__ {
			GPIO_FDD_BAND_SUPPORT_DETECT_3RD_PIN = <0xffffffff 0x05 0x00>;
			GPIO_SIM1_HOT_PLUG = <0xffffffff 0x33 0x00>;
			GPIO_SIM2_HOT_PLUG = <0xffffffff 0x34 0x00>;
			GPIO_SIM1_SCLK = <0xffffffff 0x58 0x00>;
			GPIO_SIM1_SRST = <0xffffffff 0x59 0x00>;
			GPIO_SIM1_SIO = <0xffffffff 0x5a 0x00>;
			GPIO_SIM2_SCLK = <0xffffffff 0x5b 0x00>;
			GPIO_SIM2_SRST = <0xffffffff 0x5c 0x00>;
			GPIO_SIM2_SIO = <0xffffffff 0x5d 0x00>;
			GPIO_FDD_BAND_SUPPORT_DETECT_1ST_PIN = <0xffffffff 0xb7 0x00>;
		};
	};

	fragment@62 {
		target = <0xffffffff>;

		__overlay__ {
			gpio_init_default = <0x00 0x00 0x00 0x00 0x01 0x01 0x01 0x01 0x00 0x01 0x00 0x01 0x00 0x01 0x02 0x00 0x00 0x00 0x01 0x00 0x01 0x03 0x00 0x01 0x01 0x00 0x00 0x01 0x04 0x00 0x01 0x00 0x01 0x00 0x01 0x05 0x00 0x00 0x00 0x00 0x00 0x01 0x06 0x01 0x01 0x00 0x00 0x00 0x00 0x07 0x00 0x00 0x00 0x01 0x01 0x01 0x08 0x06 0x00 0x00 0x01 0x00 0x01 0x09 0x01 0x01 0x00 0x00 0x00 0x00 0x0a 0x01 0x01 0x00 0x00 0x00 0x00 0x0b 0x01 0x01 0x00 0x00 0x00 0x00 0x0c 0x01 0x01 0x00 0x00 0x00 0x00 0x0d 0x00 0x00 0x00 0x01 0x01 0x01 0x0e 0x00 0x00 0x00 0x01 0x01 0x01 0x0f 0x00 0x00 0x00 0x01 0x00 0x01 0x10 0x00 0x00 0x00 0x01 0x00 0x01 0x11 0x00 0x00 0x00 0x01 0x01 0x01 0x12 0x00 0x00 0x00 0x01 0x00 0x01 0x13 0x00 0x00 0x00 0x01 0x01 0x01 0x14 0x01 0x01 0x00 0x00 0x00 0x00 0x15 0x00 0x01 0x00 0x01 0x00 0x01 0x16 0x00 0x00 0x00 0x01 0x00 0x01 0x17 0x00 0x01 0x00 0x01 0x00 0x01 0x18 0x00 0x01 0x00 0x01 0x00 0x00 0x19 0x01 0x01 0x00 0x00 0x00 0x00 0x1a 0x01 0x00 0x00 0x00 0x00 0x00 0x1b 0x00 0x00 0x00 0x01 0x00 0x01 0x1c 0x00 0x00 0x00 0x01 0x00 0x01 0x1d 0x01 0x01 0x00 0x00 0x00 0x00 0x1e 0x00 0x01 0x00 0x01 0x00 0x01 0x1f 0x01 0x01 0x00 0x00 0x00 0x00 0x20 0x01 0x01 0x00 0x00 0x00 0x00 0x21 0x00 0x00 0x00 0x01 0x00 0x01 0x22 0x00 0x00 0x00 0x01 0x00 0x01 0x23 0x03 0x00 0x00 0x01 0x01 0x01 0x24 0x03 0x00 0x00 0x00 0x00 0x01 0x25 0x03 0x00 0x00 0x00 0x00 0x01 0x26 0x00 0x01 0x00 0x01 0x00 0x01 0x27 0x00 0x00 0x00 0x01 0x01 0x01 0x28 0x00 0x00 0x00 0x01 0x01 0x01 0x29 0x00 0x00 0x00 0x01 0x01 0x01 0x2a 0x01 0x00 0x00 0x00 0x00 0x01 0x2b 0x01 0x01 0x00 0x00 0x00 0x01 0x2c 0x01 0x01 0x00 0x00 0x00 0x01 0x2d 0x00 0x00 0x00 0x01 0x01 0x01 0x2e 0x00 0x00 0x00 0x01 0x01 0x01 0x2f 0x01 0x00 0x00 0x00 0x00 0x01 0x30 0x01 0x00 0x00 0x00 0x00 0x01 0x31 0x01 0x00 0x00 0x00 0x00 0x01 0x32 0x03 0x00 0x00 0x01 0x00 0x01 0x33 0x01 0x00 0x00 0x01 0x01 0x01 0x34 0x01 0x00 0x00 0x01 0x01 0x01 0x35 0x01 0x00 0x00 0x00 0x00 0x01 0x36 0x01 0x00 0x00 0x01 0x01 0x01 0x37 0x01 0x00 0x00 0x00 0x00 0x01 0x38 0x01 0x00 0x00 0x01 0x01 0x01 0x39 0x01 0x00 0x00 0x01 0x00 0x01 0x3a 0x00 0x01 0x00 0x01 0x00 0x01 0x3b 0x01 0x00 0x00 0x01 0x01 0x01 0x3c 0x07 0x00 0x00 0x01 0x00 0x01 0x3d 0x07 0x00 0x00 0x01 0x00 0x01 0x3e 0x07 0x00 0x00 0x01 0x00 0x01 0x3f 0x07 0x00 0x00 0x00 0x00 0x01 0x40 0x07 0x00 0x00 0x01 0x00 0x01 0x41 0x02 0x00 0x00 0x00 0x00 0x01 0x42 0x02 0x00 0x00 0x01 0x01 0x01 0x43 0x02 0x00 0x00 0x00 0x00 0x01 0x44 0x02 0x00 0x00 0x01 0x00 0x01 0x45 0x01 0x00 0x00 0x00 0x00 0x01 0x46 0x01 0x00 0x00 0x00 0x00 0x01 0x47 0x01 0x00 0x00 0x00 0x00 0x01 0x48 0x01 0x00 0x00 0x01 0x00 0x01 0x49 0x02 0x01 0x00 0x00 0x00 0x01 0x4a 0x02 0x01 0x01 0x00 0x00 0x01 0x4b 0x02 0x01 0x00 0x00 0x00 0x01 0x4c 0x02 0x00 0x00 0x01 0x00 0x01 0x4d 0x01 0x00 0x00 0x00 0x00 0x01 0x4e 0x01 0x00 0x00 0x00 0x00 0x01 0x4f 0x01 0x00 0x00 0x00 0x00 0x01 0x50 0x01 0x00 0x00 0x01 0x00 0x01 0x52 0x01 0x00 0x00 0x00 0x00 0x01 0x53 0x01 0x00 0x00 0x01 0x01 0x01 0x54 0x01 0x00 0x00 0x01 0x01 0x01 0x55 0x01 0x00 0x00 0x01 0x01 0x01 0x56 0x01 0x00 0x00 0x01 0x01 0x01 0x57 0x01 0x00 0x00 0x01 0x01 0x01 0x58 0x01 0x00 0x00 0x00 0x00 0x01 0x59 0x01 0x00 0x00 0x00 0x00 0x01 0x5a 0x01 0x00 0x00 0x01 0x01 0x01 0x5b 0x01 0x00 0x00 0x00 0x00 0x01 0x5c 0x01 0x00 0x00 0x00 0x00 0x01 0x5d 0x01 0x00 0x00 0x01 0x01 0x01 0x5e 0x01 0x00 0x00 0x01 0x00 0x01 0x5f 0x01 0x00 0x00 0x00 0x00 0x01 0x60 0x01 0x00 0x00 0x00 0x00 0x01 0x61 0x01 0x01 0x00 0x00 0x00 0x00 0x62 0x01 0x00 0x00 0x01 0x00 0x01 0x63 0x01 0x01 0x00 0x00 0x00 0x00 0x64 0x01 0x01 0x00 0x00 0x00 0x00 0x65 0x00 0x00 0x00 0x00 0x00 0x01 0x66 0x00 0x00 0x00 0x00 0x00 0x01 0x67 0x01 0x00 0x00 0x01 0x00 0x01 0x68 0x01 0x00 0x00 0x01 0x00 0x01 0x69 0x01 0x00 0x00 0x00 0x00 0x01 0x6a 0x01 0x00 0x00 0x00 0x00 0x01 0x6b 0x01 0x00 0x00 0x00 0x00 0x01 0x6c 0x01 0x00 0x00 0x00 0x00 0x01 0x6d 0x01 0x00 0x00 0x00 0x00 0x01 0x6e 0x01 0x00 0x00 0x00 0x00 0x01 0x6f 0x01 0x00 0x00 0x00 0x00 0x01 0x70 0x01 0x00 0x00 0x00 0x00 0x01 0x71 0x01 0x00 0x00 0x00 0x00 0x01 0x72 0x01 0x00 0x00 0x00 0x00 0x01 0x73 0x01 0x00 0x00 0x00 0x00 0x01 0x74 0x01 0x00 0x00 0x00 0x00 0x01 0x75 0x01 0x00 0x00 0x00 0x00 0x01 0x76 0x01 0x00 0x00 0x00 0x00 0x01 0x77 0x01 0x00 0x00 0x00 0x00 0x01 0x78 0x01 0x00 0x00 0x00 0x00 0x01 0x79 0x01 0x00 0x00 0x00 0x00 0x01 0x7a 0x01 0x00 0x00 0x00 0x00 0x01 0x7b 0x01 0x00 0x00 0x00 0x00 0x01 0x7c 0x01 0x00 0x00 0x00 0x00 0x01 0x7d 0x01 0x00 0x00 0x00 0x00 0x01 0x7e 0x01 0x00 0x00 0x00 0x00 0x01 0x7f 0x01 0x00 0x00 0x00 0x00 0x00 0x80 0x01 0x00 0x00 0x01 0x00 0x00 0x81 0x01 0x00 0x00 0x00 0x00 0x00 0x82 0x01 0x00 0x00 0x01 0x00 0x00 0x83 0x01 0x00 0x00 0x00 0x00 0x00 0x84 0x01 0x00 0x00 0x01 0x00 0x00 0x85 0x03 0x00 0x00 0x01 0x00 0x01 0x86 0x03 0x00 0x00 0x01 0x00 0x01 0x87 0x01 0x00 0x00 0x01 0x00 0x01 0x88 0x01 0x00 0x00 0x01 0x00 0x01 0x89 0x01 0x00 0x00 0x01 0x01 0x01 0x8a 0x01 0x00 0x00 0x01 0x01 0x01 0x8b 0x02 0x00 0x00 0x01 0x01 0x01 0x8c 0x02 0x00 0x00 0x01 0x01 0x01 0x8d 0x01 0x00 0x00 0x01 0x01 0x01 0x8e 0x01 0x00 0x00 0x01 0x01 0x01 0x8f 0x01 0x00 0x00 0x01 0x01 0x01 0x90 0x01 0x00 0x00 0x01 0x01 0x01 0x91 0x01 0x00 0x00 0x01 0x01 0x01 0x92 0x01 0x00 0x00 0x01 0x01 0x01 0x93 0x01 0x00 0x00 0x01 0x01 0x01 0x94 0x01 0x00 0x00 0x01 0x01 0x01 0x95 0x01 0x00 0x00 0x01 0x01 0x01 0x96 0x01 0x00 0x00 0x01 0x01 0x01 0x97 0x01 0x00 0x00 0x01 0x01 0x01 0x98 0x01 0x00 0x00 0x01 0x01 0x01 0x99 0x01 0x00 0x00 0x01 0x01 0x01 0x9a 0x01 0x00 0x00 0x01 0x01 0x01 0x9b 0x01 0x00 0x00 0x01 0x01 0x01 0x9c 0x01 0x00 0x00 0x01 0x01 0x01 0x9d 0x00 0x01 0x00 0x01 0x00 0x01 0x9e 0x00 0x01 0x00 0x01 0x00 0x01 0x9f 0x00 0x01 0x00 0x01 0x00 0x01 0xa0 0x03 0x00 0x00 0x01 0x00 0x01 0xa1 0x00 0x01 0x00 0x01 0x00 0x01 0xa2 0x00 0x01 0x00 0x01 0x00 0x01 0xa3 0x01 0x00 0x00 0x00 0x00 0x01 0xa4 0x01 0x00 0x00 0x00 0x00 0x01 0xa5 0x01 0x00 0x00 0x00 0x00 0x01 0xa6 0x01 0x00 0x00 0x00 0x00 0x01 0xa7 0x01 0x00 0x00 0x00 0x00 0x01 0xa8 0x01 0x00 0x00 0x00 0x00 0x01 0xa9 0x01 0x00 0x00 0x00 0x00 0x01 0xaa 0x01 0x00 0x00 0x01 0x00 0x01 0xab 0x01 0x00 0x00 0x00 0x00 0x01 0xac 0x01 0x00 0x00 0x00 0x00 0x01 0xad 0x01 0x00 0x00 0x00 0x00 0x01 0xae 0x01 0x00 0x00 0x00 0x00 0x01 0xaf 0x01 0x00 0x00 0x00 0x00 0x01 0xb0 0x01 0x00 0x00 0x00 0x00 0x01 0xb1 0x01 0x00 0x00 0x00 0x00 0x01 0xb2 0x01 0x00 0x00 0x00 0x00 0x01 0xb3 0x01 0x00 0x00 0x01 0x00 0x01 0xb4 0x01 0x00 0x00 0x01 0x00 0x01 0xb5 0x01 0x00 0x00 0x01 0x00 0x01 0xb6 0x00 0x01 0x00 0x01 0x00 0x01 0xb7 0x00 0x00 0x00 0x00 0x00 0x01 0xb8 0x00 0x00 0x00 0x01 0x00 0x01 0xb9 0x00 0x00 0x00 0x01 0x00 0x01 0xba 0x00 0x00 0x00 0x01 0x00 0x01 0xbb 0x00 0x00 0x00 0x01 0x00 0x01 0xbc 0x00 0x00 0x00 0x01 0x00 0x01 0xbd 0x00 0x00 0x00 0x01 0x00 0x01 0xbe 0x00 0x00 0x00 0x01 0x00 0x01 0xbf 0x00 0x00 0x00 0x01 0x00 0x01 0xc0 0x00 0x00 0x00 0x01 0x00 0x01 0xc1 0x01 0x00 0x00 0x00 0x00 0x01 0xc2 0x00 0x01 0x00 0x01 0x00 0x01 0xc3 0x00 0x01 0x00 0x01 0x00 0x01 0xc4 0x01 0x00 0x00 0x01 0x01 0x01 0xc5 0x01 0x00 0x00 0x00 0x00 0x01 0xc6 0x01 0x00 0x00 0x01 0x01 0x01 0xc7 0x00 0x01 0x00 0x01 0x00 0x01 0xc8 0x01 0x00 0x00 0x01 0x01 0x01 0xc9 0x01 0x00 0x00 0x01 0x01 0x01 0xca 0x01 0x00 0x00 0x01 0x01 0x01 0xcb 0x00 0x01 0x00 0x01 0x00 0x01 0xcc 0x01 0x00 0x00 0x01 0x01 0x01 0xcd 0x00 0x01 0x00 0x01 0x00 0x01 0xce 0x00 0x00 0x00 0x01 0x00 0x00 0xcf 0x00 0x00 0x00 0x01 0x00 0x00 0xd0 0x00 0x00 0x00 0x01 0x00 0x00 0xd1 0x00 0x00 0x00 0x01 0x00 0x00 0xd2 0x00 0x00 0x00 0x01 0x00 0x00 0xd3 0x00 0x00 0x00 0x01 0x00 0x00 0xd4 0x00 0x00 0x00 0x01 0x00 0x00 0xd5 0x00 0x00 0x00 0x01 0x00 0x00 0xd6 0x00 0x00 0x00 0x01 0x00 0x00 0xd7 0x00 0x00 0x00 0x01 0x00 0x00 0xd8 0x00 0x00 0x00 0x01 0x00 0x00 0xd9 0x00 0x00 0x00 0x01 0x00 0x00 0xda 0x00 0x00 0x00 0x01 0x00 0x00 0xdb 0x00 0x00 0x00 0x01 0x00 0x00 0xdc 0x00 0x00 0x00 0x01 0x00 0x00 0xdd 0x00 0x00 0x00 0x01 0x00 0x00 0xde 0x00 0x00 0x00 0x01 0x00 0x00 0xdf 0x00 0x00 0x00 0x01 0x00 0x00 0xe0 0x00 0x00 0x00 0x01 0x00 0x00 0xe1 0x00 0x00 0x00 0x01 0x00 0x00>;
		};
	};

	fragment@63 {
		target = <0xffffffff>;

		__overlay__ {
			interrupt-parent = <0xffffffff>;
			interrupts = <0x07 0x08>;
			status = "okay";
		};
	};

	fragment@64 {
		target = <0xffffffff>;

		__overlay__ {
			interrupt-parent = <0xffffffff>;
			interrupts = <0x0d 0x08>;
			deb-gpios = <0xffffffff 0x0d 0x00>;
			debounce = <0x7d000>;
			status = "okay";
		};
	};

	fragment@65 {
		target = <0xffffffff>;

		__overlay__ {
			interrupt-parent = <0xffffffff>;
			interrupts = <0x16 0x02>;
			status = "okay";
		};
	};

	fragment@66 {
		target = <0xffffffff>;

		__overlay__ {
			interrupt-parent = <0xffffffff>;
			interrupts = <0x17 0x02>;
			status = "okay";
		};
	};

	fragment@67 {
		target = <0xffffffff>;

		__overlay__ {
			interrupt-parent = <0xffffffff>;
			interrupts = <0x27 0x04>;
			deb-gpios = <0xffffffff 0x27 0x00>;
			debounce = <0x7d000>;
			status = "okay";
		};
	};

	fragment@68 {
		target = <0xffffffff>;

		__overlay__ {
			interrupt-parent = <0xffffffff>;
			interrupts = <0x28 0x04>;
			deb-gpios = <0xffffffff 0x28 0x00>;
			debounce = <0x7d000>;
			status = "okay";
		};
	};

	fragment@69 {
		target = <0xffffffff>;

		__overlay__ {
			interrupt-parent = <0xffffffff>;
			interrupts = <0x29 0x04>;
			deb-gpios = <0xffffffff 0x29 0x00>;
			debounce = <0x7d000>;
			status = "okay";
		};
	};

	fragment@70 {
		target = <0xffffffff>;

		__overlay__ {
			interrupt-parent = <0xffffffff>;
			interrupts = <0x2d 0x04>;
			deb-gpios = <0xffffffff 0x2d 0x00>;
			debounce = <0x7d000>;
			status = "okay";
		};
	};

	fragment@71 {
		target = <0xffffffff>;

		__overlay__ {
			interrupt-parent = <0xffffffff>;
			interrupts = <0x2e 0x08>;
			status = "okay";
		};
	};

	fragment@72 {
		target = <0xffffffff>;

		__overlay__ {
			interrupt-parent = <0xffffffff>;
			interrupts = <0x5e 0x01>;
			status = "okay";
		};
	};

	fragment@73 {
		target = <0xffffffff>;

		__overlay__ {
			compatible = "mediatek,md1_sim1_hot_plug_eint-eint";
			interrupts = <0x00 0x08>;
			debounce = <0x00 0x2710>;
			dedicated = <0x00 0x00>;
			src_pin = <0x00 0x01>;
			sockettype = <0x00 0x00>;
			status = "okay";
		};
	};

	fragment@74 {
		target = <0xffffffff>;

		__overlay__ {
			compatible = "mediatek,md1_sim2_hot_plug_eint-eint";
			interrupts = <0x01 0x08>;
			debounce = <0x01 0x2710>;
			dedicated = <0x01 0x00>;
			src_pin = <0x01 0x02>;
			sockettype = <0x01 0x00>;
			status = "okay";
		};
	};

	fragment@75 {
		target = <0xffffffff>;

		__overlay__ {
			mediatek,key-debounce = <0x400>;
			mediatek,sw-pwrkey = <0x74>;
			mediatek,hw-pwrkey = <0x08>;
			mediatek,sw-rstkey = <0x72>;
			mediatek,hw-rstkey = <0x11>;
			mediatek,use-extend-type = <0x00>;
			mediatek,hw-map-num = <0x48>;
			mediatek,hw-init-map = <0x73 0x00 0x00 0x00 0x00 0x00 0x00 0x00 0x00 0x00 0x00 0x00 0x00 0x00 0x00 0x00 0x00 0x00 0x00 0x00 0x00 0x00 0x00 0x00 0x00 0x00 0x00 0x00 0x00 0x00 0x00 0x00 0x00 0x00 0x00 0x00 0x00 0x00 0x00 0x00 0x00 0x00 0x00 0x00 0x00 0x00 0x00 0x00 0x00 0x00 0x00 0x00 0x00 0x00 0x00 0x00 0x00 0x00 0x00 0x00 0x00 0x00 0x00 0x00 0x00 0x00 0x00 0x00 0x00 0x00 0x00 0x00>;
			mediatek,pwrkey-eint-gpio = <0x00>;
			mediatek,pwkey-gpio-din = <0x00>;
			mediatek,hw-dl-key0 = <0x00>;
			mediatek,hw-dl-key1 = <0x11>;
			mediatek,hw-dl-key2 = <0x08>;
			mediatek,hw-recovery-key = <0x00>;
			mediatek,hw-factory-key = <0x11>;
			status = "okay";
		};
	};

	fragment@76 {
		target = <0xffffffff>;

		__overlay__ {
			usb_charger_current = <0x7a120>;
			ac_charger_current = <0x16e360>;
			ac_charger_input_current = <0x16e360>;
			non_std_ac_charger_current = <0xf4240>;
			charging_host_input_current = <0x16e360>;
			charging_host_charger_current = <0xf4240>;
			temp_t4_threshold = <0x3c>;
			boot_battery_voltage = <0x365240>;
		};
	};

	fragment@77 {
		target = <0xffffffff>;

		__overlay__ {
			enable_vbat_mon = <0x00>;
			boot_battery_voltage = <0x365240>;
			battery_cv = <0x44aa20>;
			max_charger_voltage = <0xa7d8c0>;
			disable_aicl;
			enable_dynamic_mivr;
			fast_charging_indicator = <0x16>;
			charger_configuration = <0x03>;
			usb_charger_current_suspend = <0x00>;
			usb_charger_current_unconfigured = <0x11170>;
			usb_charger_current_configured = <0x7a120>;
			usb_charger_current = <0x7a120>;
			ac_charger_current = <0x2dc6c0>;
			ac_charger_input_current = <0x1e8480>;
			non_std_ac_charger_current = <0xf4240>;
			charging_host_charger_current = <0x16e360>;
			apple_1_0a_charger_current = <0x9eb10>;
			apple_2_1a_charger_current = "\0\f5";
			ta_ac_charger_current = <0x1e8480>;
			typec_limit_aicr = <0x2dc6c0>;
			mmi,iterm-ma = <0x124>;
			mmi,mmi-temp-zones = <0x00 0x1068 0x4b0 0x00 0x0a 0x109a 0xbb8 0x708 0x0f 0x1194 0xbb8 0xbb8 0x2d 0x10cc 0x1770 0x1450 0x2d 0x1130 0x1450 0xfa0 0x2d 0x1194 0xfa0 0xfa0 0x3c 0x1068 0xb68 0x00>;
			mmi,mmi-ffc-zones = <0x00 0x1068 0x124 0x0a 0x1194 0x124 0x0f 0x1194 0x124 0x19 0x11b2 0x308 0x23 0x11b2 0x3b2 0x2d 0x11b2 0x563 0x3c 0x1068 0x124>;
			mmi,enable-charging-limit;
			mmi,upper-limit-capacity = <0x41>;
			mmi,lower-limit-capacity = <0x3c>;
			mmi,min-cp-therm-current-ua = <0x186a00>;
		};
	};

	fragment@78 {
		target = <0xffffffff>;

		__overlay__ {

			mmi_chrg_manager {
				compatible = "mmi,chrg-manager";
				mmi,pps-volt-steps = <0x4e20>;
				mmi,pps-curr-steps = <0x9c40>;
				mmi,pd-volt-max = <0xb71b00>;
				mmi,pd-curr-max = <0x2dc6c0>;
				mmi,batt-curr-boost = <0x493e0>;
				mmi,batt-ovp-lmt = <0x456d70>;
				mmi,pl-chrg-vbatt-min = <0x2dc6c0>;
				mmi,typec-middle-current = "\0\f5";
				mmi,step-first-current-comp = <0x00>;
				mmi,dont-rerun-aicl;
				mmi,chrg-temp-zones-num = <0x05>;
				mmi,mmi-chrg-temp-zones = <0x00 0x1068 0x4b0 0x00 0x00 0x00 0x00 0x0a 0x109a 0xbb8 0x1194 0x708 0x00 0x00 0x0f 0x1194 0xbb8 0x00 0x00 0x00 0x00 0x2d 0x10cc 0x1770 0x1130 0x1450 0x11b2 0xfa0 0x3c 0x1068 0xb68 0x00 0x00 0x00 0x00>;
				mmi,mmi-ffc-zones = <0x1068 0x124 0x109a 0x124 0x1162 0x124 0x11b2 0x308 0x11b2 0x3b2 0x11b2 0x563 0x1068 0x124>;
				mmi,thermal-min-level = <0x16e360>;
				charger = <0xffffffff>;

				charger_device_0 {
					chrg-name = "pmic-sw";
					psy-name = "mtk-master-charger";
					charging-curr-limited = <0x7a120>;
				};

				charger_device_1 {
					chrg-name = "cp-master";
					psy-name = "cp-standalone";
					charging-curr-min = <0x1b7740>;
				};
			};
		};
	};

	fragment@79 {
		target = <0xffffffff>;

		__overlay__ {
			cv = <0x1194>;
			ircmp_r = <0x00>;
			ircmp_v = <0x00>;
		};
	};

	fragment@80 {
		target = <0xffffffff>;

		__overlay__ {
			vbus-current = <0x10c8e0>;
		};
	};

	fragment@81 {
		target = <0xffffffff>;

		__overlay__ {
			sc_input_current = <0x2dc6c0>;
		};
	};

	fragment@82 {
		target = <0xffffffff>;

		__overlay__ {
			sc_input_current = <0x2dc6c0>;
		};
	};

	fragment@83 {
		target = <0xffffffff>;

		__overlay__ {

			pd-data {
				pd,source-cap-ext = [cf 29 75 63 00 00 00 00 00 00 00 00 00 00 00 00 00 00 00 00 00 00 01 04 00];
				pd,sink-cap-ext = <0xcf297563 0x00 0x100 0x00 0x10b010a 0xf000000>;
				pd,source-pdo-data = <0x1905a>;
				pd,sink-pdo-size = <0x01>;
				pd,sink-pdo-data = <0x1912c>;
			};
		};
	};

	fragment@84 {
		target = <0xffffffff>;

		__overlay__ {
			ita_min = <0x3e8>;
		};
	};

	fragment@85 {
		target = <0xffffffff>;

		__overlay__ {
			compatible = "mediatek,charger,pe5";
			gauge = <0xffffffff>;
			polling_interval = <0x2710>;
			ta_cv_ss_repeat_tmin = <0x19>;
			vbat_cv = <0x11b2>;
			start_soc_min = <0x00>;
			start_soc_max = <0x50>;
			start_vbat_max = <0x1162>;
			idvchg_term = <0x1f4>;
			idvchg_step = <0x32>;
			ita_level = <0xbb8 0x9c4 0x7d0 0x5dc>;
			rcable_level = <0x15e 0x190 0x1f4 0x258>;
			ita_level_dual = <0x1388 0xe74 0xd48 0xbb8>;
			rcable_level_dual = <0xe6 0x15e 0x1c2 0x226>;
			idvchg_ss_init = <0x3e8>;
			idvchg_ss_step = <0xfa>;
			idvchg_ss_step1 = <0x64>;
			idvchg_ss_step2 = <0x32>;
			idvchg_ss_step1_vbat = <0xfa0>;
			idvchg_ss_step2_vbat = <0x1068>;
			ta_blanking = <0x190>;
			swchg_aicr = <0x00>;
			swchg_ichg = <0x4b0>;
			swchg_aicr_ss_init = <0x190>;
			swchg_aicr_ss_step = <0xc8>;
			swchg_off_vbat = <0x109a>;
			force_ta_cv_vbat = <0x109a>;
			chg_time_max = <0x2a30>;
			tta_level_def = <0x00 0x00 0x00 0x00 0x19 0x32 0x3c 0x46 0x50>;
			tta_curlmt = <0x00 0x00 0x00 0x00 0x00 0x00 0x00 0x00 0x00>;
			tta_recovery_area = <0x03>;
			tbat_level_def = <0x00 0x00 0x00 0x05 0x19 0x28 0x2b 0x2e 0x32>;
			tbat_curlmt = <0x00 0x00 0x00 0x00 0x00 0x00 0x00 0x00 0x00>;
			tbat_recovery_area = <0x03>;
			tdvchg_level_def = <0x00 0x00 0x00 0x05 0x19 0x37 0x3c 0x41 0x46>;
			tdvchg_curlmt = <0x00 0x00 0x00 0x00 0x00 0x00 0x00 0x00 0x00>;
			tdvchg_recovery_area = <0x03>;
			tswchg_level_def = <0x00 0x00 0x00 0x05 0x19 0x41 0x46 0x4b 0x50>;
			tswchg_curlmt = <0x00 0x00 0x00 0x00 0x00 0x00 0x00 0x00 0x00>;
			tswchg_recovery_area = <0x03>;
			ifod_threshold = <0xc8>;
			rsw_min = <0x14>;
			ircmp_rbat = <0x28>;
			ircmp_vclamp = <0x00>;
			vta_cap_min = <0x1a90>;
			vta_cap_max = <0x2af8>;
			ita_cap_min = <0x3e8>;
			support_ta = "pca_ta_pps\0pd_adapter";
			allow_not_check_ta_status;
			vbat_threshold = <0x1036>;
			mmi_therm_cur_thres = <0x1f4>;
			mmi_therm_vol_thres = <0x50>;
			mmi_therm_step = <0x03>;
			mmi_max_ibat = <0x1770>;
		};
	};

	fragment@86 {
		target = <0xffffffff>;

		__overlay__ {
			DIFFERENCE_FULLOCV_ITH = <0x50>;
			EMBEDDED_SEL = <0x01>;
			VIR_OLDOCV_DIFF_EMB = <0xbb8>;
			VIR_OLDOCV_DIFF_EMB_LT = <0xbb8>;
			CURR_MEASURE_20A = <0x00>;
			UNIT_MULTIPLE = <0x01>;
			g_temperature = <0x32 0x19 0x0a 0x00 0xfffffff6 0xffffffe7 0xffffffe2 0xffffffdd 0xffffffd8 0xffffffd3>;
			g_FG_PSEUDO100 = <0x62 0x63 0x64 0x64 0x62 0x63 0x64 0x64 0x62 0x63 0x64 0x64 0x62 0x63 0x64 0x64 0x62 0x63 0x64 0x64 0x64 0x64 0x64 0x64 0x64 0x64 0x64 0x64 0x64 0x64 0x64 0x64 0x64 0x64 0x64 0x64 0x64 0x64 0x64 0x64>;
			g_Q_MAX = <0x1754 0x1384 0x1384 0x1384 0x17a5 0x1384 0x1384 0x1384 0x1793 0x1384 0x1384 0x1384 0x1725 0x1384 0x1384 0x1384 0x1670 0x1384 0x1384 0x1384 0x1669 0x1384 0x1384 0x1384 0x1661 0x1384 0x1384 0x1384 0x1659 0x1384 0x1384 0x1384 0x164f 0x1384 0x1384 0x1384 0x1644 0x1384 0x1384 0x1384>;
			g_Q_MAX_H_CURRENT = <0x1714 0x137e 0x137e 0x137e 0x175a 0x137e 0x137e 0x137e 0x175a 0x137e 0x137e 0x137e 0x1715 0x137e 0x137e 0x137e 0x1661 0x137e 0x137e 0x137e 0x1637 0x137e 0x137e 0x137e 0x15f8 0x137e 0x137e 0x137e 0x1528 0x137e 0x137e 0x137e 0x149b 0x137e 0x137e 0x137e 0x140e 0x137e 0x137e 0x137e>;
			g_PMIC_MIN_VOL_row = <0x04>;
			g_PMIC_MIN_VOL_col = <0x0a>;
			g_PMIC_MIN_VOL = <0x7d00 0x7d00 0x82dc 0x82dc 0x7d00 0x7d00 0x80e8 0x80e8 0x80e8 0x80e8 0x80e8 0x80e8 0x7dc8 0x7dc8 0x7dc8 0x7dc8 0x7a80 0x7a80 0x7a80 0x7a80 0x7918 0x7918 0x7918 0x7918 0x7918 0x7918 0x7918 0x7918 0x7918 0x7918 0x7918 0x7918 0x7918 0x7918 0x7918 0x7918 0x7918 0x7918 0x7918 0x79e0>;
			g_QMAX_SYS_VOL_row = <0x04>;
			g_QMAX_SYS_VOL_col = <0x0a>;
			g_QMAX_SYS_VOL = <0x7ef4 0x7ef4 0x8886 0x8886 0x7ef4 0x7ef4 0x8886 0x8886 0x85ca 0x85ca 0x85ca 0x85ca 0x85ca 0x85ca 0x85ca 0x85ca 0x85ca 0x85ca 0x85ca 0x85ca 0x85ca 0x85ca 0x85ca 0x85ca 0x8020 0x8020 0x8020 0x8020 0x8020 0x8020 0x8020 0x8020 0x8020 0x8020 0x8020 0x8020 0x8020 0x8020 0x8020 0x8020>;
			SHUTDOWN_1_TIME = <0x1e>;
			ACTIVE_TABLE = <0x05>;
			R_FG_VALUE = <0x05>;
			NO_BAT_TEMP_COMPENSATE = <0x01>;
			CAR_TUNE_VALUE = <0x63>;
			df-serialnum = "SB18D89641";
			serialnum_0 = "SB18D89641";
			battery0_profile_t0_num = <0x64>;
			battery0_profile_t0_col = <0x03>;
			battery0_profile_t0 = <0x00 0xae11 0x197 0x26c 0xad39 0x197 0x4d7 0xac8e 0x199 0x743 0xabfd 0x198 0x9ae 0xab7b 0x19c 0xc1a 0xab02 0x1a0 0xe86 0xaa8e 0x19e 0x10f1 0xaa1a 0x19b 0x135d 0xa9aa 0x1a0 0x15c8 0xa935 0x1a0 0x1834 0xa8c1 0x1a0 0x1a9f 0xa84b 0x1a0 0x1d0b 0xa7d4 0x1a5 0x1f77 0xa75a 0x1a6 0x21e2 0xa6dd 0x1a2 0x244e 0xa660 0x1a1 0x26b9 0xa5e3 0x1a6 0x2925 0xa566 0x1a3 0x2b91 0xa4e8 0x1a8 0x2dfc 0xa46b 0x1a9 0x3068 0xa3ef 0x1ab 0x32d3 0xa372 0x1ac 0x353f 0xa2f7 0x1af 0x37aa 0xa27e 0x1b3 0x3a16 0xa205 0x1b6 0x3c82 0xa18d 0x1b8 0x3eed 0xa115 0x1b0 0x4159 0xa0a2 0x1b4 0x43c4 0xa02f 0x1b7 0x4630 0x9fbe 0x1b8 0x489c 0x9f50 0x1bc 0x4b07 0x9ee3 0x1c2 0x4d73 0x9e78 0x1c2 0x4fde 0x9e0d 0x1c5 0x524a 0x9da6 0x1c5 0x54b6 0x9d42 0x1cf 0x5721 0x9ce3 0x1da 0x598d 0x9c83 0x1e1 0x5bf8 0x9c24 0x1e6 0x5e64 0x9bc8 0x1ee 0x60cf 0x9b6d 0x1fb 0x633b 0x9b13 0x211 0x65a7 0x9ab8 0x227 0x6812 0x9a3f 0x21c 0x6a7e 0x99a1 0x1db 0x6ce9 0x9913 0x1b8 0x6f55 0x98a2 0x1ae 0x71c1 0x9847 0x1aa 0x742c 0x97f8 0x1a8 0x7698 0x97b0 0x1ac 0x7903 0x976b 0x1ac 0x7b6f 0x972a 0x1a1 0x7dda 0x96ee 0x1a0 0x8046 0x96b5 0x1a8 0x82b2 0x967d 0x1ac 0x851d 0x9647 0x1ac 0x8789 0x9613 0x1ac 0x89f4 0x95e0 0x1ad 0x8c60 0x95b1 0x1af 0x8ecc 0x9581 0x1ac 0x9137 0x9556 0x1af 0x93a3 0x952b 0x1b6 0x960e 0x9505 0x1bc 0x987a 0x94de 0x1bd 0x9ae5 0x94b8 0x1bf 0x9d51 0x9495 0x1c8 0x9fbd 0x9472 0x1d2 0xa228 0x9451 0x1d7 0xa494 0x942d 0x1dd 0xa6ff 0x9404 0x1e0 0xa96b 0x93bb 0x1bd 0xabd7 0x9363 0x1a4 0xae42 0x9315 0x1a3 0xb0ae 0x92d9 0x1ab 0xb319 0x92a6 0x1aa 0xb585 0x9271 0x1ab 0xb7f1 0x9239 0x1a1 0xba5c 0x920a 0x1a8 0xbcc8 0x91e1 0x1ab 0xbf33 0x91ba 0x1b4 0xc19f 0x918c 0x1b4 0xc40a 0x9153 0x1b0 0xc676 0x9111 0x1b1 0xc8e2 0x90cd 0x1ad 0xcb4d 0x9090 0x1b5 0xcdb9 0x9044 0x1b0 0xd024 0x8ff3 0x1a4 0xd290 0x8fcf 0x1a6 0xd4fc 0x8fc0 0x1b0 0xd767 0x8fb2 0x1b8 0xd9d3 0x8fa1 0x1c2 0xdc3e 0x8f83 0x1d5 0xdeaa 0x8f3a 0x1e5 0xe115 0x8e2b 0x1d2 0xe381 0x8c55 0x1ea 0xe5ed 0x89e0 0x218 0xe858 0x8657 0x259 0xeac4 0x7fb5 0x5e6 0xed2f 0x73be 0xff6 0xef9b 0x73be 0xff6>;
			battery0_profile_t1_num = <0x64>;
			battery0_profile_t1_col = <0x03>;
			battery0_profile_t1 = <0x00 0xae6e 0x288 0x26c 0xad92 0x288 0x4d7 0xacea 0x286 0x743 0xac5c 0x27c 0x9ae 0xabde 0x273 0xc1a 0xab69 0x26b 0xe86 0xaaf7 0x266 0x10f1 0xaa89 0x26b 0x135d 0xaa19 0x261 0x15c8 0xa9aa 0x263 0x1834 0xa936 0x264 0x1a9f 0xa8c2 0x264 0x1d0b 0xa84b 0x25e 0x1f77 0xa7d0 0x259 0x21e2 0xa754 0x25b 0x244e 0xa6d9 0x25f 0x26b9 0xa659 0x257 0x2925 0xa5dc 0x257 0x2b91 0xa55b 0x25a 0x2dfc 0xa4dd 0x258 0x3068 0xa460 0x25f 0x32d3 0xa3e3 0x264 0x353f 0xa366 0x263 0x37aa 0xa2e9 0x261 0x3a16 0xa26f 0x262 0x3c82 0xa1f5 0x267 0x3eed 0xa17f 0x26f 0x4159 0xa108 0x26e 0x43c4 0xa093 0x271 0x4630 0xa020 0x276 0x489c 0x9fb0 0x27a 0x4b07 0x9f41 0x280 0x4d73 0x9ed5 0x28b 0x4fde 0x9e6a 0x296 0x524a 0x9e02 0x2a0 0x54b6 0x9d9b 0x2a1 0x5721 0x9d37 0x2aa 0x598d 0x9cd7 0x2bc 0x5bf8 0x9c78 0x2ce 0x5e64 0x9c1b 0x2e3 0x60cf 0x9bc0 0x2fd 0x633b 0x9b65 0x315 0x65a7 0x9b06 0x32b 0x6812 0x9aa0 0x335 0x6a7e 0x9a21 0x30f 0x6ce9 0x998d 0x2c4 0x6f55 0x9900 0x281 0x71c1 0x988d 0x25f 0x742c 0x9830 0x256 0x7698 0x97e0 0x250 0x7903 0x9797 0x24b 0x7b6f 0x9752 0x246 0x7dda 0x9715 0x24a 0x8046 0x96d8 0x249 0x82b2 0x969f 0x245 0x851d 0x9669 0x246 0x8789 0x9635 0x24b 0x89f4 0x9602 0x24b 0x8c60 0x95d3 0x24c 0x8ecc 0x95a7 0x254 0x9137 0x957c 0x254 0x93a3 0x9552 0x257 0x960e 0x952a 0x257 0x987a 0x9503 0x259 0x9ae5 0x94df 0x25f 0x9d51 0x94bd 0x268 0x9fbd 0x949c 0x26d 0xa228 0x947c 0x270 0xa494 0x945e 0x27b 0xa6ff 0x9440 0x288 0xa96b 0x9421 0x290 0xabd7 0x93f8 0x286 0xae42 0x93c5 0x26c 0xb0ae 0x9390 0x254 0xb319 0x9360 0x24b 0xb585 0x932f 0x248 0xb7f1 0x92fe 0x242 0xba5c 0x92cb 0x242 0xbcc8 0x92a0 0x244 0xbf33 0x9279 0x241 0xc19f 0x9253 0x246 0xc40a 0x9228 0x24b 0xc676 0x91f1 0x244 0xc8e2 0x91af 0x243 0xcb4d 0x916e 0x248 0xcdb9 0x9136 0x24b 0xd024 0x90eb 0x24b 0xd290 0x9097 0x243 0xd4fc 0x9065 0x244 0xd767 0x9050 0x249 0xd9d3 0x9042 0x24c 0xdc3e 0x9030 0x252 0xdeaa 0x9019 0x264 0xe115 0x8fea 0x26f 0xe381 0x8f2b 0x270 0xe5ed 0x8d89 0x287 0xe858 0x8b30 0x2b7 0xeac4 0x87e4 0x318 0xed2f 0x8224 0x675 0xef9b 0x75d3 0x1526>;
			battery0_profile_t2_num = <0x64>;
			battery0_profile_t2_col = <0x03>;
			battery0_profile_t2 = <0x00 0xae8b 0x4fb 0x26c 0xad9f 0x4fb 0x4d7 0xacf8 0x500 0x743 0xac70 0x4f6 0x9ae 0xabf9 0x4ea 0xc1a 0xab89 0x4e1 0xe86 0xab1c 0x4d6 0x10f1 0xaab1 0x4cb 0x135d 0xaa43 0x4be 0x15c8 0xa9d6 0x4bb 0x1834 0xa966 0x4b6 0x1a9f 0xa8f3 0x4b1 0x1d0b 0xa87c 0x4a8 0x1f77 0xa803 0x4a0 0x21e2 0xa789 0x49b 0x244e 0xa70c 0x495 0x26b9 0xa68f 0x491 0x2925 0xa612 0x496 0x2b91 0xa590 0x48c 0x2dfc 0xa513 0x48a 0x3068 0xa493 0x486 0x32d3 0xa414 0x489 0x353f 0xa397 0x48c 0x37aa 0xa31a 0x48b 0x3a16 0xa29e 0x48e 0x3c82 0xa225 0x494 0x3eed 0xa1ac 0x496 0x4159 0xa133 0x496 0x43c4 0xa0bf 0x49b 0x4630 0xa04d 0x4a7 0x489c 0x9fdb 0x4b2 0x4b07 0x9f6a 0x4ba 0x4d73 0x9efc 0x4c8 0x4fde 0x9e91 0x4d8 0x524a 0x9e25 0x4e8 0x54b6 0x9dbd 0x4f6 0x5721 0x9d58 0x50a 0x598d 0x9cf5 0x51e 0x5bf8 0x9c92 0x533 0x5e64 0x9c30 0x547 0x60cf 0x9bce 0x557 0x633b 0x9b6a 0x56a 0x65a7 0x9b02 0x570 0x6812 0x9a86 0x547 0x6a7e 0x99fd 0x507 0x6ce9 0x9972 0x4b8 0x6f55 0x98f3 0x476 0x71c1 0x9884 0x44f 0x742c 0x9825 0x43e 0x7698 0x97d2 0x436 0x7903 0x9788 0x42f 0x7b6f 0x9743 0x431 0x7dda 0x9702 0x42a 0x8046 0x96c3 0x424 0x82b2 0x9687 0x426 0x851d 0x9651 0x42e 0x8789 0x961c 0x432 0x89f4 0x95e6 0x42d 0x8c60 0x95b6 0x435 0x8ecc 0x9588 0x438 0x9137 0x955b 0x440 0x93a3 0x9530 0x448 0x960e 0x9507 0x450 0x987a 0x94e1 0x456 0x9ae5 0x94ba 0x459 0x9d51 0x9495 0x45d 0x9fbd 0x9473 0x467 0xa228 0x9455 0x472 0xa494 0x9433 0x475 0xa6ff 0x9415 0x475 0xa96b 0x93f9 0x483 0xabd7 0x93dc 0x48a 0xae42 0x93be 0x485 0xb0ae 0x939e 0x47c 0xb319 0x937a 0x474 0xb585 0x934e 0x464 0xb7f1 0x931f 0x457 0xba5c 0x92ea 0x44c 0xbcc8 0x92be 0x44e 0xbf33 0x9297 0x456 0xc19f 0x926d 0x45f 0xc40a 0x923d 0x467 0xc676 0x9202 0x46e 0xc8e2 0x91bd 0x47f 0xcb4d 0x917c 0x48a 0xcdb9 0x913c 0x495 0xd024 0x90ec 0x4a7 0xd290 0x9094 0x4be 0xd4fc 0x9058 0x4d4 0xd767 0x9037 0x4f4 0xd9d3 0x901e 0x522 0xdc3e 0x9002 0x55e 0xdeaa 0x8fde 0x5b7 0xe115 0x8f9c 0x63b 0xe381 0x8ed5 0x71e 0xe5ed 0x8d0e 0x919 0xe858 0x8a65 0x101d 0xeac4 0x86ad 0x2cda 0xed2f 0x819f 0x329f 0xef9b 0x819f 0x329f>;
			battery0_profile_t3_num = <0x64>;
			battery0_profile_t3_col = <0x03>;
			battery0_profile_t3 = <0x00 0xaef8 0xae5 0x26c 0xadd2 0xae5 0x4d7 0xad0d 0xad3 0x743 0xac78 0xab1 0x9ae 0xabfb 0xa8d 0xc1a 0xab8b 0xa6f 0xe86 0xab21 0xa55 0x10f1 0xaab8 0xa38 0x135d 0xaa4f 0xa1d 0x15c8 0xa9e5 0x9ff 0x1834 0xa979 0x9e9 0x1a9f 0xa90a 0x9ba 0x1d0b 0xa897 0x996 0x1f77 0xa823 0x97f 0x21e2 0xa7ac 0x968 0x244e 0xa734 0x94e 0x26b9 0xa6bb 0x940 0x2925 0xa63e 0x92b 0x2b91 0xa5c1 0x918 0x2dfc 0xa544 0x902 0x3068 0xa4c6 0x8f8 0x32d3 0xa447 0x8ed 0x353f 0xa3ca 0x8d6 0x37aa 0xa34f 0x8b8 0x3a16 0xa2d3 0x8a8 0x3c82 0xa25a 0x8af 0x3eed 0xa1e2 0x8aa 0x4159 0xa169 0x8a7 0x43c4 0xa0f4 0x8a6 0x4630 0xa07e 0x8a8 0x489c 0xa009 0x8ad 0x4b07 0x9f97 0x8b8 0x4d73 0x9f27 0x8c7 0x4fde 0x9eb8 0x8d0 0x524a 0x9e4b 0x8c0 0x54b6 0x9de0 0x8d3 0x5721 0x9d75 0x8e0 0x598d 0x9d0c 0x8e9 0x5bf8 0x9ca3 0x8f0 0x5e64 0x9c38 0x8f9 0x60cf 0x9bce 0x901 0x633b 0x9b5f 0x8ee 0x65a7 0x9ae9 0x8ce 0x6812 0x9a6c 0x896 0x6a7e 0x99eb 0x858 0x6ce9 0x996d 0x816 0x6f55 0x98f8 0x7e1 0x71c1 0x988c 0x7b0 0x742c 0x982b 0x780 0x7698 0x97d4 0x766 0x7903 0x9783 0x75c 0x7b6f 0x973d 0x75f 0x7dda 0x96f9 0x767 0x8046 0x96b8 0x764 0x82b2 0x967c 0x76b 0x851d 0x9642 0x76d 0x8789 0x9609 0x76c 0x89f4 0x95d6 0x775 0x8c60 0x95a2 0x775 0x8ecc 0x9572 0x77e 0x9137 0x9543 0x78b 0x93a3 0x9517 0x794 0x960e 0x94eb 0x794 0x987a 0x94c1 0x79b 0x9ae5 0x949b 0x79f 0x9d51 0x9478 0x7a0 0x9fbd 0x9455 0x7b3 0xa228 0x9433 0x7be 0xa494 0x9414 0x7c9 0xa6ff 0x93f7 0x7d4 0xa96b 0x93dc 0x7df 0xabd7 0x93c4 0x7f0 0xae42 0x93af 0x800 0xb0ae 0x9398 0x80f 0xb319 0x937d 0x824 0xb585 0x935e 0x836 0xb7f1 0x9338 0x83b 0xba5c 0x9309 0x846 0xbcc8 0x92d9 0x860 0xbf33 0x92a9 0x87d 0xc19f 0x927a 0x8ae 0xc40a 0x9246 0x8ed 0xc676 0x9208 0x930 0xc8e2 0x91c0 0x982 0xcb4d 0x9173 0x9d8 0xcdb9 0x9130 0xa5f 0xd024 0x90de 0xaf8 0xd290 0x907c 0xbae 0xd4fc 0x9026 0xc9d 0xd767 0x8feb 0xded 0xd9d3 0x8fbd 0xfcc 0xdc3e 0x8f88 0x129b 0xdeaa 0x8f4a 0x1742 0xe115 0x8eef 0x20ba 0xe381 0x8e42 0x3c9d 0xe5ed 0x8ced 0x4ee3 0xe858 0x8b5a 0x4af6 0xeac4 0x8b5a 0x4af6 0xed2f 0x8b5a 0x4af6 0xef9b 0x8b5a 0x4af6>;
			battery0_profile_t4_num = <0x64>;
			battery0_profile_t4_col = <0x03>;
			battery0_profile_t4 = <0x00 0xaf00 0x1810 0x26c 0xadb2 0x1810 0x4d7 0xaccd 0x1800 0x743 0xac1f 0x17d5 0x9ae 0xab8b 0x179c 0xc1a 0xab07 0x1764 0xe86 0xaa8b 0x172b 0x10f1 0xaa0f 0x16e9 0x135d 0xa99b 0x16bf 0x15c8 0xa926 0x1681 0x1834 0xa8b2 0x164d 0x1a9f 0xa83d 0x1614 0x1d0b 0xa7c6 0x15df 0x1f77 0xa74f 0x15af 0x21e2 0xa6d6 0x157c 0x244e 0xa65e 0x1548 0x26b9 0xa5e4 0x151c 0x2925 0xa56e 0x14f6 0x2b91 0xa4f6 0x14cd 0x2dfc 0xa47b 0x14a3 0x3068 0xa401 0x1481 0x32d3 0xa388 0x1462 0x353f 0xa310 0x1443 0x37aa 0xa297 0x1426 0x3a16 0xa221 0x140b 0x3c82 0xa1aa 0x13ed 0x3eed 0xa136 0x13d8 0x4159 0xa0c2 0x13c2 0x43c4 0xa04d 0x13ac 0x4630 0x9fd9 0x1397 0x489c 0x9f67 0x138b 0x4b07 0x9ef6 0x1386 0x4d73 0x9e86 0x137b 0x4fde 0x9e16 0x1366 0x524a 0x9da5 0x135e 0x54b6 0x9d35 0x134f 0x5721 0x9cc2 0x1334 0x598d 0x9c51 0x131b 0x5bf8 0x9bdf 0x1300 0x5e64 0x9b69 0x12de 0x60cf 0x9af3 0x12b7 0x633b 0x9a7c 0x128e 0x65a7 0x9a06 0x1260 0x6812 0x9992 0x1238 0x6a7e 0x9923 0x120f 0x6ce9 0x98b9 0x11ed 0x6f55 0x9857 0x11d4 0x71c1 0x97fa 0x11c8 0x742c 0x97a2 0x11c5 0x7698 0x9751 0x11c7 0x7903 0x9704 0x11c4 0x7b6f 0x96be 0x11c4 0x7dda 0x967a 0x11d5 0x8046 0x963a 0x11e8 0x82b2 0x95fe 0x1200 0x851d 0x95c5 0x121a 0x8789 0x958f 0x1235 0x89f4 0x955c 0x1258 0x8c60 0x952d 0x1281 0x8ecc 0x94fd 0x1297 0x9137 0x94cf 0x12af 0x93a3 0x94a6 0x12de 0x960e 0x9482 0x1311 0x987a 0x9461 0x1344 0x9ae5 0x9442 0x137f 0x9d51 0x9427 0x13c4 0x9fbd 0x940e 0x1408 0xa228 0x93f8 0x1461 0xa494 0x93e3 0x14c0 0xa6ff 0x93ca 0x152c 0xa96b 0x93b3 0x15af 0xabd7 0x939a 0x1641 0xae42 0x9381 0x16e2 0xb0ae 0x9364 0x1793 0xb319 0x9343 0x1851 0xb585 0x931e 0x192a 0xb7f1 0x92f7 0x1a17 0xba5c 0x92cd 0x1b19 0xbcc8 0x929e 0x1c3e 0xbf33 0x926a 0x1d7c 0xc19f 0x9231 0x1edc 0xc40a 0x91f3 0x2066 0xc676 0x91ad 0x2220 0xc8e2 0x9164 0x241b 0xcb4d 0x911b 0x266b 0xcdb9 0x90d0 0x294d 0xd024 0x9079 0x2cce 0xd290 0x901e 0x3155 0xd4fc 0x8fce 0x3722 0xd767 0x8f8f 0x3ebc 0xd9d3 0x8f5f 0x4989 0xdc3e 0x8f36 0x5499 0xdeaa 0x8f00 0x5412 0xe115 0x8eb7 0x5365 0xe381 0x8eb7 0x5365 0xe5ed 0x8eb7 0x5365 0xe858 0x8eb7 0x5365 0xeac4 0x8eb7 0x5365 0xed2f 0x8eb7 0x5365 0xef9b 0x8eb7 0x5365>;
		};
	};

	fragment@87 {
		target = <0xffffffff>;

		__overlay__ {

			bq25960-standalone@65 {
				compatible = "ti,bq25960-standalone";
				reg = <0x65>;
				interrupt-parent = <0xffffffff>;
				interrupts = <0x00 0x02 0x00 0x00>;
				interrupt-names = "bq25960_irq";
				pinctrl-names = "default";
				pinctrl-0 = <0x57>;
				sc8541-addr = <0x6a>;
			};

			wt6670f@35 {
				status = "okay";
				compatible = "mediatek,wt6670f_qc3p";
				reg = <0x35>;
				wt6670f-reset-gpio = <0xffffffff 0x1e 0x00>;
				wt6670f-int-gpio = <0xffffffff 0x13 0x00>;
				wt6670f-i2c-scl-pin = <0xffffffff 0x9b 0x00>;
				wt6670f-i2c-sda-pin = <0xffffffff 0x9c 0x00>;
				pinctrl-names = "default\0wt6670_i2c_scl_low\0wt6670_i2c_scl_high\0wt6670_i2c_sda_low\0wt6670_i2c_sda_high\0wt6670_i2c";
				pinctrl-0 = <0x58>;
				pinctrl-1 = <0x59>;
				pinctrl-2 = <0x5a>;
				pinctrl-3 = <0x5b>;
				pinctrl-4 = <0x5c>;
				pinctrl-5 = <0x5d>;
			};
		};
	};

	fragment@88 {
		target = <0xffffffff>;

		__overlay__ {

			wt6670_default_mode {
				phandle = <0x58>;
			};

			wt6670_scl_low {
				phandle = <0x59>;

				pins_cmd_dat {
					pinmux = <0x9b00>;
					slew-rate = <0x01>;
					output-low;
				};
			};

			wt6670_scl_high {
				phandle = <0x5a>;

				pins_cmd_dat {
					pinmux = <0x9b00>;
					slew-rate = <0x01>;
					output-high;
				};
			};

			wt6670_sda_low {
				phandle = <0x5b>;

				pins_cmd_dat {
					pinmux = <0x9c00>;
					slew-rate = <0x01>;
					output-low;
				};
			};

			wt6670_sda_high {
				phandle = <0x5c>;

				pins_cmd_dat {
					pinmux = <0x9c00>;
					slew-rate = <0x01>;
					output-high;
				};
			};

			wt6670_i2c_mode {
				phandle = <0x5d>;

				pins_cmd_dat {
					pinmux = <0x9c01 0x9b01>;
				};
			};

			bq25960_int_default {
				pinmux = <0x00>;
				slew-rate = <0x00>;
				input-enable;
				bias-pull-up;
				phandle = <0x57>;
			};
		};
	};

	fragment@89 {
		target = <0xffffffff>;

		__overlay__ {
			compatible = "gpio-leds";

			charging {
				label = "charging";
				gpios = <0xffffffff 0x17 0x00>;
				default-state = "off";
			};
		};
	};

	fragment@90 {
		target = <0xffffffff>;

		__overlay__ {
			bootmode = <0xffffffff>;
			mmi,thermal-mitigation = <0xffffffff 0x4f5880 0x47b760 0x44aa20 0x3d0900 0x33e140 0x2dc6c0 0x2625a0 0x1e8480 0x1b7740 0xf4240 0xc3500 0x7a120>;
			mmi,thermal-charger-pump-support;
		};
	};

	fragment@91 {
		target = <0xffffffff>;

		__overlay__ {
			polling-delay = <0x1388>;
			polling-delay-passive = <0xbb8>;
			thermal-sensors = <0xffffffff>;
		};
	};

	fragment@92 {
		target = <0xffffffff>;

		__overlay__ {
			compatible = "mmi,moto-chg-tcmd";
			status = "okay";
			mmi,ntc_table = <0x01>;
			mmi,ntc_v_ref = <0x1b7740>;
			mmi,ntc_r_pull = <0x186a0>;
			mmi,batid_v_ref = <0x1b7740>;
			mmi,batid_r_pull = <0x186a0>;
			mmi,adc-channel-cpu = <0x00>;
			mmi,adc-channel-charger = <0x02>;
			mmi,adc-channel-pa = <0x01>;
			mmi,adc-channel-batid = <0x03>;
			mmi,adc-channel-vbat = <0x64>;
		};
	};

	fragment@93 {
		target = <0xffffffff>;

		__overlay__ {
			led_brightness = <0x3ff>;
		};
	};

	__symbols__ {
		i2c_lcd_bias_mtk = "/fragment@3/__overlay__/i2c_lcd_bias@3e";
		aw99703_backlight = "/fragment@3/__overlay__/sprd_backlight@36";
		mtkfb_pins_lcd_bias_enp0 = "/fragment@5/__overlay__/lcd_bias_enp0_gpio";
		mtkfb_pins_lcd_bias_enn0 = "/fragment@5/__overlay__/lcd_bias_enn0_gpio";
		mtkfb_pins_lcm_rst_out1_gpio = "/fragment@5/__overlay__/lcm_rst_out1_gpio";
		mtkfb_pins_lcm_rst_out0_gpio = "/fragment@5/__overlay__/lcm_rst_out0_gpio";
		mtkfb_pins_lcm_dsi_te = "/fragment@5/__overlay__/lcm_dsi_te";
		panel_in1 = "/fragment@7/__overlay__/panel1@0/port/endpoint";
		panel_in2 = "/fragment@7/__overlay__/panel2@0/port/endpoint";
		panel_in3 = "/fragment@7/__overlay__/panel3@0/port/endpoint";
		panel_in4 = "/fragment@7/__overlay__/panel4@0/port/endpoint";
		panel_in5 = "/fragment@7/__overlay__/panel5@0/port/endpoint";
		dsi_out = "/fragment@7/__overlay__/ports/port/endpoint";
		camera_pins_cam0_rst_0 = "/fragment@8/__overlay__/cam0@0";
		camera_pins_cam0_rst_1 = "/fragment@8/__overlay__/cam0@1";
		camera_pins_cam1_rst_0 = "/fragment@8/__overlay__/cam1@0";
		camera_pins_cam1_rst_1 = "/fragment@8/__overlay__/cam1@1";
		camera_pins_cam2_rst_0 = "/fragment@8/__overlay__/cam2@0";
		camera_pins_cam2_rst_1 = "/fragment@8/__overlay__/cam2@1";
		camera_pins_cam0_vcamd_0 = "/fragment@8/__overlay__/cam0@vcam0";
		camera_pins_cam0_vcamd_1 = "/fragment@8/__overlay__/cam0@vcam1";
		camera_pins_cam0_vcama_0 = "/fragment@8/__overlay__/cam0@vcam2";
		camera_pins_cam0_vcama_1 = "/fragment@8/__overlay__/cam0@vcam3";
		camera_pins_cam0_vcamio_0 = "/fragment@8/__overlay__/cam0@vcam4";
		camera_pins_cam0_vcamio_1 = "/fragment@8/__overlay__/cam0@vcam5";
		camera_pins_cam0_vcamd1_0 = "/fragment@8/__overlay__/cam0@vcam6";
		camera_pins_cam0_vcamd1_1 = "/fragment@8/__overlay__/cam0@vcam7";
		camera_pins_cam0_vcamaf_0 = "/fragment@8/__overlay__/cam2@vcam8";
		camera_pins_cam0_vcamaf_1 = "/fragment@8/__overlay__/cam2@vcam9";
		camera_pins_cam1_vcamd_0 = "/fragment@8/__overlay__/cam1@vcam0";
		camera_pins_cam1_vcamd_1 = "/fragment@8/__overlay__/cam1@vcam1";
		camera_pins_cam1_vcama_0 = "/fragment@8/__overlay__/cam1@vcam2";
		camera_pins_cam1_vcama_1 = "/fragment@8/__overlay__/cam1@vcam3";
		camera_pins_cam1_vcamio_0 = "/fragment@8/__overlay__/cam1@vcam4";
		camera_pins_cam1_vcamio_1 = "/fragment@8/__overlay__/cam1@vcam5";
		camera_pins_cam2_vcamd_0 = "/fragment@8/__overlay__/cam2@vcam0";
		camera_pins_cam2_vcamd_1 = "/fragment@8/__overlay__/cam2@vcam1";
		camera_pins_cam2_vcama_0 = "/fragment@8/__overlay__/cam2@vcam2";
		camera_pins_cam2_vcama_1 = "/fragment@8/__overlay__/cam2@vcam3";
		camera_pins_cam2_vcamio_0 = "/fragment@8/__overlay__/cam2@vcam4";
		camera_pins_cam2_vcamio_1 = "/fragment@8/__overlay__/cam2@vcam5";
		camera_pins_cam0_mclk_off = "/fragment@8/__overlay__/camera_pins_cam0_mclk_off";
		camera_pins_cam0_mclk_2ma = "/fragment@8/__overlay__/camera_pins_cam0_mclk_2ma";
		camera_pins_cam0_mclk_4ma = "/fragment@8/__overlay__/camera_pins_cam0_mclk_4ma";
		camera_pins_cam0_mclk_6ma = "/fragment@8/__overlay__/camera_pins_cam0_mclk_6ma";
		camera_pins_cam0_mclk_8ma = "/fragment@8/__overlay__/camera_pins_cam0_mclk_8ma";
		camera_pins_cam1_mclk_off = "/fragment@8/__overlay__/camera_pins_cam1_mclk_off";
		camera_pins_cam1_mclk_2ma = "/fragment@8/__overlay__/camera_pins_cam1_mclk_2ma";
		camera_pins_cam1_mclk_4ma = "/fragment@8/__overlay__/camera_pins_cam1_mclk_4ma";
		camera_pins_cam1_mclk_6ma = "/fragment@8/__overlay__/camera_pins_cam1_mclk_6ma";
		camera_pins_cam1_mclk_8ma = "/fragment@8/__overlay__/camera_pins_cam1_mclk_8ma";
		camera_pins_cam2_mclk_off = "/fragment@8/__overlay__/camera_pins_cam2_mclk_off";
		camera_pins_cam2_mclk_2ma = "/fragment@8/__overlay__/camera_pins_cam2_mclk_2ma";
		camera_pins_cam2_mclk_4ma = "/fragment@8/__overlay__/camera_pins_cam2_mclk_4ma";
		camera_pins_cam2_mclk_6ma = "/fragment@8/__overlay__/camera_pins_cam2_mclk_6ma";
		camera_pins_cam2_mclk_8ma = "/fragment@8/__overlay__/camera_pins_cam2_mclk_8ma";
		camera_pins_default = "/fragment@8/__overlay__/camdefault";
		flashlight_gpio_high = "/fragment@8/__overlay__/flashlight@0";
		flashlight_gpio_low = "/fragment@8/__overlay__/flashlight@1";
		flashlight_pwm_high = "/fragment@8/__overlay__/flashlight@2";
		flashlight_pwm_low = "/fragment@8/__overlay__/flashlight@3";
		flashlight_pwm_en = "/fragment@8/__overlay__/flashlight@4";
		flash_default = "/fragment@8/__overlay__/flashlightdefault";
		mtk_camera_eeprom0 = "/fragment@10/__overlay__/camera_eeprom0@50";
		camera_main_mtk = "/fragment@10/__overlay__/camera_main@1a";
		mtk_camera_eeprom1 = "/fragment@11/__overlay__/camera_eeprom1@51";
		camera_sub_mtk = "/fragment@11/__overlay__/camera_sub@1a";
		mtk_camera_eeprom2 = "/fragment@12/__overlay__/camera_eeprom2@50";
		camera_main_two_mtk = "/fragment@12/__overlay__/camera_main_two@10";
		camera_main_af_mtk = "/fragment@14/__overlay__/camera_main_af@72";
		camera_main_two_af_mtk2 = "/fragment@15/__overlay__/camera_main_two_af@0c";
		sar_int_default = "/fragment@16/__overlay__/sar_int_default";
		sar_int_sleep = "/fragment@16/__overlay__/sar_int_sleep";
		sx937x = "/fragment@18/__overlay__/sx937x@2c";
		spk = "/fragment@19/__overlay__/speaker_amp@5c";
		aud_pins_hacamp_high = "/fragment@21/__overlay__/aud_pins_hacamp_high";
		aud_pins_hacamp_low = "/fragment@21/__overlay__/aud_pins_hacamp_low";
		fingerfp_rst_high = "/fragment@24/__overlay__/fingerfp_rst_high";
		fingerfp_rst_low = "/fragment@24/__overlay__/fingerfp_rst_low";
		fingerfp_irq_active = "/fragment@24/__overlay__/fingerfp_irq_active";
		fingerfp_spi_active = "/fragment@24/__overlay__/fingerfp_spi_active";
		fingerfp_spi_default = "/fragment@24/__overlay__/fingerfp_spi_default";
		fingerprint_irq = "/fragment@24/__overlay__/fingerprint_irq";
		fingerprint_reset_high = "/fragment@24/__overlay__/fingerprint_reset_high";
		fingerprint_reset_low = "/fragment@24/__overlay__/fingerprint_reset_low";
		fingerprint_int = "/fragment@26/__overlay__/fingerprint_int";
		chipone_int = "/fragment@26/__overlay__/chipone_int";
		nfc_pn5xx = "/fragment@30/__overlay__/nfc_pn5xx@28";
		p61 = "/fragment@32/__overlay__/p61@0";
		pinctrl_state_mode_spi = "/fragment@33/__overlay__/pinctrl_state_mode_spi";
		pinctrl_state_mode_idle = "/fragment@33/__overlay__/pinctrl_state_mode_idle";
		mtee = "/fragment@34/__overlay__/MTEE";
		svp = "/fragment@34/__overlay__/SecureVideoPath";
		gps_pins_default = "/fragment@36/__overlay__/gps_default";
		gps_l1_lna_pins_ol = "/fragment@36/__overlay__/gps_l1_lna@0";
		gps_l1_lna_pins_dsp_ctrl = "/fragment@36/__overlay__/gps_l1_lna@1";
		gps_l1_lna_pins_oh = "/fragment@36/__overlay__/gps_l1_lna@2";
		gps_l5_lna_pins_ol = "/fragment@36/__overlay__/gps_l5_lna@0";
		gps_l5_lna_pins_dsp_ctrl = "/fragment@36/__overlay__/gps_l5_lna@1";
		gps_l5_lna_pins_oh = "/fragment@36/__overlay__/gps_l5_lna@2";
		lm3644 = "/fragment@38/__overlay__/lm3644@63";
		fl_core_0 = "/fragment@38/__overlay__/lm3644@63/flash@0/port@0/endpoint";
		fl_core_1 = "/fragment@38/__overlay__/lm3644@63/flash@1/port@1/endpoint";
		lm3644_pins_default = "/fragment@39/__overlay__/default";
		lm3644_pins_hwen_high = "/fragment@39/__overlay__/hwen_high";
		lm3644_pins_hwen_low = "/fragment@39/__overlay__/hwen_low";
		flashlight_0 = "/fragment@40/__overlay__/port@0/endpoint";
		flashlight_1 = "/fragment@40/__overlay__/port@1/endpoint";
		camera_main_three_af_mtk = "/fragment@42/__overlay__/camera_main_three_af@0c";
		mmc1_pins_default = "/fragment@46/__overlay__/mmc1default";
		mmc1_pins_uhs = "/fragment@46/__overlay__/mmc1@0";
		ctp_ft8725_pins_default = "/fragment@48/__overlay__/pins_default";
		ctp_ft8725_spi_mode = "/fragment@48/__overlay__/spimode_default";
		main_pmic = "/fragment@51/__overlay__/pmic@4";
		pmic_adc = "/fragment@51/__overlay__/pmic@4/mt6363-auxadc";
		pa_therm1 = "/fragment@60/__overlay__/pa_therm1";
		nrpa_ntc = "/fragment@60/__overlay__/nrpa_ntc";
		wt6670_pins_default = "/fragment@88/__overlay__/wt6670_default_mode";
		wt6670_pins_scl_low = "/fragment@88/__overlay__/wt6670_scl_low";
		wt6670_pins_scl_high = "/fragment@88/__overlay__/wt6670_scl_high";
		wt6670_pins_sda_low = "/fragment@88/__overlay__/wt6670_sda_low";
		wt6670_pins_sda_high = "/fragment@88/__overlay__/wt6670_sda_high";
		wt6670_pins_i2c = "/fragment@88/__overlay__/wt6670_i2c_mode";
		bq25960_int_default = "/fragment@88/__overlay__/bq25960_int_default";
	};

	__fixups__ {
		utags = "/fragment@0:target:0";
		hw = "/fragment@1:target:0";
		dispsys_config = "/fragment@2:target:0\0/fragment@31:target:0";
		i2c6 = "/fragment@3:target:0\0/fragment@19:target:0\0/fragment@38:target:0";
		pio = "/fragment@3/__overlay__/i2c_lcd_bias@3e:sm,lcd-bias-enn-gpio:0\0/fragment@3/__overlay__/i2c_lcd_bias@3e:sm,lcd-bias-enp-gpio:0\0/fragment@3/__overlay__/sprd_backlight@36:hwen-gpio:0\0/fragment@3/__overlay__/sprd_backlight@36:aw99703,hwen-gpio:0\0/fragment@5:target:0\0/fragment@7/__overlay__/panel2@0:reset-gpios:0\0/fragment@7/__overlay__/panel2@0:bias_n-gpios:0\0/fragment@7/__overlay__/panel2@0:bias_p-gpios:0\0/fragment@7/__overlay__/panel3@0:reset-gpios:0\0/fragment@7/__overlay__/panel3@0:bias_n-gpios:0\0/fragment@7/__overlay__/panel3@0:bias_p-gpios:0\0/fragment@7/__overlay__/panel4@0:reset-gpios:0\0/fragment@7/__overlay__/panel4@0:bias_n-gpios:0\0/fragment@7/__overlay__/panel4@0:bias_p-gpios:0\0/fragment@7/__overlay__/panel5@0:reset-gpios:0\0/fragment@7/__overlay__/panel5@0:bias_n-gpios:0\0/fragment@7/__overlay__/panel5@0:bias_p-gpios:0\0/fragment@8:target:0\0/fragment@16:target:0\0/fragment@18/__overlay__/sx937x@2c:interrupt-parent:0\0/fragment@18/__overlay__/sx937x@2c:Semtech,nirq-gpio:0\0/fragment@21:target:0\0/fragment@24:target:0\0/fragment@26/__overlay__/fingerprint_int:interrupt-parent:0\0/fragment@26/__overlay__/fingerprint_int:goodix_rst:0\0/fragment@26/__overlay__/fingerprint_int:gf,gpio_irq:0\0/fragment@26/__overlay__/chipone_int:interrupt-parent:0\0/fragment@26/__overlay__/chipone_int:chipone,irq:0\0/fragment@30/__overlay__/sec-nfc@27:sec-nfc,ven-gpio:0\0/fragment@30/__overlay__/sec-nfc@27:sec-nfc,firm-gpio:0\0/fragment@30/__overlay__/sec-nfc@27:sec-nfc,irq-gpio:0\0/fragment@30/__overlay__/sec-nfc@27:sec-nfc,clk_req-gpio:0\0/fragment@30/__overlay__/nfc_pn5xx@28:interrupt-parent:0\0/fragment@30/__overlay__/nfc_pn5xx@28:qcom,sn-irq:0\0/fragment@30/__overlay__/nfc_pn5xx@28:qcom,sn-ven:0\0/fragment@33:target:0\0/fragment@36:target:0\0/fragment@39:target:0\0/fragment@45/__overlay__:cd-gpios:0\0/fragment@46:target:0\0/fragment@47/__overlay__/novatek@0:novatek,reset-gpio:0\0/fragment@47/__overlay__/novatek@0:novatek,irq-gpio:0\0/fragment@47/__overlay__/ilitek@1:touch,reset-gpio:0\0/fragment@47/__overlay__/ilitek@1:touch,irq-gpio:0\0/fragment@47/__overlay__/focaltech@2:focaltech,reset-gpio:0\0/fragment@47/__overlay__/focaltech@2:focaltech,irq-gpio:0\0/fragment@48:target:0\0/fragment@61/__overlay__:GPIO_FDD_BAND_SUPPORT_DETECT_3RD_PIN:0\0/fragment@61/__overlay__:GPIO_SIM1_HOT_PLUG:0\0/fragment@61/__overlay__:GPIO_SIM2_HOT_PLUG:0\0/fragment@61/__overlay__:GPIO_SIM1_SCLK:0\0/fragment@61/__overlay__:GPIO_SIM1_SRST:0\0/fragment@61/__overlay__:GPIO_SIM1_SIO:0\0/fragment@61/__overlay__:GPIO_SIM2_SCLK:0\0/fragment@61/__overlay__:GPIO_SIM2_SRST:0\0/fragment@61/__overlay__:GPIO_SIM2_SIO:0\0/fragment@61/__overlay__:GPIO_FDD_BAND_SUPPORT_DETECT_1ST_PIN:0\0/fragment@63/__overlay__:interrupt-parent:0\0/fragment@64/__overlay__:interrupt-parent:0\0/fragment@64/__overlay__:deb-gpios:0\0/fragment@65/__overlay__:interrupt-parent:0\0/fragment@66/__overlay__:interrupt-parent:0\0/fragment@67/__overlay__:interrupt-parent:0\0/fragment@67/__overlay__:deb-gpios:0\0/fragment@68/__overlay__:interrupt-parent:0\0/fragment@68/__overlay__:deb-gpios:0\0/fragment@69/__overlay__:interrupt-parent:0\0/fragment@69/__overlay__:deb-gpios:0\0/fragment@70/__overlay__:interrupt-parent:0\0/fragment@70/__overlay__:deb-gpios:0\0/fragment@71/__overlay__:interrupt-parent:0\0/fragment@72/__overlay__:interrupt-parent:0\0/fragment@87/__overlay__/bq25960-standalone@65:interrupt-parent:0\0/fragment@87/__overlay__/wt6670f@35:wt6670f-reset-gpio:0\0/fragment@87/__overlay__/wt6670f@35:wt6670f-int-gpio:0\0/fragment@87/__overlay__/wt6670f@35:wt6670f-i2c-scl-pin:0\0/fragment@87/__overlay__/wt6670f@35:wt6670f-i2c-sda-pin:0\0/fragment@88:target:0\0/fragment@89/__overlay__/charging:gpios:0";
		mtk_leds = "/fragment@4:target:0";
		mtkfb = "/fragment@6:target:0";
		dsi0 = "/fragment@7:target:0";
		kd_camera_hw1 = "/fragment@9:target:0";
		mt6369_vtp = "/fragment@9/__overlay__:cam2_vcamaf-supply:0";
		i2c2 = "/fragment@10:target:0\0/fragment@14:target:0\0/fragment@42:target:0";
		i2c4 = "/fragment@11:target:0";
		i2c8 = "/fragment@12:target:0\0/fragment@15:target:0";
		flashlights_cancunf = "/fragment@13:target:0";
		pericfg_ao_clk = "/fragment@13/__overlay__:srcclk:0";
		mt6363_vio18 = "/fragment@17:target:0\0/fragment@18/__overlay__/sx937x@2c:cap_vdd-supply:0";
		i2c0 = "/fragment@18:target:0";
		i2c7 = "/fragment@20:target:0\0/fragment@41:target:0";
		afe = "/fragment@22:target:0";
		aud_clk_mosi_off = "/fragment@22/__overlay__:pinctrl-0:0";
		aud_clk_mosi_on = "/fragment@22/__overlay__:pinctrl-1:0";
		aud_dat_mosi_off = "/fragment@22/__overlay__:pinctrl-2:0";
		aud_dat_mosi_on = "/fragment@22/__overlay__:pinctrl-3:0";
		aud_dat_miso0_off = "/fragment@22/__overlay__:pinctrl-4:0";
		aud_dat_miso0_on = "/fragment@22/__overlay__:pinctrl-5:0";
		aud_dat_miso1_off = "/fragment@22/__overlay__:pinctrl-6:0";
		aud_dat_miso1_on = "/fragment@22/__overlay__:pinctrl-7:0";
		aud_dat_miso2_off = "/fragment@22/__overlay__:pinctrl-8:0";
		aud_dat_miso2_on = "/fragment@22/__overlay__:pinctrl-9:0";
		vow_dat_miso_off = "/fragment@22/__overlay__:pinctrl-10:0";
		vow_dat_miso_on = "/fragment@22/__overlay__:pinctrl-11:0";
		vow_clk_miso_off = "/fragment@22/__overlay__:pinctrl-12:0";
		vow_clk_miso_on = "/fragment@22/__overlay__:pinctrl-13:0";
		aud_gpio_i2s0_off = "/fragment@22/__overlay__:pinctrl-14:0";
		aud_gpio_i2s0_on = "/fragment@22/__overlay__:pinctrl-15:0";
		aud_gpio_i2s3_off = "/fragment@22/__overlay__:pinctrl-16:0";
		aud_gpio_i2s3_on = "/fragment@22/__overlay__:pinctrl-17:0";
		mt6369_vfp = "/fragment@23:target:0\0/fragment@26/__overlay__/fingerprint_int:fp_vdd-supply:0\0/fragment@26/__overlay__/chipone_int:fp_vdd-supply:0";
		spi1 = "/fragment@25:target:0";
		odm = "/fragment@26:target:0\0/fragment@78:target:0";
		memory_ssmr_features = "/fragment@27:target:0";
		chosen = "/fragment@28:target:0\0/fragment@90/__overlay__:bootmode:0";
		clock_buffer_ctrl = "/fragment@29:target:0";
		i2c3 = "/fragment@30:target:0";
		spi5 = "/fragment@32:target:0";
		mtee_svp = "/fragment@34:target:0";
		regulator_vibrator = "/fragment@35:target:0";
		gps = "/fragment@37:target:0";
		mtk_composite_v4l2_1 = "/fragment@40:target:0";
		camera_af_hw_node = "/fragment@43:target:0";
		rt5133_ldo3 = "/fragment@43/__overlay__:camaf_m1_pmic-supply:0";
		rt5133_ldo2 = "/fragment@43/__overlay__:camaf_m2_pmic-supply:0";
		rt5133_gpio1 = "/fragment@43/__overlay__:camaf_m3_pmic-supply:0";
		sound = "/fragment@44:target:0";
		mmc1 = "/fragment@45:target:0";
		mt6369_vmch_eint_low = "/fragment@45/__overlay__:vmmc-supply:0";
		spi3 = "/fragment@47:target:0";
		mt6369_vio28 = "/fragment@49:target:0";
		u2port0 = "/fragment@50:target:0";
		spmi = "/fragment@51:target:0";
		tboard_thermistor1 = "/fragment@52:target:0\0/fragment@91/__overlay__:thermal-sensors:0";
		tboard_thermistor2 = "/fragment@53:target:0\0/fragment@60/__overlay__/pa_therm1:thermal-sensors:0";
		tboard_thermistor3 = "/fragment@54:target:0\0/fragment@60/__overlay__/nrpa_ntc:thermal-sensors:0";
		tboard_thermistor4 = "/fragment@55:target:0\0/fragment@60/__overlay__/emmc_therm:thermal-sensors:0";
		tboard_thermistor5 = "/fragment@56:target:0\0/fragment@60/__overlay__/chg_ntc:thermal-sensors:0";
		tboard_thermistor6 = "/fragment@57:target:0\0/fragment@60/__overlay__/mtktsflashlight:thermal-sensors:0";
		ltepa_ntc = "/fragment@58:target:0";
		therm_intf = "/fragment@59:target:0";
		thermal_zones = "/fragment@60:target:0";
		gpio_usage_mapping = "/fragment@61:target:0";
		gpio = "/fragment@62:target:0";
		subpmic_pmu_eint = "/fragment@63:target:0";
		mrdump_ext_rst = "/fragment@64:target:0";
		touch = "/fragment@65:target:0";
		rt5133_eint = "/fragment@66:target:0";
		swtp = "/fragment@67:target:0";
		swtp_1 = "/fragment@68:target:0";
		swtp_2 = "/fragment@69:target:0";
		swtp_3 = "/fragment@70:target:0";
		smart_pa = "/fragment@71:target:0";
		dsi_te = "/fragment@72:target:0";
		md1_sim1_hot_plug_eint = "/fragment@73:target:0";
		md1_sim2_hot_plug_eint = "/fragment@74:target:0";
		keypad = "/fragment@75:target:0";
		lk_charger = "/fragment@76:target:0\0/fragment@93:target:0";
		charger = "/fragment@77:target:0";
		mt6375_chg = "/fragment@78/__overlay__/mmi_chrg_manager:charger:0\0/fragment@79:target:0";
		extcon_usb = "/fragment@80:target:0";
		pdc = "/fragment@81:target:0";
		pe2 = "/fragment@82:target:0";
		mt6375_typec = "/fragment@83:target:0";
		pd_adapter = "/fragment@84:target:0";
		pe5 = "/fragment@85:target:0";
		mtk_gauge = "/fragment@85/__overlay__:gauge:0\0/fragment@86:target:0";
		i2c9 = "/fragment@87:target:0";
		charge_leds = "/fragment@89:target:0";
		charger_cooler = "/fragment@90:target:0";
		ap_ntc = "/fragment@91:target:0";
		moto_chg_tcmd = "/fragment@92:target:0";
	};

	__local_fixups__ {

		fragment@6 {

			__overlay__ {
				pinctrl-0 = <0x00>;
				pinctrl-1 = <0x00>;
				pinctrl-2 = <0x00>;
				pinctrl-3 = <0x00>;
				pinctrl-4 = <0x00>;
			};
		};

		fragment@7 {

			__overlay__ {

				panel1@0 {

					port {

						endpoint {
							remote-endpoint = <0x00>;
						};
					};
				};

				panel2@0 {

					port {

						endpoint {
							remote-endpoint = <0x00>;
						};
					};
				};

				panel3@0 {

					port {

						endpoint {
							remote-endpoint = <0x00>;
						};
					};
				};

				panel4@0 {

					port {

						endpoint {
							remote-endpoint = <0x00>;
						};
					};
				};

				panel5@0 {

					port {

						endpoint {
							remote-endpoint = <0x00>;
						};
					};
				};

				ports {

					port {

						endpoint {
							remote-endpoint = <0x00>;
						};
					};
				};
			};
		};

		fragment@9 {

			__overlay__ {
				pinctrl-0 = <0x00>;
				pinctrl-1 = <0x00>;
				pinctrl-2 = <0x00>;
				pinctrl-3 = <0x00>;
				pinctrl-4 = <0x00>;
				pinctrl-5 = <0x00>;
				pinctrl-6 = <0x00>;
				pinctrl-7 = <0x00>;
				pinctrl-8 = <0x00>;
				pinctrl-9 = <0x00>;
				pinctrl-10 = <0x00>;
				pinctrl-11 = <0x00>;
				pinctrl-12 = <0x00>;
				pinctrl-13 = <0x00>;
				pinctrl-14 = <0x00>;
				pinctrl-15 = <0x00>;
				pinctrl-16 = <0x00>;
				pinctrl-17 = <0x00>;
				pinctrl-18 = <0x00>;
				pinctrl-19 = <0x00>;
				pinctrl-20 = <0x00>;
				pinctrl-21 = <0x00>;
				pinctrl-22 = <0x00>;
				pinctrl-23 = <0x00>;
				pinctrl-24 = <0x00>;
				pinctrl-25 = <0x00>;
				pinctrl-26 = <0x00>;
				pinctrl-27 = <0x00>;
				pinctrl-28 = <0x00>;
				pinctrl-29 = <0x00>;
				pinctrl-30 = <0x00>;
				pinctrl-31 = <0x00>;
				pinctrl-32 = <0x00>;
				pinctrl-33 = <0x00>;
				pinctrl-34 = <0x00>;
				pinctrl-35 = <0x00>;
				pinctrl-36 = <0x00>;
				pinctrl-37 = <0x00>;
				pinctrl-38 = <0x00>;
				pinctrl-39 = <0x00>;
				pinctrl-40 = <0x00>;
				pinctrl-41 = <0x00>;
				pinctrl-42 = <0x00>;
				pinctrl-43 = <0x00>;
			};
		};

		fragment@13 {

			__overlay__ {
				pinctrl-0 = <0x00>;
				pinctrl-1 = <0x00>;
				pinctrl-2 = <0x00>;
				pinctrl-3 = <0x00>;
				pinctrl-4 = <0x00>;
				pinctrl-5 = <0x00>;
			};
		};

		fragment@18 {

			__overlay__ {

				sx937x@2c {
					pinctrl-0 = <0x00>;
					pinctrl-1 = <0x00>;
				};
			};
		};

		fragment@22 {

			__overlay__ {
				pinctrl-18 = <0x00>;
				pinctrl-19 = <0x00>;
			};
		};

		fragment@26 {

			__overlay__ {

				fingerprint_int {
					pinctrl-0 = <0x00>;
					pinctrl-1 = <0x00>;
					pinctrl-2 = <0x00>;
				};

				chipone_int {
					pinctrl-0 = <0x00>;
					pinctrl-1 = <0x00>;
					pinctrl-2 = <0x00>;
				};
			};
		};

		fragment@31 {

			__overlay__ {
				pinctrl-0 = <0x00>;
				pinctrl-1 = <0x00>;
				pinctrl-2 = <0x00>;
			};
		};

		fragment@32 {

			__overlay__ {

				p61@0 {
					pinctrl-0 = <0x00>;
					pinctrl-1 = <0x00>;
				};
			};
		};

		fragment@37 {

			__overlay__ {
				pinctrl-0 = <0x00>;
				pinctrl-1 = <0x00>;
				pinctrl-2 = <0x00>;
				pinctrl-3 = <0x00>;
				pinctrl-4 = <0x00>;
				pinctrl-5 = <0x00>;
				pinctrl-6 = <0x00>;
			};
		};

		fragment@38 {

			__overlay__ {

				lm3644@63 {
					pinctrl-0 = <0x00>;
					pinctrl-1 = <0x00>;
					pinctrl-2 = <0x00>;

					flash@0 {

						port@0 {

							endpoint {
								remote-endpoint = <0x00>;
							};
						};
					};

					flash@1 {

						port@1 {

							endpoint {
								remote-endpoint = <0x00>;
							};
						};
					};
				};
			};
		};

		fragment@40 {

			__overlay__ {

				port@0 {

					endpoint {
						remote-endpoint = <0x00>;
					};
				};

				port@1 {

					endpoint {
						remote-endpoint = <0x00>;
					};
				};
			};
		};

		fragment@44 {

			__overlay__ {

				mediatek,speaker-codec {
					sound-dai = <0x00>;
				};
			};
		};

		fragment@45 {

			__overlay__ {
				pinctrl-0 = <0x00>;
				pinctrl-1 = <0x00>;
			};
		};

		fragment@47 {

			__overlay__ {
				pinctrl-0 = <0x00>;
				pinctrl-1 = <0x00>;
			};
		};

		fragment@55 {

			__overlay__ {
				io-channels = <0x00>;
			};
		};

		fragment@56 {

			__overlay__ {
				io-channels = <0x00>;
			};
		};

		fragment@57 {

			__overlay__ {
				io-channels = <0x00>;
			};
		};

		fragment@87 {

			__overlay__ {

				bq25960-standalone@65 {
					pinctrl-0 = <0x00>;
				};

				wt6670f@35 {
					pinctrl-0 = <0x00>;
					pinctrl-1 = <0x00>;
					pinctrl-2 = <0x00>;
					pinctrl-3 = <0x00>;
					pinctrl-4 = <0x00>;
					pinctrl-5 = <0x00>;
				};
			};
		};
	};
};
